AUTOSAR XML (schema 4-0-2)
package /ARRoot
  pdu MyISignalIPdu
    mapping MyISignalToIPduMapping1: start-position=5
    mapping MyISignalToIPduMapping2: start-position=9
