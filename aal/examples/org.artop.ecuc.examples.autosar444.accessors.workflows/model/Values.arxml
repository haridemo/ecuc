AUTOSAR XML (schema 4-1-2)
package /Values
  module config NvMValues: definition=NvM
    NvMBlockDescriptorValues (NvMBlockDescriptor): NvMBlockJobPriority=3, NvMBlockCrcType=NVM_CRC16, NvMBlockUseCrc=1
