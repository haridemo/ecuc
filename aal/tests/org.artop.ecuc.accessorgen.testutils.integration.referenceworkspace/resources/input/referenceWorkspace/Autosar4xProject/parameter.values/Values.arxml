AUTOSAR XML (schema 4-3-0)
package /Values
  module config AdcValues: definition=Adc
    AdcConfigSetValues (AdcConfigSet)
      AdcHwUnitValues (AdcHwUnit): AdcPrescale=13
        AdcChannelValues1 (AdcChannel)
        AdcChannelValues2 (AdcChannel)
        AdcGroupValues (AdcGroup): AdcGroupDefinition=AdcChannelValues1
    AdcGeneralValues (AdcGeneral)
    AdcPublishedInformationValues (AdcPublishedInformation)
  module config BswMValues: definition=BswM
    BswMConfigValues (BswMConfig)
      BswMArbitrationValues (BswMArbitration)
        BswMModeConditionValues (BswMModeCondition)
          BswMConditionValueVals (BswMConditionValue)
            BswModeValues (BswMBswMode): BswMBswRequestedMode=Whatever a mode is
    BswMGeneralValueValues (BswMGeneral)
      BswMUserIncludeFilesValues (BswMUserIncludeFiles): BswMUserIncludeFile=BswMUserIncludeFile
  module config CanSMValues: definition=CanSM
  module config EcuCValues: definition=EcuC
    EcucPartitionCollectionValues (EcucPartitionCollection)
      EcucPartitionValues (EcucPartition)
  module config IPduMValues: definition=IpduM
    IPduMContainerRxPduValues (IpduMContainerRxPdu): IpduMContainerHeaderSize=IPDUM_HEADERTYPE_LONG
  module config NvMValues: definition=NvM
    NvMBlockDescriptorValues (NvMBlockDescriptor): NvMBlockCrcType=NVM_CRC16, NvMBlockJobPriority=3, NvMBlockUseCrc=1
