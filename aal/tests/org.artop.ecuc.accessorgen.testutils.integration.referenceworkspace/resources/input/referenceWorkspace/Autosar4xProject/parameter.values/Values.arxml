AUTOSAR XML (schema 4-1-2)
package /Values
  module config NvMValues: definition=NvM
    NvMBlockDescriptorValues (NvMBlockDescriptor): NvMBlockJobPriority=3, NvMBlockCrcType=NVM_CRC16, NvMBlockUseCrc=1
  module config AdcValues: definition=Adc
    AdcConfigSetValues (AdcConfigSet)
      AdcHwUnitValues (AdcHwUnit): AdcPrescale=13
    AdcGeneralValues (AdcGeneral)
    AdcPublishedInformationValues (AdcPublishedInformation)
  module config BswMValues: definition=BswM
    BswMConfigValues (BswMConfig)
      BswMArbitrationValues (BswMArbitration)
        BswMModeConditionValues (BswMModeCondition)
          BswMConditionValueVals (BswMConditionValue)
            BswModeValues (BswMBswMode): BswMBswRequestedMode=Whatever a mode is
    BswMGeneralValueValues (BswMGeneral)
      BswMUserIncludeFilesValues (BswMUserIncludeFiles): BswMUserIncludeFile=BswMUserIncludeFile
  module config EcuCValues: definition=EcuC
    EcucPartitionCollectionValues (EcucPartitionCollection)
      EcucPartitionValues (EcucPartition)
