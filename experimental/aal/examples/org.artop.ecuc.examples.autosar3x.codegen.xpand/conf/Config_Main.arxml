AUTOSAR XML (schema 3.1.1)
package /GEENSYS
  ecu configuration SMERA_ECU: ecu-extract=SystemMapping, module=SpiCustom_Config
  module config EcuM_Config: definition=EcuM, implementation-config-variant=VARIANT-PRE-COMPILE, module-description=EcuM_Impl
    EcuMConfiguration:
      EcuMConfigConsistencyHash = 1
      EcuMNvramReadallTimeout = 1000.0
      EcuMNvramWriteallTimeout = 1000.0
      EcuMRunMinimumDuration = 3000.0
      EcuMSleepActivityPeriod = 1000.0
      EcuMDefaultAppMode = OsAppMode
      EcuMNormalMcuModeRef = McuModeSettingConf
      EcuMDefaultShutdownTarget: EcuMDefaultState=EcuMStateReset, EcuMDefaultSleepModeRef=EcuMSleepMode
      EcuMSleepMode:
        EcuMSleepModeId = 0
        EcuMSleepModeName = SLEEP
        EcuMSleepModeSuspend = false
        EcuMSleepModeMcuModeRef = McuModeSettingConf
        EcuMSleepModeWdgMModeRef = (unset)
        EcuMWakeupSourceMask = ECUM_WKSOURCE_RESET
      4 x EcuMUserConfig:
        ECUM_USER_SELF: EcuMUser=0
        ECUM_COMM_USER_ID: EcuMUser=1
        ECUM_USER_POWER_SUPPLY: EcuMUser=2
        FLASH_USER_ID: EcuMUser=3
      9 x EcuMWakeupSource, all with EcuMResetReason=0, EcuMValidationTimeout=0.0, EcuMWakeupSourcePolling=false:
        ECUM_WKSOURCE_POWER: EcuMWakeupSourceId=1
        ECUM_WKSOURCE_RESET: EcuMWakeupSourceId=2
        ECUM_WKSOURCE_INTERNAL_RESET: EcuMWakeupSourceId=4
        ECUM_WKSOURCE_INTERNAL_WDG: EcuMWakeupSourceId=8
        ECUM_WKSOURCE_EXTERNAL_WDG: EcuMWakeupSourceId=16
        ECUM_WKSOURCE_CAN_0: EcuMWakeupSourceId=32
        ECUM_WKSOURCE_CAN_1: EcuMWakeupSourceId=64
        ECUM_WKSOURCE_CAN_2: EcuMWakeupSourceId=128
        ECUM_WKSOURCE_GPT: EcuMWakeupSourceId=256
      EcuMDriverInitListZero
        Det (EcuMDriverInitItem): EcuMModuleID=Det, EcuMModuleService=Init
      EcuMDriverInitListOne
        4 x EcuMDriverInitItem, all with EcuMModuleService=Init:
          Gpt: EcuMModuleID=Gpt, EcuMModulePBAddr=NULL_PTR
          Port: EcuMModuleID=Port, EcuMModulePBAddr=NULL_PTR
          Spi: EcuMModuleID=Spi
          Adc: EcuMModuleID=Adc, EcuMModulePBAddr=NULL_PTR
      EcuMDriverInitListTwo
        22 x EcuMDriverInitItem:
          EthDrv: EcuMModuleID=Eth, EcuMModuleService=Init, EcuMModulePBAddr=NULL_PTR
          EthController: EcuMModuleID=Stub, EcuMModuleService=Eth_ControllerInit
          SoAd: EcuMModuleInstanciated=false, EcuMModuleID=SoAd, EcuMModuleService=Init
          CanIf: EcuMModuleID=CanIf, EcuMModuleService=Init, EcuMModulePBAddr=NULL_PTR
          CanSM: EcuMModuleID=CanSM, EcuMModuleService=Init
          Com: EcuMModuleID=Com, EcuMModuleService=Init, EcuMModulePBAddr=NULL_PTR
          Stub: EcuMModuleID=Stub, EcuMModuleService=Init
          Adc_Ext_LTC1594: EcuMModuleID=Adc_Ext_LTC1594, EcuMModuleService=Init
          Adc_Verif: EcuMModuleID=Adc_Verif, EcuMModuleService=Init
          CT_InterMcus_Main: EcuMModuleID=CT_InterMcus_Main, EcuMModuleService=Init
          TORInput_Verif: EcuMModuleID=TORInput_Verif, EcuMModuleService=Init
          TOROutput_Verif: EcuMModuleID=TOROutput_Verif, EcuMModuleService=Init
          CT_SD755_Init: EcuMModuleID=sd755, EcuMModuleService=Init
          CT_SD755_Start: EcuMModuleID=sd755, EcuMModuleService=Start
          PowerSupply_Mngt: EcuMModuleID=PowerSupply_Mngt, EcuMModuleService=Init
          CT_Debug: EcuMModuleID=CT_Debug, EcuMModuleService=Init
          AP_Debug: EcuMModuleID=AP_Debug, EcuMModuleService=Init
          Flash_Dv: EcuMModuleID=Flash_Ext_K9HCG08U1M, EcuMModuleService=Init
          Flash_Ext_Ct: EcuMModuleID=Flash_Ext_Ct, EcuMModuleService=Init
          CI_Verif: EcuMModuleID=CI_Verif, EcuMModuleService=Init
          Wdg_Main: EcuMModuleID=Wdg_Main, EcuMModuleService=Init
          Cdd_Common: EcuMModuleID=Cdd_Common_Bsw, EcuMModuleService=Init
    EcuMGeneral:
      EcuMDevErrorDetect = true
      EcuMIncludeDem = false
      EcuMIncludeDet = true
      EcuMIncludeNvramMgr = false
      EcuMIncludeWdgM = false
      EcuMMainFunctionPeriod = 1000.0
      EcuMTTIIEnabled = false
      EcuMVersionInfoApi = true
      EcuMTTIISleepModeRef = EcuMSleepMode
  module config Os_Config: definition=Os, implementation-config-variant=VARIANT-PRE-COMPILE, module-description=Os_Impl
    OsAppMode: OsAppModeId=0
    OsCounterBaseTick (OsCounter): OsCounterMaxAllowedValue=65535, OsCounterMinCycle=1, OsCounterTicksPerBase=1, OsCounterType=HARDWARE
      OsDriver: OsGptChannelRef=GptOsChannel
    OsOS:
      OsScalabilityClass = SC2
      OsStackMonitoring = true
      OsStatus = STANDARD
      OsUseGetServiceId = false
      OsUseParameterAccess = false
      OsUseResScheduler = true
      OsVleInstructionUsed = true
      OsTarget = mpc5568
      OsCore = p1
      OsTickMcuClockRef = McuClockReferencePoint
      OsHooks: OsErrorHook=false, OsPostTaskHook=false, OsPreTaskHook=false, OsProtectionHook=false, OsShutdownHook=false, OsStartupHook=false
    3 x OsTask, all with OsTaskActivation=1, OsTaskSchedule=FULL:
      MainFunction250ms_Task: category=Mngt, OsTaskPriority=5, OsTaskStackSize=6000
      EcuM_StartupTwo_Task: category=EcuM_Init, OsTaskPriority=255, OsTaskStackSize=2048
        OsTaskAutostart: OsTaskAppModeRef=OsAppMode
      MainFunction20ms_Task: category=Mngt, OsTaskPriority=50, OsTaskStackSize=6000
    3 x OsAlarm, all with OsAlarmCounterRef=OsCounterBaseTick:
      EcuM_StartupTwo_Alarm: category=EcuM_Init
        OsAlarmActivateTask: OsAlarmActivateTaskRef=EcuM_StartupTwo_Task
      MainFunction250ms_AlarmCyclic: category=Mngt
        OsAlarmActivateTask: OsAlarmActivateTaskRef=MainFunction250ms_Task
      MainFunction20ms_AlarmCyclic: category=Mngt
        OsAlarmActivateTask: OsAlarmActivateTaskRef=MainFunction20ms_Task
    5 x OsIsr, all with category=OsISRp1, OsIsrPriority=10, OsIsrCore=p1:
      Mcu_LocISR: OsIsrStackSize=512, OsIsrVectorAddress=50, OsIsrCategory=CATEGORY_2
      Mcu_LolISR: OsIsrStackSize=512, OsIsrVectorAddress=51, OsIsrCategory=CATEGORY_2
      Gpt_Channel_0: OsIsrStackSize=1024, OsIsrVectorAddress=58, OsIsrCategory=CATEGORY_2
      Gpt_Channel_1: OsIsrStackSize=1024, OsIsrVectorAddress=59, OsIsrCategory=CATEGORY_2
      function_of_isr_Gpt_Channel_2: OsIsrStackSize=1024, OsIsrVectorAddress=60, OsIsrCategory=CATEGORY_1
    MainFunction1ms_Task (OsTask): category=Mngt, OsTaskActivation=1, OsTaskPriority=100, OsTaskStackSize=6000, OsTaskSchedule=FULL
    MainFunction1ms_AlarmCyclic (OsAlarm): category=Mngt, OsAlarmCounterRef=OsCounterBaseTick
      OsAlarmActivateTask: OsAlarmActivateTaskRef=MainFunction1ms_Task
    7 x OsIsr, all with OsIsrPriority=10:
      Eth_RxIrqHdlr_0: category=OsISRp0_CustomerTask, OsIsrVectorAddress=299, OsIsrCategory=CATEGORY_1, OsIsrStackSize=4000, OsIsrCore=p0
      Eth_TxIrqHdlr_0: category=OsISRp0_CustomerTask, OsIsrVectorAddress=298, OsIsrCategory=CATEGORY_1, OsIsrStackSize=4000, OsIsrCore=p0
      function_of_isr_Dspi_IsrRxPio_DSPI_A: category=OsISRp1, OsIsrStackSize=1024, OsIsrVectorAddress=118, OsIsrCategory=CATEGORY_1, OsIsrCore=p1
      function_of_isr_Dspi_IsrRxPio_DSPI_B: category=OsISRp1, OsIsrStackSize=4000, OsIsrVectorAddress=123, OsIsrCategory=CATEGORY_1, OsIsrCore=p1
      function_of_isr_Dspi_IsrRxPio_DSPI_C: category=OsISRp1, OsIsrStackSize=1024, OsIsrVectorAddress=278, OsIsrCategory=CATEGORY_1, OsIsrCore=p1
      function_of_isr_Dspi_IsrRxPio_DSPI_D: category=OsISRp1, OsIsrStackSize=1024, OsIsrVectorAddress=280, OsIsrCategory=CATEGORY_1, OsIsrCore=p1
      Adc_EndGroupConvUnit0: category=OsISRp1, OsIsrStackSize=1024, OsIsrVectorAddress=82, OsIsrCategory=CATEGORY_2, OsIsrCore=p1
    AppliBackGround_Task (OsTask): category=Mngt, OsTaskActivation=1, OsTaskPriority=2, OsTaskStackSize=6000, OsTaskSchedule=FULL
    AppliBackGround_AlarmCyclic (OsAlarm): category=Mngt, OsAlarmCounterRef=OsCounterBaseTick
      OsAlarmActivateTask: OsAlarmActivateTaskRef=AppliBackGround_Task
    function_of_isr_Icu_Ext_Irq_4_15 (OsIsr): category=OsISRp1, OsIsrPriority=10, OsIsrStackSize=1024, OsIsrVectorAddress=57, OsIsrCategory=CATEGORY_1, OsIsrCore=p1
    MainFunction10ms_Task (OsTask): category=Mngt, OsTaskActivation=1, OsTaskPriority=90, OsTaskStackSize=6000, OsTaskSchedule=FULL
    MainFunction10ms_AlarmCyclic (OsAlarm): category=Mngt, OsAlarmCounterRef=OsCounterBaseTick
      OsAlarmActivateTask: OsAlarmActivateTaskRef=MainFunction10ms_Task
    MainFunction50ms_Task (OsTask): category=Mngt, OsTaskActivation=1, OsTaskPriority=80, OsTaskStackSize=6000, OsTaskSchedule=FULL
    MainFunction50ms_AlarmCyclic (OsAlarm): category=Mngt, OsAlarmCounterRef=OsCounterBaseTick
      OsAlarmActivateTask: OsAlarmActivateTaskRef=MainFunction50ms_Task
    function_of_isr_Task1ms (OsIsr): category=OsISRp0_CustomerTask, OsIsrPriority=4, OsIsrCore=p0, OsIsrVectorAddress=7, OsIsrCategory=CATEGORY_1
    MainFunction_TrigTask1ms (OsTask): category=Mngt, OsTaskActivation=1, OsTaskPriority=150, OsTaskStackSize=1000, OsTaskSchedule=FULL
    MainFunction_TrigTask1ms_AlarmCyclic (OsAlarm): category=Mngt, OsAlarmCounterRef=OsCounterBaseTick
      OsAlarmActivateTask: OsAlarmActivateTaskRef=MainFunction_TrigTask1ms
    function_of_isr_Task20ms (OsIsr): category=OsISRp0_CustomerTask, OsIsrPriority=3, OsIsrCore=p0, OsIsrVectorAddress=6, OsIsrCategory=CATEGORY_1
    MainFunction_TrigTask20ms (OsTask): category=Mngt, OsTaskActivation=1, OsTaskPriority=149, OsTaskStackSize=1000, OsTaskSchedule=FULL
    MainFunction_TrigTask20ms_AlarmCyclic (OsAlarm): category=Mngt, OsAlarmCounterRef=OsCounterBaseTick
      OsAlarmActivateTask: OsAlarmActivateTaskRef=MainFunction_TrigTask20ms
    function_of_isr_Task100ms (OsIsr): category=OsISRp0_CustomerTask, OsIsrPriority=2, OsIsrCore=p0, OsIsrVectorAddress=5, OsIsrCategory=CATEGORY_1
    MainFunction_TrigTask100ms (OsTask): category=Mngt, OsTaskActivation=1, OsTaskPriority=148, OsTaskStackSize=1000, OsTaskSchedule=FULL
    MainFunction_TrigTask100ms_AlarmCyclic (OsAlarm): category=Mngt, OsAlarmCounterRef=OsCounterBaseTick
      OsAlarmActivateTask: OsAlarmActivateTaskRef=MainFunction_TrigTask100ms
    function_of_isr_Task250ms (OsIsr): category=OsISRp0_CustomerTask, OsIsrPriority=1, OsIsrCore=p0, OsIsrVectorAddress=4, OsIsrCategory=CATEGORY_1
    MainFunction_TrigTask250ms (OsTask): category=Mngt, OsTaskActivation=1, OsTaskPriority=147, OsTaskStackSize=1000, OsTaskSchedule=FULL
    MainFunction_TrigTask250ms_AlarmCyclic (OsAlarm): category=Mngt, OsAlarmCounterRef=OsCounterBaseTick
      OsAlarmActivateTask: OsAlarmActivateTaskRef=MainFunction_TrigTask250ms
    45 x OsIsr, all with category=OsISRp1, OsIsrPriority=10, OsIsrStackSize=1200, OsIsrCategory=CATEGORY_1, OsIsrCore=p1:
      Can_Isr_FCA_MOB_00: OsIsrVectorAddress=130
      Can_Isr_FCA_MOB_01: OsIsrVectorAddress=131
      Can_Isr_FCA_MOB_02: OsIsrVectorAddress=132
      Can_Isr_FCA_MOB_03: OsIsrVectorAddress=133
      Can_Isr_FCA_MOB_04: OsIsrVectorAddress=134
      Can_Isr_FCA_MOB_05: OsIsrVectorAddress=135
      Can_Isr_FCA_MOB_06: OsIsrVectorAddress=136
      Can_Isr_FCA_MOB_07: OsIsrVectorAddress=137
      Can_Isr_FCA_MOB_08: OsIsrVectorAddress=138
      Can_Isr_FCA_MOB_09: OsIsrVectorAddress=139
      Can_Isr_FCA_MOB_10: OsIsrVectorAddress=140
      Can_Isr_FCB_MOB_00: OsIsrVectorAddress=160
      Can_Isr_FCB_MOB_01: OsIsrVectorAddress=161
      Can_Isr_FCB_MOB_02: OsIsrVectorAddress=162
      Can_Isr_FCB_MOB_03: OsIsrVectorAddress=163
      Can_Isr_FCB_MOB_04: OsIsrVectorAddress=164
      Can_Isr_FCB_MOB_05: OsIsrVectorAddress=165
      Can_Isr_FCB_MOB_06: OsIsrVectorAddress=166
      Can_Isr_FCB_MOB_07: OsIsrVectorAddress=167
      Can_Isr_FCB_MOB_08: OsIsrVectorAddress=168
      Can_Isr_FCB_MOB_09: OsIsrVectorAddress=169
      Can_Isr_FCB_MOB_10: OsIsrVectorAddress=170
      Can_Isr_FCB_MOB_11: OsIsrVectorAddress=171
      Can_Isr_FCB_MOB_12: OsIsrVectorAddress=172
      Can_Isr_FCC_MOB_00: OsIsrVectorAddress=181
      Can_Isr_FCC_MOB_01: OsIsrVectorAddress=182
      Can_Isr_FCC_MOB_02: OsIsrVectorAddress=183
      Can_Isr_FCC_MOB_03: OsIsrVectorAddress=184
      Can_Isr_FCC_MOB_04: OsIsrVectorAddress=185
      Can_Isr_FCC_MOB_05: OsIsrVectorAddress=186
      Can_Isr_FCC_MOB_06: OsIsrVectorAddress=187
      Can_Isr_FCC_MOB_07: OsIsrVectorAddress=188
      Can_Isr_FCC_MOB_08: OsIsrVectorAddress=189
      Can_Isr_FCC_MOB_09: OsIsrVectorAddress=190
      Can_Isr_FCC_MOB_10: OsIsrVectorAddress=191
      Can_Isr_FCC_MOB_11: OsIsrVectorAddress=192
      Can_Isr_FCC_MOB_12: OsIsrVectorAddress=193
      Can_Isr_FCC_MOB_13: OsIsrVectorAddress=194
      Can_Isr_FCC_MOB_14: OsIsrVectorAddress=195
      Can_Isr_FCC_MOB_15: OsIsrVectorAddress=196
      Can_Isr_FCC_MOB_16_31: OsIsrVectorAddress=197
      Can_Isr_FCC_MOB_32_63: OsIsrVectorAddress=198
      Can_Isr_FCA_BUS_OFF: OsIsrVectorAddress=127
      Can_Isr_FCB_BUS_OFF: OsIsrVectorAddress=157
      Can_Isr_FCC_BUS_OFF: OsIsrVectorAddress=178
    16 x OsHardRessource, all with category=OsHardRessource:
      OsHardRessource{0..15}: OsHardRessourceId={0..15}
  module config Schm_Config: definition=SchM, implementation-config-variant=VARIANT-PRE-COMPILE, module-description=SchM_Implementation
    SchMGeneral: SchMDevErrorDetect=true, SchMVersionInfoApi=true, SchMOsHookRef=(unset)
    3 x SchMModuleConfiguration, all with ActivationPointImplementation=Static, CancelationPointImplementation=Static:
      SchMGptConfiguration: category=MCALS, SchMModuleLiteral=Gpt, ExclusiveAreaImplementation=Static_Macro
        InstanceConfiguration: SchMInstanceId=0, SchMInstanceLiteral=SCHM_GPT_INSTANCE_0
          GPT_EXCLUSIVE_AREA_0 (ExclusiveAreaConf): SchMExclusiveAreaType=GetHardRessource, SchMExclusiveAreaId=0, SchMExclusiveAreaLiteral=GPT_EXCLUSIVE_AREA_0, SchMOsHardRessource=OsHardRessource9
        InstanceConfiguration2 (InstanceConfiguration): SchMInstanceId=1, SchMInstanceLiteral=SCHM_GPT_STUB_INSTANCE, SchMOsHardRessource=OsHardRessource10
      SchMEcuMConfiguration: category=OtherBSW, SchMModuleLiteral=EcuM, ExclusiveAreaImplementation=Static
        InstanceConfiguration: SchMInstanceId=0, SchMInstanceLiteral=EcuM_0
          ActivationPoint_EcuMNvMJobEnd (ActivationPointConf): SchMActivationId=0, SchMActivationLiteral=ACTIVATION_POINT_NVM_JOBEND, SporadicEventConfRef=SporadicEvent_EcuM_ImmediateTask
          SporadicEvent_EcuM_ImmediateTask (SporadicEventConf): SchMEventActivationType=Task, DelayTime=0.0, SchMSporadicLiteral=EcuM_Immediate, SchMRelatedAlarmOrTaskRef=MainFunction250ms_Task
      SchMStubConfiguration: category=Stub, SchMModuleLiteral=Stub, ExclusiveAreaImplementation=Static
        InstanceConfiguration: SchMInstanceId=0, SchMInstanceLiteral=Stub_Intance
    3 x SchMMainFunctionMapping, all with category=MainFunction, SchMMainFunctionRef=(unset):
      EcuM_StartupTwoMapping_MainFunction: SchMMainFunction=EcuM_StartupTwo, SchMPositionInTask=0, SchMMappedToTask=EcuM_StartupTwo_Task
      EcuM_MainFunction: SchMMainFunction=EcuM_MainFunction, SchMMainFunctionPeriod=250, SchMMainFunctionOffset=78, SchMPositionInTask=0, SchMOsAlarmRef=MainFunction250ms_AlarmCyclic, SchMMappedToTask=MainFunction250ms_Task
      PowerSupply_Mngt_MainFunction: SchMMainFunction=PowerSupply_Mngt_MainFunction, SchMMainFunctionPeriod=250, SchMMainFunctionOffset=78, SchMPositionInTask=3, SchMOsAlarmRef=MainFunction250ms_AlarmCyclic, SchMMappedToTask=MainFunction250ms_Task
    3 x SchMModuleConfiguration, all with category=ComStack, ActivationPointImplementation=Static, CancelationPointImplementation=Static:
      SchMPduRConfiguration: SchMModuleLiteral=PduR, ExclusiveAreaImplementation=Static_Macro
        InstanceConfiguration: SchMInstanceId=0, SchMInstanceLiteral=SCHM_PDUR_INSTANCE
          ExclusiveAreaConf:
            SchMExclusiveAreaType = GetHardRessource
            SchMExclusiveAreaId = 0
            SchMExclusiveAreaLiteral = PDUR_BUFFER_EXCLUSIVE_AREA
            SchMOsHardRessource = OsHardRessource0
      SchMComConfiguration: SchMModuleLiteral=Com, ExclusiveAreaImplementation=Static_Macro
        InstanceConfiguration: SchMInstanceId=0, SchMInstanceLiteral=SCHM_COM_INSTANCE
          7 x ExclusiveAreaConf, all with SchMExclusiveAreaType=GetHardRessource:
            ExclusiveAreaConf: SchMExclusiveAreaId=0, SchMExclusiveAreaLiteral=COM_TX_TIMER_LISTS_AREA, SchMOsHardRessource=OsHardRessource1
            ExclusiveAreaConf1: SchMExclusiveAreaId=1, SchMExclusiveAreaLiteral=COM_RX_IPDU_TIMER_LIST_AREA, SchMOsHardRessource=OsHardRessource2
            ExclusiveAreaConf2: SchMExclusiveAreaId=2, SchMExclusiveAreaLiteral=COM_TX_CONFIRMATION_LIST_AREA, SchMOsHardRessource=OsHardRessource3
            ExclusiveAreaConf3: SchMExclusiveAreaId=3, SchMExclusiveAreaLiteral=COM_TX_IPDU_AREA, SchMOsHardRessource=OsHardRessource4
            ExclusiveAreaConf4: SchMExclusiveAreaId=4, SchMExclusiveAreaLiteral=COM_RX_DATA_AREA, SchMOsHardRessource=OsHardRessource5
            ExclusiveAreaConf5: SchMExclusiveAreaId=5, SchMExclusiveAreaLiteral=COM_RX_IPDU_LIST_AREA, SchMOsHardRessource=OsHardRessource6
            ExclusiveAreaConf6: SchMExclusiveAreaId=6, SchMExclusiveAreaLiteral=COM_RX_IPDU_AREA, SchMOsHardRessource=OsHardRessource7
      SchMCanIfConfiguration: SchMModuleLiteral=CanIf, ExclusiveAreaImplementation=Dynamic
        InstanceConfiguration: SchMInstanceId=0, SchMInstanceLiteral=CANIF_INSTANCE_0
          62 x ExclusiveAreaConf, all with SchMExclusiveAreaType=GetHardRessource:
            ExclusiveAreaConf0: SchMExclusiveAreaId=0, SchMExclusiveAreaLiteral=CANIF_MUTEX_TRANSMITBUFFER, SchMOsHardRessource=OsHardRessource12
            ExclusiveAreaConf{1..33}: SchMExclusiveAreaId={1..33}, SchMExclusiveAreaLiteral=CANIF_MUTEX_TRANSMITBUFFER_HTH{1..33}, SchMOsHardRessource=OsHardRessource12
            ExclusiveAreaConf34: SchMExclusiveAreaId=34, SchMExclusiveAreaLiteral=CANIF_MUTEX_RECEIVEBUFFER, SchMOsHardRessource=OsHardRessource13
            ExclusiveAreaConf35: SchMExclusiveAreaId=35, SchMExclusiveAreaLiteral=CANIF_MUTEX_RECEIVEBUFFER_HRH1, SchMOsHardRessource=OsHardRessource13
            ExclusiveAreaConf36: SchMExclusiveAreaId=36, SchMExclusiveAreaLiteral=CANIF_MUTEX_RECEIVEBUFFER_HRH2, SchMOsHardRessource=OsHardRessource13
            ExclusiveAreaConf37: SchMExclusiveAreaId=37, SchMExclusiveAreaLiteral=CANIF_MUTEX_RECEIVEBUFFER_HRH3, SchMOsHardRessource=OsHardRessource13
            ExclusiveAreaConf38: SchMExclusiveAreaId=38, SchMExclusiveAreaLiteral=CANIF_MUTEX_RECEIVEBUFFER_HRH4, SchMOsHardRessource=OsHardRessource13
            ExclusiveAreaConf39: SchMExclusiveAreaId=39, SchMExclusiveAreaLiteral=CANIF_MUTEX_RECEIVEBUFFER_HRH5, SchMOsHardRessource=OsHardRessource13
            ExclusiveAreaConf40: SchMExclusiveAreaId=40, SchMExclusiveAreaLiteral=CANIF_MUTEX_RECEIVEBUFFER_HRH6, SchMOsHardRessource=OsHardRessource13
            ExclusiveAreaConf41: SchMExclusiveAreaId=41, SchMExclusiveAreaLiteral=CANIF_MUTEX_RECEIVEBUFFER_HRH7, SchMOsHardRessource=OsHardRessource13
            ExclusiveAreaConf42: SchMExclusiveAreaId=42, SchMExclusiveAreaLiteral=CANIF_MUTEX_RECEIVEBUFFER_HRH8, SchMOsHardRessource=OsHardRessource13
            ExclusiveAreaConf43: SchMExclusiveAreaId=43, SchMExclusiveAreaLiteral=CANIF_MUTEX_RECEIVEBUFFER_HRH9, SchMOsHardRessource=OsHardRessource13
            ExclusiveAreaConf44: SchMExclusiveAreaId=44, SchMExclusiveAreaLiteral=CANIF_MUTEX_RECEIVEBUFFER_HRH10, SchMOsHardRessource=OsHardRessource13
            ExclusiveAreaConf45: SchMExclusiveAreaId=45, SchMExclusiveAreaLiteral=CANIF_MUTEX_RECEIVEBUFFER_HRH11, SchMOsHardRessource=OsHardRessource13
            ExclusiveAreaConf46: SchMExclusiveAreaId=46, SchMExclusiveAreaLiteral=CANIF_MUTEX_RECEIVEBUFFER_HRH12, SchMOsHardRessource=OsHardRessource13
            ExclusiveAreaConf47: SchMExclusiveAreaId=47, SchMExclusiveAreaLiteral=CANIF_MUTEX_RECEIVEBUFFER_HRH13, SchMOsHardRessource=OsHardRessource13
            ExclusiveAreaConf48: SchMExclusiveAreaId=48, SchMExclusiveAreaLiteral=CANIF_MUTEX_RECEIVEBUFFER_HRH14, SchMOsHardRessource=OsHardRessource13
            ExclusiveAreaConf49: SchMExclusiveAreaId=49, SchMExclusiveAreaLiteral=CANIF_MUTEX_RECEIVEBUFFER_HRH15, SchMOsHardRessource=OsHardRessource13
            ExclusiveAreaConf50: SchMExclusiveAreaId=50, SchMExclusiveAreaLiteral=CANIF_MUTEX_RECEIVEBUFFER_HRH16, SchMOsHardRessource=OsHardRessource13
            ExclusiveAreaConf51: SchMExclusiveAreaId=51, SchMExclusiveAreaLiteral=CANIF_MUTEX_RECEIVEBUFFER_HRH17, SchMOsHardRessource=OsHardRessource13
            ExclusiveAreaConf52: SchMExclusiveAreaId=52, SchMExclusiveAreaLiteral=CANIF_MUTEX_RECEIVEBUFFER_HRH18, SchMOsHardRessource=OsHardRessource13
            ExclusiveAreaConf53: SchMExclusiveAreaId=53, SchMExclusiveAreaLiteral=CANIF_MUTEX_RECEIVEBUFFER_HRH19, SchMOsHardRessource=OsHardRessource13
            ExclusiveAreaConf54: SchMExclusiveAreaId=54, SchMExclusiveAreaLiteral=CANIF_MUTEX_RECEIVEBUFFER_HRH20, SchMOsHardRessource=OsHardRessource13
            ExclusiveAreaConf55: SchMExclusiveAreaId=55, SchMExclusiveAreaLiteral=CANIF_MUTEX_RECEIVEBUFFER_HRH21, SchMOsHardRessource=OsHardRessource13
            ExclusiveAreaConf56: SchMExclusiveAreaId=56, SchMExclusiveAreaLiteral=CANIF_MUTEX_RECEIVEBUFFER_HRH22, SchMOsHardRessource=OsHardRessource13
            ExclusiveAreaConf57: SchMExclusiveAreaId=57, SchMExclusiveAreaLiteral=CANIF_MUTEX_RECEIVEBUFFER_HRH23, SchMOsHardRessource=OsHardRessource13
            ExclusiveAreaConf58: SchMExclusiveAreaId=58, SchMExclusiveAreaLiteral=CANIF_MUTEX_RECEIVEBUFFER_HRH24, SchMOsHardRessource=OsHardRessource13
            ExclusiveAreaConf59: SchMExclusiveAreaId=59, SchMExclusiveAreaLiteral=CANIF_MUTEX_RECEIVEBUFFER_HRH25, SchMOsHardRessource=OsHardRessource13
            ExclusiveAreaConf60: SchMExclusiveAreaId=60, SchMExclusiveAreaLiteral=CANIF_MUTEX_RECEIVEBUFFER_HRH26, SchMOsHardRessource=OsHardRessource13
            ExclusiveAreaConf61: SchMExclusiveAreaId=61, SchMExclusiveAreaLiteral=CANIF_MUTEX_RECEIVEBUFFER_HRH27, SchMOsHardRessource=OsHardRessource13
    3 x SchMMainFunctionMapping, all with category=MainFunction, SchMMainFunctionPeriod=1, SchMMainFunctionOffset=10, SchMMainFunctionRef=(unset), SchMOsAlarmRef=MainFunction1ms_AlarmCyclic, SchMMappedToTask=MainFunction1ms_Task:
      Com_Rx_MainFunction: SchMMainFunction=Com_MainFunctionRx, SchMPositionInTask=0
      Com_Tx_MainFunction: SchMMainFunction=Com_MainFunctionTx, SchMPositionInTask=1
      AP_Debug_MainFunction: SchMMainFunction=AP_Debug_MainFunction, SchMPositionInTask=2
    5 x SchMModuleConfiguration, all with ActivationPointImplementation=Static, CancelationPointImplementation=Static:
      SchMCanSMConfiguration: category=ComStack, SchMModuleLiteral=CanSM, ExclusiveAreaImplementation=Dynamic
        InstanceConfiguration: SchMInstanceId=0, SchMInstanceLiteral=CANSM_INSTANCE_0
          ExclusiveAreaConf:
            SchMExclusiveAreaType = GetHardRessource
            SchMExclusiveAreaId = 0
            SchMExclusiveAreaLiteral = CANSM_EX_AREA_CHANNEL_0
            SchMOsHardRessource = OsHardRessource8
      Adc_Verif_Module: category=Cdd, SchMModuleLiteral=Adc_Verif, ExclusiveAreaImplementation=Static
        InstanceConfiguration: SchMInstanceId=0, SchMInstanceLiteral=Adc_Verif_Instance
      Cdd_Common_Module: category=Cdd, SchMModuleLiteral=Cdd_Common_Bsw, ExclusiveAreaImplementation=Static
        InstanceConfiguration: SchMInstanceId=0, SchMInstanceLiteral=Cdd_Common_Instance
      TORInput_Verif_Module: category=Cdd, SchMModuleLiteral=TORInput_Verif, ExclusiveAreaImplementation=Static
        InstanceConfiguration: SchMInstanceId=0, SchMInstanceLiteral=TORInput_Verif_Instance
      TOROutput_Verif_Module: category=Cdd, SchMModuleLiteral=TOROutput_Verif, ExclusiveAreaImplementation=Static
        InstanceConfiguration: SchMInstanceId=0, SchMInstanceLiteral=TOROutput_Verif_Instance
    CT_SD755_MainFunction (SchMMainFunctionMapping):
      category = MainFunction
      SchMMainFunction = sd755_Mngt
      SchMMainFunctionPeriod = 1
      SchMMainFunctionOffset = 10
      SchMPositionInTask = 3
      SchMMainFunctionRef = (unset)
      SchMOsAlarmRef = MainFunction1ms_AlarmCyclic
      SchMMappedToTask = MainFunction1ms_Task
    3 x SchMModuleConfiguration, all with ActivationPointImplementation=Static, CancelationPointImplementation=Static:
      CT_SD755_Module: category=Cdd, SchMModuleLiteral=sd755, ExclusiveAreaImplementation=Static
        InstanceConfiguration: SchMInstanceId=0, SchMInstanceLiteral=CT_SD755_Instance
      AP_Debug_Module: category=Cdd, SchMModuleLiteral=AP_Debug, ExclusiveAreaImplementation=Static
        InstanceConfiguration: SchMInstanceId=0, SchMInstanceLiteral=AP_Debug_Instance
      SchMAdcConfiguration: category=MCALS, SchMModuleLiteral=Adc, ExclusiveAreaImplementation=Static_Macro
        InstanceConfiguration: SchMInstanceId=0, SchMInstanceLiteral=SCHM_ADC_INSTANCE_0
          ADC_EXCLUSIVE_AREA_0 (ExclusiveAreaConf):
            SchMExclusiveAreaType = GetHardRessource
            SchMExclusiveAreaId = 0
            SchMExclusiveAreaLiteral = ADC_EXCLUSIVE_AREA_0
            SchMOsHardRessource = OsHardRessource11
        InstanceConfiguration2 (InstanceConfiguration): SchMInstanceId=1, SchMInstanceLiteral=SCHM_ADC_INSTANCE_1_NOT_USED
    3 x SchMMainFunctionMapping, all with category=MainFunction, SchMMainFunctionPeriod=1, SchMMainFunctionOffset=10, SchMMainFunctionRef=(unset), SchMOsAlarmRef=MainFunction1ms_AlarmCyclic, SchMMappedToTask=MainFunction1ms_Task:
      Stub_MainFunction: SchMMainFunction=Stub_MainFunction, SchMPositionInTask=4
      CI_Verif_MainFunction: SchMMainFunction=CI_Verif_MainFunction, SchMPositionInTask=5
      Wdg_Main_MainFunction: SchMMainFunction=Wdg_Main_MainFunction, SchMPositionInTask=6
    4 x SchMModuleConfiguration, all with ActivationPointImplementation=Static, CancelationPointImplementation=Static, ExclusiveAreaImplementation=Static:
      Wdg_Configuration: category=OtherBSW, SchMModuleLiteral=Wdg
        InstanceConfiguration: SchMInstanceId=0, SchMInstanceLiteral=Wdg_0
      PowerSupply_Mngt_Module: category=Cdd, SchMModuleLiteral=PowerSupply_Mngt
        InstanceConfiguration: SchMInstanceId=0, SchMInstanceLiteral=PowerSupply_Mngt_Instance
      Flash_Ext_Ct_Module: category=Cdd, SchMModuleLiteral=Flash_Ext_Ct
        InstanceConfiguration: SchMInstanceId=0, SchMInstanceLiteral=Flash_Ext_Ct_Instance
      CI_Verif_Module: category=Cdd, SchMModuleLiteral=CI_Verif
        InstanceConfiguration: SchMInstanceId=0, SchMInstanceLiteral=CI_Verif_Instance
    5 x SchMMainFunctionMapping, all with category=MainFunction, SchMMainFunctionPeriod=1, SchMMainFunctionOffset=18, SchMMainFunctionRef=(unset), SchMOsAlarmRef=AppliBackGround_AlarmCyclic, SchMMappedToTask=AppliBackGround_Task:
      Cdd_Common_Appli_MainFunction: SchMMainFunction=Cdd_Common_Appli_MainFunction, SchMPositionInTask=0
      Flash_Ext_Ct_ReadMngt: SchMMainFunction=Flash_Ext_Ct_ReadMngt, SchMPositionInTask=1
      Flash_Ext_Ct_WriteMngt: SchMMainFunction=Flash_Ext_Ct_WriteMngt, SchMPositionInTask=2
      Flash_Ext_Ct_EraseMngt: SchMMainFunction=Flash_Ext_Ct_EraseMngt, SchMPositionInTask=3
      Flash_Ext_Ct_PowerOffMngt: SchMMainFunction=Flash_Ext_Ct_PowerOffMngt, SchMPositionInTask=4
    Wdg_Main_Module (SchMModuleConfiguration):
      category = Cdd
      ActivationPointImplementation = Static
      SchMModuleLiteral = Wdg_Main
      CancelationPointImplementation = Static
      ExclusiveAreaImplementation = Static
      InstanceConfiguration: SchMInstanceId=0, SchMInstanceLiteral=Wdg_Main_Instance
    CT_InterMcus_Main_Module (SchMModuleConfiguration):
      category = Cdd
      ActivationPointImplementation = Static
      SchMModuleLiteral = CT_InterMcus_Main
      CancelationPointImplementation = Static
      ExclusiveAreaImplementation = Static
      InstanceConfiguration: SchMInstanceId=0, SchMInstanceLiteral=Adc_Verif_Instance
    10 x SchMMainFunctionMapping, all with SchMMainFunctionRef=(unset):
      Adc_Verif_MainFunction: category=MainFunction, SchMMainFunction=Adc_Verif_MainFunction, SchMMainFunctionPeriod=10, SchMMainFunctionOffset=12, SchMPositionInTask=0, SchMOsAlarmRef=MainFunction10ms_AlarmCyclic, SchMMappedToTask=MainFunction10ms_Task
      CT_InterMcus_Main_MainFunction: category=MainFunction, SchMMainFunction=CT_InterMcus_Main_MainFunction, SchMMainFunctionPeriod=10, SchMMainFunctionOffset=12, SchMPositionInTask=1, SchMOsAlarmRef=MainFunction10ms_AlarmCyclic, SchMMappedToTask=MainFunction10ms_Task
      TORInput_Verif_MainFunction: category=MainFunction, SchMMainFunction=TORInput_Verif_MainFunction, SchMMainFunctionPeriod=50, SchMMainFunctionOffset=16, SchMPositionInTask=0, SchMOsAlarmRef=MainFunction50ms_AlarmCyclic, SchMMappedToTask=MainFunction50ms_Task
      TOROutput_Verif_MainFunction: category=MainFunction, SchMMainFunction=TOROutput_Verif_MainFunction, SchMMainFunctionPeriod=50, SchMMainFunctionOffset=16, SchMPositionInTask=1, SchMOsAlarmRef=MainFunction50ms_AlarmCyclic, SchMMappedToTask=MainFunction50ms_Task
      Cdd_Common_MainFunction: category=MainFunction, SchMMainFunction=Cdd_Common_MainFunction, SchMMainFunctionPeriod=20, SchMMainFunctionOffset=14, SchMPositionInTask=0, SchMOsAlarmRef=MainFunction20ms_AlarmCyclic, SchMMappedToTask=MainFunction20ms_Task
      CanSM_MainFunction: category=MainFunction, SchMMainFunction=CanSM_MainFunction, SchMMainFunctionPeriod=20, SchMMainFunctionOffset=14, SchMPositionInTask=1, SchMOsAlarmRef=MainFunction20ms_AlarmCyclic, SchMMappedToTask=MainFunction20ms_Task
      TrigTask1ms: category=MainFunction_ForTrigTasskLumeneo, SchMMainFunction=TrigTask1ms, SchMMainFunctionPeriod=1, SchMMainFunctionOffset=100, SchMPositionInTask=0, SchMOsAlarmRef=MainFunction_TrigTask1ms_AlarmCyclic, SchMMappedToTask=MainFunction_TrigTask1ms
      TrigTask20ms: category=MainFunction_ForTrigTasskLumeneo, SchMMainFunction=TrigTask20ms, SchMMainFunctionPeriod=20, SchMMainFunctionOffset=101, SchMPositionInTask=0, SchMOsAlarmRef=MainFunction_TrigTask20ms_AlarmCyclic, SchMMappedToTask=MainFunction_TrigTask20ms
      TrigTask100ms: category=MainFunction_ForTrigTasskLumeneo, SchMMainFunction=TrigTask100ms, SchMMainFunctionPeriod=100, SchMMainFunctionOffset=105, SchMPositionInTask=0, SchMOsAlarmRef=MainFunction_TrigTask100ms_AlarmCyclic, SchMMappedToTask=MainFunction_TrigTask100ms
      TrigTask250ms: category=MainFunction_ForTrigTasskLumeneo, SchMMainFunction=TrigTask250ms, SchMMainFunctionPeriod=250, SchMMainFunctionOffset=108, SchMPositionInTask=0, SchMOsAlarmRef=MainFunction_TrigTask250ms_AlarmCyclic, SchMMappedToTask=MainFunction_TrigTask250ms
  module config Can_Config: definition=Can, implementation-config-variant=VARIANT-PRE-COMPILE, module-description=Can_Impl
    CanConfigSet
      3 x CanController, all with CanBusoffProcessing=Polling, CanControllerActivation=true, CanControllerPropSeg=1, CanControllerSeg1=1, CanControllerSeg2=2, CanControllerTimeQuanta=(unset), CanRxProcessing=Interrupt, CanTxProcessing=Interrupt, CanWakeupProcessing=Polling, CanCpuClockRef=McuClockReferencePoint, CanWakeupSourceRef=ECUM_WKSOURCE_CAN_0:
        CanController_A_Tilt: CanControllerBaudRate=500000, CanControllerId=0
          CanFilterMask: CanFilterMaskValue=3
        CanController_B_Chassis: CanControllerBaudRate=250000, CanControllerId=1
          CanFilterMask: CanFilterMaskValue=3
        CanController_C_Confort: CanControllerBaudRate=250000, CanControllerId=2
          CanFilterMask: CanFilterMaskValue=3
      62 x CanHardwareObject, all with CanHandleType=BASIC, CanFilterMaskRef=(unset):
        CanHwObj_Hrh_0_Tilt_581: CanIdType=STANDARD, CanIdValue=1409, CanObjectId=0, CanObjectType=RECEIVE, CanControllerRef=CanController_A_Tilt
        CanHwObj_Hrh_1_Tilt_181: CanIdType=STANDARD, CanIdValue=385, CanObjectId=1, CanObjectType=RECEIVE, CanControllerRef=CanController_A_Tilt
        CanHwObj_Hrh_2_Tilt_281: CanIdType=STANDARD, CanIdValue=641, CanObjectId=2, CanObjectType=RECEIVE, CanControllerRef=CanController_A_Tilt
        CanHwObj_Hrh_3_Tilt_381: CanIdType=STANDARD, CanIdValue=897, CanObjectId=3, CanObjectType=RECEIVE, CanControllerRef=CanController_A_Tilt
        CanHwObj_Hrh_4_Chassis_190: CanIdType=STANDARD, CanIdValue=400, CanObjectId=4, CanObjectType=RECEIVE, CanControllerRef=CanController_B_Chassis
        CanHwObj_Hrh_5_Chassis_290: CanIdType=STANDARD, CanIdValue=656, CanObjectId=5, CanObjectType=RECEIVE, CanControllerRef=CanController_B_Chassis
        CanHwObj_Hrh_6_Chassis_390: CanIdType=STANDARD, CanIdValue=912, CanObjectId=6, CanObjectType=RECEIVE, CanControllerRef=CanController_B_Chassis
        CanHwObj_Hrh_7_Chassis_490: CanIdType=STANDARD, CanIdValue=1168, CanObjectId=7, CanObjectType=RECEIVE, CanControllerRef=CanController_B_Chassis
        CanHwObj_Hrh_8_Chassis_193: CanIdType=STANDARD, CanIdValue=403, CanObjectId=8, CanObjectType=RECEIVE, CanControllerRef=CanController_B_Chassis
        CanHwObj_Hrh_9_Chassis_293: CanIdType=STANDARD, CanIdValue=659, CanObjectId=9, CanObjectType=RECEIVE, CanControllerRef=CanController_B_Chassis
        CanHwObj_Hrh_10_Chassis_393: CanIdType=STANDARD, CanIdValue=915, CanObjectId=10, CanObjectType=RECEIVE, CanControllerRef=CanController_B_Chassis
        CanHwObj_Hrh_11_Chassis_493: CanIdType=STANDARD, CanIdValue=1171, CanObjectId=11, CanObjectType=RECEIVE, CanControllerRef=CanController_B_Chassis
        CanHwObj_Hrh_12_Tilt_305: CanIdType=STANDARD, CanIdValue=773, CanObjectId=12, CanObjectType=RECEIVE, CanControllerRef=CanController_A_Tilt
        CanHwObj_Hrh_13_Confort_506: CanIdType=STANDARD, CanIdValue=1286, CanObjectId=13, CanObjectType=RECEIVE, CanControllerRef=CanController_C_Confort
        CanHwObj_Hrh_14_Confort_101: CanIdType=STANDARD, CanIdValue=257, CanObjectId=14, CanObjectType=RECEIVE, CanControllerRef=CanController_C_Confort
        CanHwObj_Hrh_15_Confort_102: CanIdType=STANDARD, CanIdValue=258, CanObjectId=15, CanObjectType=RECEIVE, CanControllerRef=CanController_C_Confort
        CanHwObj_Hrh_16_Confort_103: CanIdType=STANDARD, CanIdValue=259, CanObjectId=16, CanObjectType=RECEIVE, CanControllerRef=CanController_C_Confort
        CanHwObj_Hrh_17_Confort_110: CanIdType=STANDARD, CanIdValue=272, CanObjectId=17, CanObjectType=RECEIVE, CanControllerRef=CanController_C_Confort
        CanHwObj_Hrh_18_Confort_201: CanIdType=STANDARD, CanIdValue=513, CanObjectId=18, CanObjectType=RECEIVE, CanControllerRef=CanController_C_Confort
        CanHwObj_Hrh_19_Confort_202: CanIdType=STANDARD, CanIdValue=514, CanObjectId=19, CanObjectType=RECEIVE, CanControllerRef=CanController_C_Confort
        CanHwObj_Hrh_20_Confort_203: CanIdType=STANDARD, CanIdValue=515, CanObjectId=20, CanObjectType=RECEIVE, CanControllerRef=CanController_C_Confort
        CanHwObj_Hrh_21_Confort_221: CanIdType=STANDARD, CanIdValue=545, CanObjectId=21, CanObjectType=RECEIVE, CanControllerRef=CanController_C_Confort
        CanHwObj_Hrh_22_Confort_251: CanIdType=STANDARD, CanIdValue=593, CanObjectId=22, CanObjectType=RECEIVE, CanControllerRef=CanController_C_Confort
        CanHwObj_Hrh_23_Confort_592: CanIdType=STANDARD, CanIdValue=1426, CanObjectId=23, CanObjectType=RECEIVE, CanControllerRef=CanController_C_Confort
        CanHwObj_Hrh_24_Confort_593: CanIdType=STANDARD, CanIdValue=1427, CanObjectId=24, CanObjectType=RECEIVE, CanControllerRef=CanController_C_Confort
        CanHwObj_Hrh_25_Confort_603: CanIdType=STANDARD, CanIdValue=1539, CanObjectId=25, CanObjectType=RECEIVE, CanControllerRef=CanController_C_Confort
        CanHwObj_Hrh_26_Confort_7FC: CanIdType=STANDARD, CanIdValue=2044, CanObjectId=26, CanObjectType=RECEIVE, CanControllerRef=CanController_C_Confort
        CanHwObj_Hrh_27_Confort_7FE: CanIdType=STANDARD, CanIdValue=2046, CanObjectId=27, CanObjectType=RECEIVE, CanControllerRef=CanController_C_Confort
        CanHwObj_Hth_28_Tilt_80: CanIdType=STANDARD, CanIdValue=0, CanObjectId=28, CanObjectType=TRANSMIT, CanControllerRef=CanController_A_Tilt
        CanHwObj_Hth_29_Tilt_201: CanIdType=STANDARD, CanIdValue=0, CanObjectId=29, CanObjectType=TRANSMIT, CanControllerRef=CanController_A_Tilt
        CanHwObj_Hth_30_Tilt_701: CanIdType=STANDARD, CanIdValue=0, CanObjectId=30, CanObjectType=TRANSMIT, CanControllerRef=CanController_A_Tilt
        CanHwObj_Hth_31_Tilt_000: CanIdType=STANDARD, CanIdValue=0, CanObjectId=31, CanObjectType=TRANSMIT, CanControllerRef=CanController_A_Tilt
        CanHwObj_Hth_32_Tilt_601: CanIdType=STANDARD, CanIdValue=0, CanObjectId=32, CanObjectType=TRANSMIT, CanControllerRef=CanController_A_Tilt
        CanHwObj_Hth_33_Tilt_7C0: CanIdType=STANDARD, CanIdValue=0, CanObjectId=33, CanObjectType=TRANSMIT, CanControllerRef=CanController_A_Tilt
        CanHwObj_Hth_34_Chassis_80: CanIdType=MIXED, CanIdValue=0, CanObjectId=34, CanObjectType=TRANSMIT, CanControllerRef=CanController_B_Chassis
        CanHwObj_Hth_35_Chassis_210: CanIdType=MIXED, CanIdValue=0, CanObjectId=35, CanObjectType=TRANSMIT, CanControllerRef=CanController_B_Chassis
        CanHwObj_Hth_36_Chassis_213: CanIdType=MIXED, CanIdValue=0, CanObjectId=36, CanObjectType=TRANSMIT, CanControllerRef=CanController_B_Chassis
        CanHwObj_Hth_37_Chassis_610: CanIdType=MIXED, CanIdValue=0, CanObjectId=37, CanObjectType=TRANSMIT, CanControllerRef=CanController_B_Chassis
        CanHwObj_Hth_38_Chassis_613: CanIdType=MIXED, CanIdValue=0, CanObjectId=38, CanObjectType=TRANSMIT, CanControllerRef=CanController_B_Chassis
        CanHwObj_Hth_39_Confort_100: CanIdType=STANDARD, CanIdValue=0, CanObjectId=39, CanObjectType=TRANSMIT, CanControllerRef=CanController_C_Confort
        CanHwObj_Hth_40_Confort_111: CanIdType=STANDARD, CanIdValue=0, CanObjectId=40, CanObjectType=TRANSMIT, CanControllerRef=CanController_C_Confort
        CanHwObj_Hth_41_Confort_112: CanIdType=STANDARD, CanIdValue=0, CanObjectId=41, CanObjectType=TRANSMIT, CanControllerRef=CanController_C_Confort
        CanHwObj_Hth_42_Confort_113: CanIdType=STANDARD, CanIdValue=0, CanObjectId=42, CanObjectType=TRANSMIT, CanControllerRef=CanController_C_Confort
        CanHwObj_Hth_43_Confort_250: CanIdType=STANDARD, CanIdValue=0, CanObjectId=43, CanObjectType=TRANSMIT, CanControllerRef=CanController_C_Confort
        CanHwObj_Hth_44_Confort_500: CanIdType=STANDARD, CanIdValue=0, CanObjectId=44, CanObjectType=TRANSMIT, CanControllerRef=CanController_C_Confort
        CanHwObj_Hth_45_Confort_504: CanIdType=STANDARD, CanIdValue=0, CanObjectId=45, CanObjectType=TRANSMIT, CanControllerRef=CanController_C_Confort
        CanHwObj_Hth_46_Confort_591: CanIdType=STANDARD, CanIdValue=0, CanObjectId=46, CanObjectType=TRANSMIT, CanControllerRef=CanController_C_Confort
        CanHwObj_Hth_47_Confort_594: CanIdType=STANDARD, CanIdValue=0, CanObjectId=47, CanObjectType=TRANSMIT, CanControllerRef=CanController_C_Confort
        CanHwObj_Hth_48_Confort_595: CanIdType=STANDARD, CanIdValue=0, CanObjectId=48, CanObjectType=TRANSMIT, CanControllerRef=CanController_C_Confort
        CanHwObj_Hth_49_Confort_7F0: CanIdType=STANDARD, CanIdValue=0, CanObjectId=49, CanObjectType=TRANSMIT, CanControllerRef=CanController_C_Confort
        CanHwObj_Hth_50_Confort_7F1: CanIdType=STANDARD, CanIdValue=0, CanObjectId=50, CanObjectType=TRANSMIT, CanControllerRef=CanController_C_Confort
        CanHwObj_Hth_51_Confort_7F2: CanIdType=STANDARD, CanIdValue=0, CanObjectId=51, CanObjectType=TRANSMIT, CanControllerRef=CanController_C_Confort
        CanHwObj_Hth_52_Confort_7F3: CanIdType=STANDARD, CanIdValue=0, CanObjectId=52, CanObjectType=TRANSMIT, CanControllerRef=CanController_C_Confort
        CanHwObj_Hth_53_Confort_7F4: CanIdType=STANDARD, CanIdValue=0, CanObjectId=53, CanObjectType=TRANSMIT, CanControllerRef=CanController_C_Confort
        CanHwObj_Hth_54_Confort_7F5: CanIdType=STANDARD, CanIdValue=0, CanObjectId=54, CanObjectType=TRANSMIT, CanControllerRef=CanController_C_Confort
        CanHwObj_Hth_55_Confort_7F6: CanIdType=STANDARD, CanIdValue=0, CanObjectId=55, CanObjectType=TRANSMIT, CanControllerRef=CanController_C_Confort
        CanHwObj_Hth_56_Confort_7F7: CanIdType=STANDARD, CanIdValue=0, CanObjectId=56, CanObjectType=TRANSMIT, CanControllerRef=CanController_C_Confort
        CanHwObj_Hth_57_Confort_7F8: CanIdType=STANDARD, CanIdValue=0, CanObjectId=57, CanObjectType=TRANSMIT, CanControllerRef=CanController_C_Confort
        CanHwObj_Hth_58_Confort_7F9: CanIdType=STANDARD, CanIdValue=0, CanObjectId=58, CanObjectType=TRANSMIT, CanControllerRef=CanController_C_Confort
        CanHwObj_Hth_59_Confort_7FA: CanIdType=STANDARD, CanIdValue=0, CanObjectId=59, CanObjectType=TRANSMIT, CanControllerRef=CanController_C_Confort
        CanHwObj_Hth_60_Confort_7FB: CanIdType=STANDARD, CanIdValue=0, CanObjectId=60, CanObjectType=TRANSMIT, CanControllerRef=CanController_C_Confort
        CanHwObj_Hth_61_Confort_7FD: CanIdType=STANDARD, CanIdValue=0, CanObjectId=61, CanObjectType=TRANSMIT, CanControllerRef=CanController_C_Confort
    CanGeneral:
      CanDevErrorDetection = false
      CanHardwareCancellation = false
      CanIndex = 0
      CanMainFunctionBusoffPeriod = 50.0
      CanMainFunctionReadPeriod = 50.0
      CanMainFunctionWakeupPeriod = 50.0
      CanMainFunctionWritePeriod = 50.0
      CanMultiplexedTransmission = true
      CanTimeoutDurationFactor = 2000
      CanVersionInfoApi = false
      CanWakeupSupport = true
  module config Stub_Gpt_Config: definition=Gpt, implementation-config-variant=VARIANT-PRE-COMPILE, module-description=Gpt_Impl
    GptChannelConfigSet
      GptOsChannel (GptChannelConfiguration):
        GptChannelClkSrc = (unset)
        GptChannelId = 0
        GptChannelMode = (unset)
        GptChannelPrescale = (unset)
        GptEnableWakeup = (unset)
        GptNotification = Gpt_OsTickNotification
        GptWakeupConfiguration: GptWakeupSourceRef=(unset)
      GptOsTimingProtecChannel (GptChannelConfiguration):
        GptChannelClkSrc = (unset)
        GptChannelId = 2
        GptChannelMode = (unset)
        GptChannelPrescale = (unset)
        GptEnableWakeup = (unset)
        GptNotification = Gpt_OsTickNotification
        GptWakeupConfiguration: GptWakeupSourceRef=(unset)
    GptConfigurationOfOptApiServices:
      GptDeinitApi = (unset)
      GptEnableDisableNotificationApi = (unset)
      GptTimeElapsedApi = (unset)
      GptTimeRemainingApi = (unset)
      GptVersionInfoApi = (unset)
      GptWakeupFunctionalityApi = (unset)
    GptDriverConfiguration: GptDevErrorDetect=(unset), GptReportWakeupSource=(unset)
  module config Stub_Mcu_Config: definition=Mcu, implementation-config-variant=VARIANT-PRE-COMPILE, module-description=Mcu_Impl
    McuGeneralConfiguration: McuDevErrorDetect=(unset), McuPerformResetApi=(unset), McuVersionInfoApi=(unset)
    McuModuleConfiguration: McuClockSrcFailureNotification=(unset), McuNumberOfMcuModes=(unset), McuRamSectors=(unset), McuResetSetting=(unset)
      McuClockSettingConfig
        McuClockReferencePoint: McuClockReferencePointFrequency=2.5E7
      McuModeSettingConf: McuMode=0
      McuRamSectorSettingConf: McuRamDefaultValue=(unset), McuRamSectionBaseAddress=(unset), McuRamSectionSize=(unset)
  module config Stub_Dio_Config: definition=Dio, implementation-config-variant=VARIANT-PRE-COMPILE, module-description=Dio_Impl
    DioGeneral: DioDevErrorDetect=(unset), DioVersionInfoApi=(unset)
    DioPort: DioPortId=(unset)
      4 x DioChannel, all with DioChannelId=(unset):
        DioChannel_PSU_EN
        DioChannel_RESET
        DioChannel_RAMPDIRIN
        DioChannel_FMCW_SYNC
  module config Stub_Spi_Config: definition=Spi, implementation-config-variant=VARIANT-PRE-COMPILE, module-description=Spi_Impl
    SpiDriver: SpiMaxChannel=(unset), SpiMaxJob=(unset), SpiMaxSequence=(unset)
      SpiChannel_TxCmd (SpiChannel): SpiChannelId=0, SpiChannelType=, SpiDataWidth=(unset), SpiDefaultData=(unset), SpiEbMaxLength=(unset), SpiIbNBuffers=(unset), SpiTransferStart=
      SpiExternalDevice: SpiBaudrate=(unset), SpiCsIdentifier=, SpiCsPolarity=, SpiDataShiftEdge=, SpiEnableCs=(unset), SpiShiftClockIdleLevel=, SpiTimeClk2Cs=(unset)
      SpiJob: SpiHwUnit=, SpiJobEndNotification=, SpiJobId=(unset), SpiJobPriority=(unset), ChannelAssignment=(unset), DeviceAssignment=(unset)
      SpiSequence_TxReq (SpiSequence): SpiInterruptibleSequence=(unset), SpiSeqEndNotification=, SpiSequenceId=0, JobAssignment=(unset)
    SpiGeneral:
      SpiCancelApi = (unset)
      SpiChannelBuffersAllowed = (unset)
      SpiDevErrorDetect = (unset)
      SpiHwStatusApi = (unset)
      SpiInterruptibleSeqAllowed = (unset)
      SpiLevelDelivered = (unset)
      SpiVersionInfoApi = (unset)
  module config Stub_Adc_Config: definition=Adc, implementation-config-variant=VARIANT-PRE-COMPILE, module-description=Adc_Impl
    AdcConfigSet
      AdcHwUnit: AdcClockSource=(unset), AdcHwUnitId=(unset), AdcPrescale=(unset)
        AdcChannel:
          AdcChannelConvTime = (unset)
          AdcChannelId = (unset)
          AdcChannelRefVoltsrcHigh = (unset)
          AdcChannelRefVoltsrcLow = (unset)
          AdcChannelResolution = (unset)
          AdcChannelSampTime = (unset)
        3 x AdcGroup, all with AdcGroupAccessMode=, AdcGroupConversionMode=, AdcGroupId=0, AdcGroupPriority=(unset), AdcGroupReplacement=, AdcGroupTriggSrc=, AdcHwTrigSignal=, AdcHwTrigTimer=(unset), AdcNotification=ArpodRadar_Cbk_SamplesNotif, AdcResultBufferPointer=, AdcStreamingBufferMode=, AdcStreamingNumSamples=1, AdcGroupDefinition=(unset):
          AdcGroup
          AdcGroupTemp
          AdcGroupPow
    AdcGeneral:
      AdcDeInitApi = (unset)
      AdcDevErrorDetect = (unset)
      AdcEnableQueuing = (unset)
      AdcEnableStartStopGroupApi = (unset)
      AdcGrpNotifCapability = (unset)
      AdcHwTriggerApi = (unset)
      AdcPriorityImplementation = 
      AdcReadGroupApi = (unset)
      AdcVersionInfoApi = (unset)
    AdcPublishedInformation: AdcChannelValueSigned=(unset), AdcGroupFirstChannelFixed=(unset), AdcMaxChannelResolution=(unset)
  module config TcpIp_Config: definition=TcpIp, implementation-config-variant=VARIANT-PRE-COMPILE, module-description=TcpIp_Impl
    TcpIpMem: TcpIpMemLibcMalloc=false, TcpIpMemAlignement=4, TcpIpMemSize=0, TcpIpMempOverflowCheck=2, TcpIpMempSanityCheck=true, TcpIpMemUsePools=true
    TcpIpMempSizes:
      TcpIpMempNumPbuf = 8
      TcpIpMempNumUdpPcb = 8
      TcpIpMempNumRawPcb = 0
      TcpIpMempNumTcpPcb = 8
      TcpIpMempNumTcpPcbListen = 4
      TcpIpMempNumTcpSeg = 2
      TcpIpMempNumArpQueue = 0
      TcpIpMempNumReassData = 0
      TcpIpMempNumNetbuf = 8
      TcpIpPbufPoolSize = 8
      TcpIpMempNumMbox = 8
    TcpIpArp: TcpIpArpEnable=true, TcpIpArpTableSize=4, TcpIpArpTrustIpMac=true, TcpIpArpQueueing=false
    TcpIpIp:
      TcpIpIpForward = (unset)
      TcpIpIpOptionsAllowed = (unset)
      TcpIpIpReassembly = (unset)
      TcpIpIpFrag = (unset)
      TcpIpIpReassMaxAge = (unset)
      TcpIpIpFragUsesStaticBuffer = (unset)
      TcpIpIpDefaultTTL = (unset)
      TcpIpIpFragMaxMTU = (unset)
      TcpIpIpReassMaxPbufs = (unset)
    TcpIpIcmp: TcpIpIcmpEnable=true, TcpIpIcmpTTL=(unset)
    TcpIpRaw: TcpIpRawEnable=false, TcpIpRawTTL=(unset)
    TcpIpUdp: TcpIpUdpEnable=true, TcpIpUdpTTL=(unset), TcpIpUdpLiteEnable=(unset)
    TcpIpTcp:
      TcpIpTcpEnable = true
      TcpIpTcpTTL = (unset)
      TcpIpTcpWnd = (unset)
      TcpIpTcpMaxRtx = (unset)
      TcpIpTcpSynMaxRtx = (unset)
      TcpIpTcpMss = 1024
      TcpIpTcpQueueOOSeq = (unset)
      TcpIpTcpCalculateEffSendMSS = (unset)
      TcpIpTcpSndBuffer = 1024
      TcpIpTcpSndQueueLen = (unset)
      TcpIpTcpSndLowat = (unset)
      TcpIpTcpListenBacklog = (unset)
      TcpIpTcpDefaultListenBacklog = (unset)
    TcpIpPbuf: TcpIpPbufLinkHlen=(unset), TcpIpPbufPoolBuffSize=(unset)
    TcpIpStats:
      TcpIpStatsEnable = true
      TcpIpStatsDisplay = (unset)
      TcpIpLinkStats = (unset)
      TcpIpArpStats = (unset)
      TcpIpIpStats = (unset)
      TcpIpIpFragStats = (unset)
      TcpIpUdpStats = (unset)
      TcpIpIcmpStats = (unset)
      TcpIpTcpStats = (unset)
      TcpIpMemStats = (unset)
      TcpIpMempStats = (unset)
    TcpIpChecksums: TcpIpChkGenIp=true, TcpIpChkGenUdp=true, TcpIpChkGenTcp=(unset), TcpIpChkCheckIp=false, TcpIpChkCheckUdp=false, TcpIpChkCheckTcp=false
  module config SoAd_Config: definition=SoAd, implementation-config-variant=VARIANT-PRE-COMPILE, module-description=SoAd_Impl
    SoAdGeneral:
      SoAdPollingInterval = 0.25
      SoAdMainFunctionPeriod = 0.25
      SoAdTcpIpMainFunctionPeriod = 0.25
      SoAdSocketCount = 1
      SoAdMaxOpenSockets = 2
      SoAdBufferMemorySize = 1580
      SoAdDevErrorDetect = true
      SoAdVersionInfoApi = true
      DoIpVersionInfoApi = false
      TcpIpVersionInfoApi = true
      SoAdCallbackApi = true
      SoAdIPv6AddressEnabled = false
      SoAdUdpNmApiEnabled = false
      SoAdXcpApiEnabled = false
      SoAdDoIpActive = false
    SoAdSocketConnectionTcp1 (SoAdSocketConnection):
      SoAdSocketLocalIpAddress = 192.168.0.2
      SoAdSocketRemoteIpAddress = 192.168.0.56
      SoAdSocketRemotePort = 6900
      SoAdSocketProtocol = TCP
      SoAdSocketLocalPort = 6900
      SoAdSocketTcpInitiate = false
      SoAdSocketTcpNoDelay = false
      SoAdSocketUdpListenOnly = false
      SoAdPduHeaderEnable = false
      SoAdPduProvideBufferEnable = false
      SoAdResourceMngtEnable = false
      SoAdSocketAutosarApi = false
      SoAdAutosarConnector = PduR
      SoAdSocketId = 0
    SoAdPduRoute_TxTcp1 (SoAdPduRoute): SoAdSourcePduId=0, SoAdSourceSduLength=1024, SoAdDestinationId=0, SoAdDestinationSocketRef=SoAdSocketConnectionTcp1
    SoAdSocketRoute_RxTcp1 (SoAdSocketRoute): SoAdDestinationSduLength=1, SoAdSourceId=0, SoAdDestinationPduId=6, SoAdSourceSocketRef=SoAdSocketConnectionTcp1
  module config EthDrv_Config: definition=EthDrv, implementation-config-variant=VARIANT-PRE-COMPILE, module-description=EthDrv_Impl
    EthGeneral:
      EthNbRxBuffers = 8
      EthNbTxBuffers = 8
      EthRxBufferSize = 1536
      EthTxBufferSize = 1536
      EthMacAddress = 00:04:9f:4d:50:43
      EthPhyAddress = 1
      EthEnableCallbackOnIt = true
      EthUseIsr2OnInterrupt = false
    EthLink: EthEnableAutoNegociation=false, EthEnableAutoCross=false, EthCrossedLink=true, EthUse100Mbps=false, EthUseFullDuplex=true
  module config Com_Config: definition=Com, implementation-config-variant=VARIANT-PRE-COMPILE, module-description=Com_Impl
    ComConfig: ComConfigurationId=305419896
      ComIPduGroupTX (ComIPduGroup): category=IPDU_Group, ComIPduGroupHandleId=0
      ComIPduGroupRx (ComIPduGroup): category=IPDU_Group, ComIPduGroupHandleId=1
      F_CanOpenSynchFrame_Chassis_80 (ComIPdu):
        category = IPDU_Tx
        ComIPduSignalProcessing = DEFERED
        ComIPduSize = 1
        ComIpduDirection = SEND
        ComIPduGroupRef = ComIPduGroupTX
        ComIPduSignalRef = S_Unused_Chassis_80
        PduIdRef = ECUC_CAN_Chassis_80
        ComTxIPdu: ComTxIPduUnusedAreasDefault=0, ComTxIPduMinimumDelayTimeFactor=0
          ComTxModeTrue
            ComTxMode: ComTxModeMode=DIRECT, ComTxModeNumberOfRepetitions=0
      F_DataTransferFromUcConfort_Confort_506 (ComIPdu):
        category = IPDU_Rx
        ComIPduRxHandleId = 0
        ComIPduSignalProcessing = DEFERED
        ComIPduSize = 8
        ComIpduDirection = RECEIVE
        ComIPduGroupRef = ComIPduGroupRx
        PduIdRef = ECUC_CAN_Confort_506
        ComIPduSignalRef = S_Renesas_TOR_inputs_506
        ComIPduSignalRef = S_Renesas_TOR_outputs_506
        ComIPduSignalRef = S_Shift_selector_position_506
        ComIPduSignalRef = S_Service_battery_voltage_506
        ComIPduSignalRef = S_UserSelectedCarMode_506
        ComIPduSignalRef = S_CarSpeedCommand_506
      29 x ComSignal, all with ComSignalInitValue=0, SystemTemplateSystemSignalRef=(unset):
        S_Unused_Chassis_80: category=Signal_Tx, ComBitPosition=0, ComBitSize=8, ComHandleId=144, ComSignalEndianess=opaque, ComSignalLength=1, ComSignalType=UINT8_N, ComTransferProperty=TRIGGERED
        S_Unused_Tilt_80: category=Signal_Tx, ComBitPosition=0, ComBitSize=8, ComHandleId=145, ComSignalEndianess=opaque, ComSignalLength=1, ComSignalType=UINT8_N, ComTransferProperty=TRIGGERED
        S_CopleyAccelnetAmplifier_Nodeguarding_701: category=Signal_Tx, ComBitPosition=0, ComBitSize=8, ComHandleId=146, ComSignalEndianess=opaque, ComSignalLength=1, ComSignalType=UINT8_N, ComTransferProperty=TRIGGERED
        S_CarSpeedSigned_504: category=Signal_Tx, ComBitPosition=0, ComBitSize=16, ComHandleId=147, ComSignalEndianess=LITTLE_ENDIAN, ComSignalType=UINT16, ComTransferProperty=PENDING
        S_PropulsionInvertersMeanPowersupply_504: category=Signal_Tx, ComBitPosition=16, ComBitSize=8, ComHandleId=148, ComSignalEndianess=opaque, ComSignalLength=1, ComSignalType=UINT8_N, ComTransferProperty=PENDING
        S_PropulsionInvertersMaxTemperature_504: category=Signal_Tx, ComBitPosition=24, ComBitSize=8, ComHandleId=149, ComSignalEndianess=LITTLE_ENDIAN, ComSignalType=SINT8, ComTransferProperty=PENDING
        S_MotorsMaxTemperature_504: category=Signal_Tx, ComBitPosition=32, ComBitSize=8, ComHandleId=150, ComSignalEndianess=LITTLE_ENDIAN, ComSignalType=SINT8, ComTransferProperty=PENDING
        S_ShiftSelectorState_504: category=Signal_Tx, ComBitPosition=40, ComBitSize=8, ComHandleId=151, ComSignalEndianess=opaque, ComSignalLength=1, ComSignalType=UINT8_N, ComTransferProperty=PENDING
        S_SocCorrige_504: category=Signal_Tx, ComBitPosition=48, ComBitSize=8, ComHandleId=152, ComSignalEndianess=opaque, ComSignalLength=1, ComSignalType=UINT8_N, ComTransferProperty=PENDING
        S_Throttleposition_504: category=Signal_Tx, ComBitPosition=56, ComBitSize=8, ComHandleId=153, ComSignalEndianess=opaque, ComSignalLength=1, ComSignalType=UINT8_N, ComTransferProperty=PENDING
        S_AmplifierTemperature_281: category=Signal_Rx, ComBitPosition=0, ComBitSize=16, ComHandleId=0, ComSignalEndianess=LITTLE_ENDIAN, ComSignalType=UINT16
        S_ManufacturerStatusRegister_381: category=Signal_Rx, ComBitPosition=0, ComBitSize=32, ComHandleId=1, ComSignalEndianess=LITTLE_ENDIAN, ComSignalType=UINT32, ComNotification=RxCbk_CopleyAccelnetAmplifierPDO3_Tilt_381
        S_0x07_202: category=Signal_Rx, ComBitPosition=0, ComBitSize=8, ComHandleId=2, ComSignalEndianess=opaque, ComSignalType=UINT8_N, ComSignalLength=1
        S_Battery_Voltage_202: category=Signal_Rx, ComBitPosition=8, ComBitSize=16, ComHandleId=3, ComSignalEndianess=LITTLE_ENDIAN, ComSignalType=UINT16
        S_BatteryCurrent_202: category=Signal_Rx, ComBitPosition=24, ComBitSize=16, ComHandleId=4, ComSignalEndianess=LITTLE_ENDIAN, ComSignalType=SINT16
        S_AverageTemperature_202: category=Signal_Rx, ComBitPosition=40, ComBitSize=8, ComHandleId=5, ComSignalEndianess=opaque, ComSignalType=UINT8_N, ComSignalLength=1
        S_StateOfCharge_202: category=Signal_Rx, ComBitPosition=48, ComBitSize=8, ComHandleId=6, ComSignalEndianess=opaque, ComSignalType=UINT8_N, ComSignalLength=1
        S_Udiff_202: category=Signal_Rx, ComBitPosition=56, ComBitSize=8, ComHandleId=7, ComSignalEndianess=opaque, ComSignalType=UINT8_N, ComSignalLength=1
        S_0x07_203: category=Signal_Rx, ComBitPosition=0, ComBitSize=8, ComHandleId=8, ComSignalEndianess=opaque, ComSignalType=UINT8_N, ComSignalLength=1
        S_AverageCell_Voltage_203: category=Signal_Rx, ComBitPosition=8, ComBitSize=16, ComHandleId=9, ComSignalEndianess=LITTLE_ENDIAN, ComSignalType=UINT16
        S_MinCellVoltage_203: category=Signal_Rx, ComBitPosition=24, ComBitSize=16, ComHandleId=10, ComSignalEndianess=LITTLE_ENDIAN, ComSignalType=UINT16
        S_MaxCellVoltage_203: category=Signal_Rx, ComBitPosition=40, ComBitSize=16, ComHandleId=11, ComSignalEndianess=LITTLE_ENDIAN, ComSignalType=UINT16
        S_WakeUpData_221: category=Signal_Rx, ComBitPosition=0, ComBitSize=8, ComHandleId=12, ComSignalEndianess=opaque, ComSignalType=UINT8_N, ComSignalLength=1, ComNotification=RxCbk_ACTIA_WakeUp_221
        S_Renesas_TOR_inputs_506: category=Signal_Rx, ComBitPosition=0, ComBitSize=16, ComHandleId=13, ComSignalEndianess=LITTLE_ENDIAN, ComSignalType=UINT16, ComNotification=RxCbk_Renesas_TOR_inputs_506
        S_Renesas_TOR_outputs_506: category=Signal_Rx, ComBitPosition=16, ComBitSize=16, ComHandleId=14, ComSignalEndianess=LITTLE_ENDIAN, ComSignalType=UINT16, ComNotification=RxCbk_Renesas_TOR_outputs_506
        S_Shift_selector_position_506: category=Signal_Rx, ComBitPosition=32, ComBitSize=8, ComHandleId=15, ComSignalEndianess=opaque, ComSignalType=UINT8_N, ComNotification=RxCbk_Shift_selector_position_506, ComSignalLength=1
        S_Service_battery_voltage_506: category=Signal_Rx, ComBitPosition=40, ComBitSize=8, ComHandleId=16, ComSignalEndianess=opaque, ComSignalType=UINT8_N, ComNotification=RxCbk_Service_battery_voltage_506, ComSignalLength=1
        S_UserSelectedCarMode_506: category=Signal_Rx, ComBitPosition=48, ComBitSize=8, ComHandleId=17, ComSignalEndianess=opaque, ComSignalType=UINT8_N, ComNotification=RxCbk_UserSelectedCarMode_506, ComSignalLength=1
        S_CarSpeedCommand_506: category=Signal_Rx, ComBitPosition=56, ComBitSize=8, ComHandleId=18, ComSignalEndianess=opaque, ComSignalType=UINT8_N, ComNotification=RxCbk_CarSpeedCommand_506, ComSignalLength=1
      31 x ComIPdu, all with ComIPduSignalProcessing=DEFERED:
        F_CanOpenSynchFrame_Tilt_80: category=IPDU_Tx, ComIPduSize=1, ComIpduDirection=SEND, ComIPduGroupRef=ComIPduGroupTX, ComIPduSignalRef=S_Unused_Tilt_80, PduIdRef=ECUC_CAN_Tilt_80
          ComTxIPdu: ComTxIPduUnusedAreasDefault=0, ComTxIPduMinimumDelayTimeFactor=0
            ComTxModeTrue
              ComTxMode: ComTxModeMode=DIRECT, ComTxModeNumberOfRepetitions=0
        F_CLAS_Data_Confort_504: category=IPDU_Tx, ComIPduSize=8, ComIpduDirection=SEND, ComIPduGroupRef=ComIPduGroupTX, PduIdRef=ECUC_CAN_Confort_504, ComIPduSignalRef=S_CarSpeedSigned_504, ComIPduSignalRef=S_PropulsionInvertersMeanPowersupply_504, ComIPduSignalRef=S_PropulsionInvertersMaxTemperature_504, ComIPduSignalRef=S_MotorsMaxTemperature_504, ComIPduSignalRef=S_ShiftSelectorState_504, ComIPduSignalRef=S_SocCorrige_504, ComIPduSignalRef=S_Throttleposition_504
          ComTxIPdu: ComTxIPduUnusedAreasDefault=0, ComTxIPduMinimumDelayTimeFactor=0
            ComTxModeTrue
              ComTxMode: ComTxModeMode=PERIODIC, ComTxModeTimeOffsetFactor=50, ComTxModeTimePeriodFactor=100
        F_CLAS_Status_Confort_100: category=IPDU_Tx, ComIPduSize=8, ComIpduDirection=SEND, ComIPduGroupRef=ComIPduGroupTX, PduIdRef=ECUC_CAN_Confort_100, ComIPduSignalGroupRef=SG_CLAS_Status_100
          ComTxIPdu: ComTxIPduUnusedAreasDefault=0, ComTxIPduMinimumDelayTimeFactor=0
            ComTxModeTrue
              ComTxMode: ComTxModeMode=DIRECT, ComTxModeNumberOfRepetitions=0
        F_BSIDebugData_Confort_111: category=IPDU_Tx, ComIPduSize=8, ComIpduDirection=SEND, ComIPduGroupRef=ComIPduGroupTX, PduIdRef=ECUC_CAN_Confort_111, ComIPduSignalGroupRef=SG_BSIDebugData_111
          ComTxIPdu: ComTxIPduUnusedAreasDefault=0, ComTxIPduMinimumDelayTimeFactor=0
            ComTxModeTrue
              ComTxMode: ComTxModeMode=DIRECT, ComTxModeNumberOfRepetitions=0
        F_IHMDebugData_Confort_112: category=IPDU_Tx, ComIPduSize=8, ComIpduDirection=SEND, ComIPduGroupRef=ComIPduGroupTX, PduIdRef=ECUC_CAN_Confort_112, ComIPduSignalGroupRef=SG_IHMDebugData_112
          ComTxIPdu: ComTxIPduUnusedAreasDefault=0, ComTxIPduMinimumDelayTimeFactor=0
            ComTxModeTrue
              ComTxMode: ComTxModeMode=DIRECT, ComTxModeNumberOfRepetitions=0
        F_EXTDebugData_Confort_113: category=IPDU_Tx, ComIPduSize=8, ComIpduDirection=SEND, ComIPduGroupRef=ComIPduGroupTX, PduIdRef=ECUC_CAN_Confort_113, ComIPduSignalGroupRef=SG_EXTDebugData_113
          ComTxIPdu: ComTxIPduUnusedAreasDefault=0, ComTxIPduMinimumDelayTimeFactor=0
            ComTxModeTrue
              ComTxMode: ComTxModeMode=DIRECT, ComTxModeNumberOfRepetitions=0
        F_CLASToIHM_Confort_500: category=IPDU_Tx, ComIPduSize=8, ComIpduDirection=SEND, ComIPduGroupRef=ComIPduGroupTX, PduIdRef=ECUC_CAN_Confort_500, ComIPduSignalGroupRef=SG_CLASToIHM_500
          ComTxIPdu: ComTxIPduUnusedAreasDefault=0, ComTxIPduMinimumDelayTimeFactor=0
            ComTxModeTrue
              ComTxMode: ComTxModeMode=PERIODIC, ComTxModeTimeOffsetFactor=0, ComTxModeTimePeriodFactor=100
        F_IMMOData_Confort_591: category=IPDU_Tx, ComIPduSize=8, ComIpduDirection=SEND, ComIPduGroupRef=ComIPduGroupTX, PduIdRef=ECUC_CAN_Confort_591, ComIPduSignalGroupRef=SG_IMMOData_591
          ComTxIPdu: ComTxIPduUnusedAreasDefault=0, ComTxIPduMinimumDelayTimeFactor=0
            ComTxModeTrue
              ComTxMode: ComTxModeMode=DIRECT, ComTxModeNumberOfRepetitions=0
        F_IMMODiagConfiguration_Confort_594: category=IPDU_Tx, ComIPduSize=8, ComIpduDirection=SEND, ComIPduGroupRef=ComIPduGroupTX, PduIdRef=ECUC_CAN_Confort_594, ComIPduSignalGroupRef=SG_IMMODiagConfiguration_594
          ComTxIPdu: ComTxIPduUnusedAreasDefault=0, ComTxIPduMinimumDelayTimeFactor=0
            ComTxModeTrue
              ComTxMode: ComTxModeMode=DIRECT, ComTxModeNumberOfRepetitions=0
        F_IMMORcuConfiguration_Confort_595: category=IPDU_Tx, ComIPduSize=8, ComIpduDirection=SEND, ComIPduGroupRef=ComIPduGroupTX, PduIdRef=ECUC_CAN_Confort_595, ComIPduSignalGroupRef=SG_IMMORcuConfiguration_595
          ComTxIPdu: ComTxIPduUnusedAreasDefault=0, ComTxIPduMinimumDelayTimeFactor=0
            ComTxModeTrue
              ComTxMode: ComTxModeMode=DIRECT, ComTxModeNumberOfRepetitions=0
        F_RightSKAISingleInverterCommandData_Chassis_210: category=IPDU_Tx, ComIPduSize=8, ComIpduDirection=SEND, ComIPduGroupRef=ComIPduGroupTX, PduIdRef=ECUC_CAN_Chassis_210, ComIPduSignalGroupRef=SG_RightSKAI_SingleInverter_CommandData_210
          ComTxIPdu: ComTxIPduUnusedAreasDefault=0, ComTxIPduMinimumDelayTimeFactor=0
            ComTxModeTrue
              ComTxMode: ComTxModeMode=DIRECT, ComTxModeNumberOfRepetitions=0
        F_LeftSKAISingleInverterCommandData_Chassis_213: category=IPDU_Tx, ComIPduSize=8, ComIpduDirection=SEND, ComIPduGroupRef=ComIPduGroupTX, PduIdRef=ECUC_CAN_Chassis_213, ComIPduSignalGroupRef=SG_LeftSKAI_SingleInverter_CommandData_213
          ComTxIPdu: ComTxIPduUnusedAreasDefault=0, ComTxIPduMinimumDelayTimeFactor=0
            ComTxModeTrue
              ComTxMode: ComTxModeMode=DIRECT, ComTxModeNumberOfRepetitions=0
        F_RightSKAISingleInverterClearError_Chassis_610: category=IPDU_Tx, ComIPduSize=4, ComIpduDirection=SEND, ComIPduGroupRef=ComIPduGroupTX, PduIdRef=ECUC_CAN_Chassis_610, ComIPduSignalGroupRef=SG_RightSKAI_SingleInverter_ClearError_610
          ComTxIPdu: ComTxIPduUnusedAreasDefault=0, ComTxIPduMinimumDelayTimeFactor=0
            ComTxModeTrue
              ComTxMode: ComTxModeMode=DIRECT, ComTxModeNumberOfRepetitions=0
        F_LeftSKAISingleInverterClearError_Chassis_613: category=IPDU_Tx, ComIPduSize=4, ComIpduDirection=SEND, ComIPduGroupRef=ComIPduGroupTX, PduIdRef=ECUC_CAN_Chassis_613, ComIPduSignalGroupRef=SG_LeftSKAI_SingleInverter_ClearError_613
          ComTxIPdu: ComTxIPduUnusedAreasDefault=0, ComTxIPduMinimumDelayTimeFactor=0
            ComTxModeTrue
              ComTxMode: ComTxModeMode=DIRECT, ComTxModeNumberOfRepetitions=0
        F_CopleyAccelnetAmplifierCommandData_Tilt_201: category=IPDU_Tx, ComIPduSize=5, ComIpduDirection=SEND, ComIPduGroupRef=ComIPduGroupTX, PduIdRef=ECUC_CAN_Tilt_201, ComIPduSignalGroupRef=SG_CopleyAccelnetAmplifier_CommandData_201
          ComTxIPdu: ComTxIPduUnusedAreasDefault=0, ComTxIPduMinimumDelayTimeFactor=0
            ComTxModeTrue
              ComTxMode: ComTxModeMode=DIRECT, ComTxModeNumberOfRepetitions=0
        F_CopleyAccelnetAmplifierNodeGuarding_Tilt_701: category=IPDU_Tx, ComIPduSize=1, ComIpduDirection=SEND, ComIPduGroupRef=ComIPduGroupTX, ComIPduSignalRef=S_CopleyAccelnetAmplifier_Nodeguarding_701, PduIdRef=ECUC_CAN_Tilt_701
          ComTxIPdu: ComTxIPduUnusedAreasDefault=0, ComTxIPduMinimumDelayTimeFactor=0
            ComTxModeTrue
              ComTxMode: ComTxModeMode=DIRECT, ComTxModeNumberOfRepetitions=0
        F_CopleyAccelnetAmplifierMode_Tilt_000: category=IPDU_Tx, ComIPduSize=2, ComIpduDirection=SEND, ComIPduGroupRef=ComIPduGroupTX, PduIdRef=ECUC_CAN_Tilt_000, ComIPduSignalGroupRef=SG_CopleyAccelnetAmplifier_Mode_000
          ComTxIPdu: ComTxIPduUnusedAreasDefault=0, ComTxIPduMinimumDelayTimeFactor=0
            ComTxModeTrue
              ComTxMode: ComTxModeMode=DIRECT, ComTxModeNumberOfRepetitions=0
        F_CopleyAccelnetAmplifierConfigurationTxFrame_Tilt_601: category=IPDU_Tx, ComIPduSize=8, ComIpduDirection=SEND, ComIPduGroupRef=ComIPduGroupTX, PduIdRef=ECUC_CAN_Tilt_601, ComIPduSignalGroupRef=SG_CopleyAccelnetAmplifier_ConfigurationTxFrame_601
          ComTxIPdu: ComTxIPduUnusedAreasDefault=0, ComTxIPduMinimumDelayTimeFactor=0
            ComTxModeTrue
              ComTxMode: ComTxModeMode=DIRECT, ComTxModeNumberOfRepetitions=0
        F_RightSKAISingleInverterErrorDebug_Chassis_190: category=IPDU_Rx, ComIPduRxHandleId=1, ComIPduSize=8, ComIpduDirection=RECEIVE, ComIPduGroupRef=ComIPduGroupRx, PduIdRef=ECUC_CAN_Chassis_190, ComIPduSignalGroupRef=SG_RightSKAISingleInverterErrorDebug_190
        F_RightSKAISingleInverterData1_Chassis_290: category=IPDU_Rx, ComIPduRxHandleId=2, ComIPduSize=8, ComIpduDirection=RECEIVE, ComIPduGroupRef=ComIPduGroupRx, PduIdRef=ECUC_CAN_Chassis_290, ComIPduSignalGroupRef=SG_RightSKAISingleInverterData1_Chassis_290
        F_RightSKAISingleInverterData2_Chassis_390: category=IPDU_Rx, ComIPduRxHandleId=3, ComIPduSize=8, ComIpduDirection=RECEIVE, ComIPduGroupRef=ComIPduGroupRx, PduIdRef=ECUC_CAN_Chassis_390, ComIPduSignalGroupRef=SG_RightSKAISingleInverterData2_Chassis_390
        F_RightSKAISingleInverterData3_Chassis_490: category=IPDU_Rx, ComIPduRxHandleId=4, ComIPduSize=8, ComIpduDirection=RECEIVE, ComIPduGroupRef=ComIPduGroupRx, PduIdRef=ECUC_CAN_Chassis_490, ComIPduSignalGroupRef=SG_RightSKAISingleInverterData3_Chassis_490
        F_LeftSKAISingleInverterErrorDebug_Chassis_193: category=IPDU_Rx, ComIPduRxHandleId=5, ComIPduSize=8, ComIpduDirection=RECEIVE, ComIPduGroupRef=ComIPduGroupRx, PduIdRef=ECUC_CAN_Chassis_193, ComIPduSignalGroupRef=SG_LeftSKAISingleInverterErrorDebug_Chassis_193
        F_LeftSKAISingleInverterData1_Chassis_293: category=IPDU_Rx, ComIPduRxHandleId=6, ComIPduSize=8, ComIpduDirection=RECEIVE, ComIPduGroupRef=ComIPduGroupRx, PduIdRef=ECUC_CAN_Chassis_293, ComIPduSignalGroupRef=SG_LeftSKAISingleInverterData1_Chassis_293
        F_LeftSKAISingleInverterData2_Chassis_393: category=IPDU_Rx, ComIPduRxHandleId=7, ComIPduSize=8, ComIpduDirection=RECEIVE, ComIPduGroupRef=ComIPduGroupRx, PduIdRef=ECUC_CAN_Chassis_393, ComIPduSignalGroupRef=SG_LeftSKAISingleInverterData2_Chassis_393
        F_LeftSKAISingleInverterData3_Chassis_493: category=IPDU_Rx, ComIPduRxHandleId=8, ComIPduSize=8, ComIpduDirection=RECEIVE, ComIPduGroupRef=ComIPduGroupRx, PduIdRef=ECUC_CAN_Chassis_493, ComIPduSignalGroupRef=SG_LeftSKAISingleInverterData3_Chassis_493
        F_CopleyAccelnetAmplifierConfigurationRxFrame_Tilt_581: category=IPDU_Rx, ComIPduRxHandleId=9, ComIPduSize=8, ComIpduDirection=RECEIVE, ComIPduGroupRef=ComIPduGroupRx, PduIdRef=ECUC_CAN_Tilt_581, ComIPduSignalGroupRef=SG_CopleyAccelnetAmplifierConfigurationRxFrame_581
        F_CopleyAccelnetAmplifierPDO1_Tilt_181: category=IPDU_Rx, ComIPduRxHandleId=10, ComIPduSize=8, ComIpduDirection=RECEIVE, ComIPduGroupRef=ComIPduGroupRx, PduIdRef=ECUC_CAN_Tilt_181, ComIPduSignalGroupRef=SG_CopleyAccelnetAmplifierPDO1_181
        F_CopleyAccelnetAmplifierPDO2_Tilt_281: category=IPDU_Rx, ComIPduRxHandleId=11, ComIPduSize=2, ComIpduDirection=RECEIVE, ComIPduGroupRef=ComIPduGroupRx, ComIPduSignalRef=S_AmplifierTemperature_281, PduIdRef=ECUC_CAN_Tilt_281
        F_CopleyAccelnetAmplifierPDO3_Tilt_381: category=IPDU_Rx, ComIPduRxHandleId=12, ComIPduSize=4, ComIpduDirection=RECEIVE, ComIPduGroupRef=ComIPduGroupRx, ComIPduSignalRef=S_ManufacturerStatusRegister_381, PduIdRef=ECUC_CAN_Tilt_381
        F_BoschSteeringWheelSensorData_Tilt_305: category=IPDU_Rx, ComIPduRxHandleId=13, ComIPduSize=6, ComIpduDirection=RECEIVE, ComIPduGroupRef=ComIPduGroupRx, PduIdRef=ECUC_CAN_Tilt_305, ComIPduSignalGroupRef=SG_BoschSteeringWheelSensorData_305
      SG_BoschSteeringWheelSensorCalibration_7C0 (ComSignalGroup): category=SignalGroup_Tx, ComBitPosition=0, ComBitSize=16, ComHandleId=22, ComTransferProperty=TRIGGERED, SystemTemplateSignalGroupRef=(unset)
        GS_CalibrationData_7C0 (ComGroupSignal):
          ComBitPosition = 0
          ComBitSize = 8
          ComHandleId = 154
          ComSignalEndianess = opaque
          ComSignalInitValue = 0
          ComSignalLength = 1
          ComSignalType = UINT8_N
          SystemTemplateSystemSignalRef = (unset)
        GS_0x00_7C0 (ComGroupSignal):
          ComBitPosition = 8
          ComBitSize = 8
          ComHandleId = 155
          ComSignalEndianess = opaque
          ComSignalInitValue = 0
          ComSignalLength = 1
          ComSignalType = UINT8_N
          SystemTemplateSystemSignalRef = (unset)
      F_BoschSteeringWheelSensorCalibration_Tilt_7C0 (ComIPdu):
        category = IPDU_Tx
        ComIPduSignalProcessing = DEFERED
        ComIPduSize = 2
        ComIpduDirection = SEND
        ComIPduGroupRef = ComIPduGroupTX
        PduIdRef = ECUC_CAN_Tilt_7C0
        ComIPduSignalGroupRef = SG_BoschSteeringWheelSensorCalibration_7C0
        ComTxIPdu: ComTxIPduUnusedAreasDefault=0, ComTxIPduMinimumDelayTimeFactor=0
          ComTxModeTrue
            ComTxMode: ComTxModeMode=DIRECT, ComTxModeNumberOfRepetitions=0
      SG_ACTIA_DataRequest_250 (ComSignalGroup): category=SignalGroup_Tx, ComBitPosition=0, ComBitSize=8, ComHandleId=23, ComTransferProperty=TRIGGERED, SystemTemplateSignalGroupRef=(unset)
        GS_Sub_id_250 (ComGroupSignal):
          ComBitPosition = 0
          ComBitSize = 8
          ComHandleId = 156
          ComSignalEndianess = opaque
          ComSignalInitValue = 0
          ComSignalLength = 1
          ComSignalType = UINT8_N
          SystemTemplateSystemSignalRef = (unset)
      F_ACTIA_DataRequest_Confort_250 (ComIPdu):
        category = IPDU_Tx
        ComIPduSignalProcessing = DEFERED
        ComIPduSize = 1
        ComIpduDirection = SEND
        ComIPduGroupRef = ComIPduGroupTX
        PduIdRef = ECUC_CAN_Confort_250
        ComIPduSignalGroupRef = SG_ACTIA_DataRequest_250
        ComTxIPdu: ComTxIPduUnusedAreasDefault=0, ComTxIPduMinimumDelayTimeFactor=0
          ComTxModeTrue
            ComTxMode: ComTxModeMode=DIRECT, ComTxModeNumberOfRepetitions=0
      SG_ACTIA_Data_251 (ComSignalGroup): category=SignalGroup_Rx, ComBitPosition=0, ComBitSize=64, ComHandleId=0, ComNotification=RxCbk_ACTIA_Data_251, SystemTemplateSignalGroupRef=(unset)
        8 x ComGroupSignal, all with ComBitSize=8, ComSignalEndianess=opaque, ComSignalInitValue=0, ComSignalLength=1, ComSignalType=UINT8_N, SystemTemplateSystemSignalRef=(unset):
          GS_SubId_251: ComBitPosition=0, ComHandleId=19
          GS_SubId_Data_0_251: ComBitPosition=8, ComHandleId=20
          GS_SubId_Data_1_251: ComBitPosition=16, ComHandleId=21
          GS_SubId_Data_2_251: ComBitPosition=24, ComHandleId=22
          GS_SubId_Data_3_251: ComBitPosition=32, ComHandleId=23
          GS_SubId_Data_4_251: ComBitPosition=40, ComHandleId=24
          GS_SubId_Data_5_251: ComBitPosition=48, ComHandleId=25
          GS_SubId_Data_6_251: ComBitPosition=56, ComHandleId=26
      SG_ACTIA_ErrorWarning_201 (ComSignalGroup):
        category = SignalGroup_Rx
        ComBitPosition = 0
        ComBitSize = 64
        ComHandleId = 1
        ComNotification = RxCbk_ACTIA_ErrorWarning_201
        SystemTemplateSignalGroupRef = (unset)
        5 x ComGroupSignal, all with ComSignalInitValue=0, SystemTemplateSystemSignalRef=(unset):
          GS_ShutdownError_201: ComBitPosition=0, ComBitSize=16, ComHandleId=27, ComSignalEndianess=LITTLE_ENDIAN, ComSignalType=UINT16
          GS_ActualError_201: ComBitPosition=16, ComBitSize=16, ComHandleId=28, ComSignalEndianess=LITTLE_ENDIAN, ComSignalType=UINT16
          GS_ActualWarning_201: ComBitPosition=32, ComBitSize=16, ComHandleId=29, ComSignalEndianess=LITTLE_ENDIAN, ComSignalType=UINT16
          GS_Unused1_201: ComBitPosition=48, ComBitSize=8, ComHandleId=30, ComSignalEndianess=opaque, ComSignalLength=1, ComSignalType=UINT8_N
          GS_Unused2_201: ComBitPosition=56, ComBitSize=8, ComHandleId=31, ComSignalEndianess=opaque, ComSignalLength=1, ComSignalType=UINT8_N
      23 x ComIPdu, all with ComIPduSignalProcessing=DEFERED:
        F_ACTIA_ErrorWarning_Confort_201: category=IPDU_Rx, ComIPduRxHandleId=14, ComIPduSize=8, ComIpduDirection=RECEIVE, ComIPduGroupRef=ComIPduGroupRx, PduIdRef=ECUC_CAN_Confort_201, ComIPduSignalGroupRef=SG_ACTIA_ErrorWarning_201
        F_ACTIA_ShortInfo_Confort_202: category=IPDU_Rx, ComIPduRxHandleId=15, ComIPduSize=8, ComIpduDirection=RECEIVE, ComIPduGroupRef=ComIPduGroupRx, PduIdRef=ECUC_CAN_Confort_202, ComIPduSignalRef=S_0x07_202, ComIPduSignalRef=S_Battery_Voltage_202, ComIPduSignalRef=S_BatteryCurrent_202, ComIPduSignalRef=S_AverageTemperature_202, ComIPduSignalRef=S_StateOfCharge_202, ComIPduSignalRef=S_Udiff_202
        F_ACTIA_WakeUp_Confort_221: category=IPDU_Rx, ComIPduRxHandleId=16, ComIPduSize=1, ComIpduDirection=RECEIVE, ComIPduGroupRef=ComIPduGroupRx, PduIdRef=ECUC_CAN_Confort_221, ComIPduSignalRef=S_WakeUpData_221
        F_ACTIA_Data_Confort_251: category=IPDU_Rx, ComIPduRxHandleId=17, ComIPduSize=8, ComIpduDirection=RECEIVE, ComIPduGroupRef=ComIPduGroupRx, PduIdRef=ECUC_CAN_Confort_251, ComIPduSignalGroupRef=SG_ACTIA_Data_251
        F_BSI_Status_Confort_101: category=IPDU_Rx, ComIPduRxHandleId=18, ComIPduSize=8, ComIpduDirection=RECEIVE, ComIPduGroupRef=ComIPduGroupRx, PduIdRef=ECUC_CAN_Confort_101, ComIPduSignalGroupRef=SG_BSI_Status_101
        F_IHM_Status_Confort_102: category=IPDU_Rx, ComIPduRxHandleId=19, ComIPduSize=8, ComIpduDirection=RECEIVE, ComIPduGroupRef=ComIPduGroupRx, PduIdRef=ECUC_CAN_Confort_102, ComIPduSignalGroupRef=SG_IHM_Status_102
        F_EXT_Status_Confort_103: category=IPDU_Rx, ComIPduRxHandleId=20, ComIPduSize=8, ComIpduDirection=RECEIVE, ComIPduGroupRef=ComIPduGroupRx, PduIdRef=ECUC_CAN_Confort_103, ComIPduSignalGroupRef=SG_EXT_Status_103
        F_CLASDebugData_Confort_110: category=IPDU_Rx, ComIPduRxHandleId=21, ComIPduSize=8, ComIpduDirection=RECEIVE, ComIPduGroupRef=ComIPduGroupRx, PduIdRef=ECUC_CAN_Confort_110, ComIPduSignalGroupRef=SG_CLASDebugData_110
        F_ADC_Value_A_Confort_7F0: category=IPDU_Tx, ComIPduSize=8, ComIpduDirection=SEND, ComIPduGroupRef=ComIPduGroupTX, PduIdRef=PduCollection/CAN_Confort_7F0, ComIPduSignalGroupRef=SG_ADC_Value_A_7F0
          ComTxIPdu: ComTxIPduUnusedAreasDefault=0, ComTxIPduMinimumDelayTimeFactor=0
            ComTxModeTrue
              ComTxMode: ComTxModeMode=DIRECT, ComTxModeNumberOfRepetitions=0
        F_ADC_Value_B_Confort_7F1: category=IPDU_Tx, ComIPduSize=8, ComIpduDirection=SEND, ComIPduGroupRef=ComIPduGroupTX, PduIdRef=PduCollection/CAN_Confort_7F1, ComIPduSignalGroupRef=SG_ADC_Value_B_7F1
          ComTxIPdu: ComTxIPduUnusedAreasDefault=0, ComTxIPduMinimumDelayTimeFactor=0
            ComTxModeTrue
              ComTxMode: ComTxModeMode=DIRECT, ComTxModeNumberOfRepetitions=0
        F_TOR_Input_Confort_7F2: category=IPDU_Tx, ComIPduSize=8, ComIpduDirection=SEND, ComIPduGroupRef=ComIPduGroupTX, PduIdRef=PduCollection/CAN_Confort_7F2, ComIPduSignalGroupRef=SG_TOR_Input_7F2
          ComTxIPdu: ComTxIPduUnusedAreasDefault=0, ComTxIPduMinimumDelayTimeFactor=0
            ComTxModeTrue
              ComTxMode: ComTxModeMode=DIRECT, ComTxModeNumberOfRepetitions=0
        F_CI_X_AXIS_Value_Confort_7F3: category=IPDU_Tx, ComIPduSize=8, ComIpduDirection=SEND, ComIPduGroupRef=ComIPduGroupTX, PduIdRef=PduCollection/CAN_Confort_7F3, ComIPduSignalGroupRef=SG_CI_X_AXIS_Value_7F3
          ComTxIPdu: ComTxIPduUnusedAreasDefault=0, ComTxIPduMinimumDelayTimeFactor=0
            ComTxModeTrue
              ComTxMode: ComTxModeMode=DIRECT, ComTxModeNumberOfRepetitions=0
        F_CI_Y_AXIS_Value_Confort_7F4: category=IPDU_Tx, ComIPduSize=8, ComIpduDirection=SEND, ComIPduGroupRef=ComIPduGroupTX, PduIdRef=PduCollection/CAN_Confort_7F4, ComIPduSignalGroupRef=SG_CI_Y_AXIS_Value_7F4
          ComTxIPdu: ComTxIPduUnusedAreasDefault=0, ComTxIPduMinimumDelayTimeFactor=0
            ComTxModeTrue
              ComTxMode: ComTxModeMode=DIRECT, ComTxModeNumberOfRepetitions=0
        F_CI_Z_AXIS_Value_Confort_7F5: category=IPDU_Tx, ComIPduSize=8, ComIpduDirection=SEND, ComIPduGroupRef=ComIPduGroupTX, PduIdRef=PduCollection/CAN_Confort_7F5, ComIPduSignalGroupRef=SG_CI_Z_AXIS_Value_7F5
          ComTxIPdu: ComTxIPduUnusedAreasDefault=0, ComTxIPduMinimumDelayTimeFactor=0
            ComTxModeTrue
              ComTxMode: ComTxModeMode=DIRECT, ComTxModeNumberOfRepetitions=0
        F_CI_X_AXIS_Info1_Confort_7F6: category=IPDU_Tx, ComIPduSize=8, ComIpduDirection=SEND, ComIPduGroupRef=ComIPduGroupTX, PduIdRef=PduCollection/CAN_Confort_7F6, ComIPduSignalGroupRef=SG_CI_X_AXIS_Info1_7F6
          ComTxIPdu: ComTxIPduUnusedAreasDefault=0, ComTxIPduMinimumDelayTimeFactor=0
            ComTxModeTrue
              ComTxMode: ComTxModeMode=DIRECT, ComTxModeNumberOfRepetitions=0
        F_CI_X_AXIS_Info2_Confort_7F7: category=IPDU_Tx, ComIPduSize=8, ComIpduDirection=SEND, ComIPduGroupRef=ComIPduGroupTX, PduIdRef=PduCollection/CAN_Confort_7F7, ComIPduSignalGroupRef=SG_CI_X_AXIS_Info2_7F7
          ComTxIPdu: ComTxIPduUnusedAreasDefault=0, ComTxIPduMinimumDelayTimeFactor=0
            ComTxModeTrue
              ComTxMode: ComTxModeMode=DIRECT, ComTxModeNumberOfRepetitions=0
        F_CI_Y_AXIS_Info1_Confort_7F8: category=IPDU_Tx, ComIPduSize=8, ComIpduDirection=SEND, ComIPduGroupRef=ComIPduGroupTX, PduIdRef=PduCollection/CAN_Confort_7F8, ComIPduSignalGroupRef=SG_CI_Y_AXIS_Info1_7F8
          ComTxIPdu: ComTxIPduUnusedAreasDefault=0, ComTxIPduMinimumDelayTimeFactor=0
            ComTxModeTrue
              ComTxMode: ComTxModeMode=DIRECT, ComTxModeNumberOfRepetitions=0
        F_CI_Y_AXIS_Info2_Confort_7F9: category=IPDU_Tx, ComIPduSize=8, ComIpduDirection=SEND, ComIPduGroupRef=ComIPduGroupTX, PduIdRef=PduCollection/CAN_Confort_7F9, ComIPduSignalGroupRef=SG_CI_Y_AXIS_Info2_7F9
          ComTxIPdu: ComTxIPduUnusedAreasDefault=0, ComTxIPduMinimumDelayTimeFactor=0
            ComTxModeTrue
              ComTxMode: ComTxModeMode=DIRECT, ComTxModeNumberOfRepetitions=0
        F_CI_Z_AXIS_Info1_Confort_7FA: category=IPDU_Tx, ComIPduSize=8, ComIpduDirection=SEND, ComIPduGroupRef=ComIPduGroupTX, PduIdRef=PduCollection/CAN_Confort_7FA, ComIPduSignalGroupRef=SG_CI_Z_AXIS_Info1_7FA
          ComTxIPdu: ComTxIPduUnusedAreasDefault=0, ComTxIPduMinimumDelayTimeFactor=0
            ComTxModeTrue
              ComTxMode: ComTxModeMode=DIRECT, ComTxModeNumberOfRepetitions=0
        F_CI_Z_AXIS_Info2_Confort_7FB: category=IPDU_Tx, ComIPduSize=8, ComIpduDirection=SEND, ComIPduGroupRef=ComIPduGroupTX, PduIdRef=PduCollection/CAN_Confort_7FB, ComIPduSignalGroupRef=SG_CI_Z_AXIS_Info2_7FB
          ComTxIPdu: ComTxIPduUnusedAreasDefault=0, ComTxIPduMinimumDelayTimeFactor=0
            ComTxModeTrue
              ComTxMode: ComTxModeMode=DIRECT, ComTxModeNumberOfRepetitions=0
        F_Debug_Reserve_Tx_Confort_7FD: category=IPDU_Tx, ComIPduSize=8, ComIpduDirection=SEND, ComIPduGroupRef=ComIPduGroupTX, PduIdRef=PduCollection/CAN_Confort_7FD, ComIPduSignalGroupRef=SG_Debug_Reserve_Tx_7FD
          ComTxIPdu: ComTxIPduUnusedAreasDefault=0, ComTxIPduMinimumDelayTimeFactor=0
            ComTxModeTrue
              ComTxMode: ComTxModeMode=DIRECT, ComTxModeNumberOfRepetitions=0
        F_TOR_Output_Confort_7FC: category=IPDU_Rx, ComIPduRxHandleId=22, ComIPduSize=2, ComIpduDirection=RECEIVE, ComIPduGroupRef=ComIPduGroupRx, PduIdRef=PduCollection/CAN_Confort_7FC, ComIPduSignalGroupRef=SG_TOR_Output_7FC
        F_Debug_Reserve_Rx_Confort_7FE: category=IPDU_Rx, ComIPduRxHandleId=23, ComIPduSize=8, ComIpduDirection=RECEIVE, ComIPduGroupRef=ComIPduGroupRx, PduIdRef=PduCollection/CAN_Confort_7FE, ComIPduSignalGroupRef=SG_Debug_Reserve_Rx_7FE
      31 x ComSignalGroup, all with ComBitPosition=0, SystemTemplateSignalGroupRef=(unset):
        SG_TOR_Output_7FC: category=SignalGroup_Rx, ComBitSize=16, ComHandleId=2, ComNotification=RxCbk_TOR_Output_7FC
          GS_TOR_OUT_1_7FC (ComGroupSignal):
            ComBitPosition = 0
            ComBitSize = 8
            ComHandleId = 297
            ComSignalEndianess = opaque
            ComSignalInitValue = 0
            ComSignalLength = 1
            ComSignalType = UINT8_N
            SystemTemplateSystemSignalRef = (unset)
          GS_TOR_OUT_2_7FC (ComGroupSignal):
            ComBitPosition = 8
            ComBitSize = 8
            ComHandleId = 32
            ComSignalEndianess = opaque
            ComSignalInitValue = 0
            ComSignalLength = 1
            ComSignalType = UINT8_N
            SystemTemplateSystemSignalRef = (unset)
        SG_Debug_Reserve_Rx_7FE: category=SignalGroup_Rx, ComBitSize=64, ComHandleId=3, ComNotification=RxCbk_Debug_Reserve_Rx_7FE
          8 x ComGroupSignal, all with ComBitSize=8, ComSignalEndianess=opaque, ComSignalInitValue=0, ComSignalLength=1, ComSignalType=UINT8_N, SystemTemplateSystemSignalRef=(unset):
            GS_Data1_7FE: ComBitPosition=0, ComHandleId=33
            GS_Data2_7FE: ComBitPosition=8, ComHandleId=34
            GS_Data3_7FE: ComBitPosition=16, ComHandleId=35
            GS_Data4_7FE: ComBitPosition=24, ComHandleId=36
            GS_Data5_7FE: ComBitPosition=32, ComHandleId=37
            GS_Data6_7FE: ComBitPosition=40, ComHandleId=38
            GS_Data7_7FE: ComBitPosition=48, ComHandleId=39
            GS_Data8_7FE: ComBitPosition=56, ComHandleId=40
        SG_ADC_Value_A_7F0: category=SignalGroup_Tx, ComBitSize=64, ComHandleId=24, ComTransferProperty=TRIGGERED
          4 x ComGroupSignal, all with ComBitSize=16, ComSignalEndianess=opaque, ComSignalInitValue=0, ComSignalLength=2, ComSignalType=UINT8_N, SystemTemplateSystemSignalRef=(unset):
            GS_AngleVolant_A_7F0: ComBitPosition=0, ComHandleId=157
            GS_Pedale_A_7F0: ComBitPosition=16, ComHandleId=158
            GS_AngleCabine_A_7F0: ComBitPosition=32, ComHandleId=159
            GS_Spare_A_7F0: ComBitPosition=48, ComHandleId=160
        SG_ADC_Value_B_7F1: category=SignalGroup_Tx, ComBitSize=64, ComHandleId=25, ComTransferProperty=TRIGGERED
          4 x ComGroupSignal, all with ComBitSize=16, ComSignalEndianess=opaque, ComSignalInitValue=0, ComSignalLength=2, ComSignalType=UINT8_N, SystemTemplateSystemSignalRef=(unset):
            GS_AngleVolant_B_7F1: ComBitPosition=0, ComHandleId=161
            GS_Pedale_B_7F1: ComBitPosition=16, ComHandleId=162
            GS_AngleCabine_B_7F1: ComBitPosition=32, ComHandleId=163
            GS_Spare_B_7F1: ComBitPosition=48, ComHandleId=164
        SG_TOR_Input_7F2: category=SignalGroup_Tx, ComBitSize=64, ComHandleId=26, ComTransferProperty=TRIGGERED
          8 x ComGroupSignal, all with ComBitSize=8, ComSignalEndianess=opaque, ComSignalInitValue=0, ComSignalLength=1, ComSignalType=UINT8_N, SystemTemplateSystemSignalRef=(unset):
            GS_TOR_IN_1_7F2: ComBitPosition=0, ComHandleId=165
            GS_TOR_IN_2_7F2: ComBitPosition=8, ComHandleId=166
            GS_TOR_IN_3_7F2: ComBitPosition=16, ComHandleId=167
            GS_TOR_IN_4_7F2: ComBitPosition=24, ComHandleId=168
            GS_TOR_IN_5_7F2: ComBitPosition=32, ComHandleId=169
            GS_TOR_IN_6_7F2: ComBitPosition=40, ComHandleId=170
            GS_TOR_IN_7_7F2: ComBitPosition=48, ComHandleId=171
            GS_TOR_IN_8_7F2: ComBitPosition=56, ComHandleId=172
        SG_CI_X_AXIS_Value_7F3: category=SignalGroup_Tx, ComBitSize=64, ComHandleId=27, ComTransferProperty=TRIGGERED
          4 x ComGroupSignal, all with ComBitSize=16, ComSignalEndianess=opaque, ComSignalInitValue=0, ComSignalLength=2, ComSignalType=UINT8_N, SystemTemplateSystemSignalRef=(unset):
            GS_CI_X_AXIS_RateMR1X_7F3: ComBitPosition=0, ComHandleId=173
            GS_CI_X_AXIS_RateMR2X_7F3: ComBitPosition=16, ComHandleId=174
            GS_CI_X_AXIS_AccMR1Y_7F3: ComBitPosition=32, ComHandleId=175
            GS_CI_X_AXIS_AccMR2Y_7F3: ComBitPosition=48, ComHandleId=176
        SG_CI_Y_AXIS_Value_7F4: category=SignalGroup_Tx, ComBitSize=64, ComHandleId=28, ComTransferProperty=TRIGGERED
          4 x ComGroupSignal, all with ComBitSize=16, ComSignalEndianess=opaque, ComSignalInitValue=0, ComSignalLength=2, ComSignalType=UINT8_N, SystemTemplateSystemSignalRef=(unset):
            GS_CI_Y_AXIS_RateMR1X_7F4: ComBitPosition=0, ComHandleId=177
            GS_CI_Y_AXIS_RateMR2X_7F4: ComBitPosition=16, ComHandleId=178
            GS_CI_Y_AXIS_AccMR1Y_7F4: ComBitPosition=32, ComHandleId=179
            GS_CI_Y_AXIS_AccMR2Y_7F4: ComBitPosition=48, ComHandleId=180
        SG_CI_Z_AXIS_Value_7F5: category=SignalGroup_Tx, ComBitSize=64, ComHandleId=29, ComTransferProperty=TRIGGERED
          4 x ComGroupSignal, all with ComBitSize=16, ComSignalEndianess=opaque, ComSignalInitValue=0, ComSignalLength=2, ComSignalType=UINT8_N, SystemTemplateSystemSignalRef=(unset):
            GS_CI_Z_AXIS_RateMR1X_7F5: ComBitPosition=0, ComHandleId=181
            GS_CI_Z_AXIS_RateMR2X_7F5: ComBitPosition=16, ComHandleId=182
            GS_CI_Z_AXIS_AccMR1Y_7F5: ComBitPosition=32, ComHandleId=183
            GS_CI_Z_AXIS_AccMR2Y_7F5: ComBitPosition=48, ComHandleId=184
        SG_CI_X_AXIS_Info1_7F6: category=SignalGroup_Tx, ComBitSize=64, ComHandleId=30, ComTransferProperty=TRIGGERED
          3 x ComGroupSignal, all with ComSignalEndianess=opaque, ComSignalInitValue=0, ComSignalType=UINT8_N, SystemTemplateSystemSignalRef=(unset):
            GS_CI_X_AXIS_Temperature_7F6: ComBitPosition=0, ComBitSize=8, ComHandleId=185, ComSignalLength=1
            GS_CI_X_AXIS_Status_Bits_7F6: ComBitPosition=8, ComBitSize=48, ComHandleId=186, ComSignalLength=6
            GS_CI_X_AXIS_Info1_Reserved_7F6: ComBitPosition=56, ComBitSize=8, ComHandleId=187, ComSignalLength=1
        SG_CI_X_AXIS_Info2_7F7: category=SignalGroup_Tx, ComBitSize=64, ComHandleId=31, ComTransferProperty=TRIGGERED
          4 x ComGroupSignal, all with ComSignalEndianess=opaque, ComSignalInitValue=0, ComSignalType=UINT8_N, SystemTemplateSystemSignalRef=(unset):
            GS_CI_X_AXIS_RateHInfo2_7F7: ComBitPosition=0, ComBitSize=8, ComHandleId=188, ComSignalLength=1
            GS_CI_X_AXIS_AccHInfo2_7F7: ComBitPosition=8, ComBitSize=8, ComHandleId=189, ComSignalLength=1
            GS_CI_X_AXIS_Error_Bits_7F7: ComBitPosition=16, ComBitSize=40, ComHandleId=190, ComSignalLength=5
            GS_CI_X_AXIS_Info2_Reserved_7F7: ComBitPosition=56, ComBitSize=8, ComHandleId=191, ComSignalLength=1
        SG_CI_Y_AXIS_Info1_7F8: category=SignalGroup_Tx, ComBitSize=64, ComHandleId=32, ComTransferProperty=TRIGGERED
          3 x ComGroupSignal, all with ComSignalEndianess=opaque, ComSignalInitValue=0, ComSignalType=UINT8_N, SystemTemplateSystemSignalRef=(unset):
            GS_CI_Y_AXIS_Temperature_7F8: ComBitPosition=0, ComBitSize=8, ComHandleId=192, ComSignalLength=1
            GS_CI_Y_AXIS_Status_Bits_7F8: ComBitPosition=8, ComBitSize=48, ComHandleId=193, ComSignalLength=6
            GS_CI_Y_AXIS_Info1_Reserved_7F8: ComBitPosition=56, ComBitSize=8, ComHandleId=194, ComSignalLength=1
        SG_CI_Y_AXIS_Info2_7F9: category=SignalGroup_Tx, ComBitSize=64, ComHandleId=33, ComTransferProperty=TRIGGERED
          4 x ComGroupSignal, all with ComSignalEndianess=opaque, ComSignalInitValue=0, ComSignalType=UINT8_N, SystemTemplateSystemSignalRef=(unset):
            GS_CI_Y_AXIS_RateHInfo2_7F9: ComBitPosition=0, ComBitSize=8, ComHandleId=195, ComSignalLength=1
            GS_CI_Y_AXIS_AccHInfo2_7F9: ComBitPosition=8, ComBitSize=8, ComHandleId=196, ComSignalLength=1
            GS_CI_Y_AXIS_Error_Bits_7F9: ComBitPosition=16, ComBitSize=40, ComHandleId=197, ComSignalLength=5
            GS_CI_Y_AXIS_Info2_Reserved_7F9: ComBitPosition=56, ComBitSize=8, ComHandleId=198, ComSignalLength=1
        SG_CI_Z_AXIS_Info1_7FA: category=SignalGroup_Tx, ComBitSize=64, ComHandleId=34, ComTransferProperty=TRIGGERED
          3 x ComGroupSignal, all with ComSignalEndianess=opaque, ComSignalInitValue=0, ComSignalType=UINT8_N, SystemTemplateSystemSignalRef=(unset):
            GS_CI_Z_AXIS_Temperature_7FA: ComBitPosition=0, ComBitSize=8, ComHandleId=199, ComSignalLength=1
            GS_CI_Z_AXIS_Status_Bits_7FA: ComBitPosition=8, ComBitSize=48, ComHandleId=200, ComSignalLength=6
            GS_CI_Z_AXIS_Info1_Reserved_7FA: ComBitPosition=56, ComBitSize=8, ComHandleId=201, ComSignalLength=1
        SG_CI_Z_AXIS_Info2_7FB: category=SignalGroup_Tx, ComBitSize=64, ComHandleId=35, ComTransferProperty=TRIGGERED
          4 x ComGroupSignal, all with ComSignalEndianess=opaque, ComSignalInitValue=0, ComSignalType=UINT8_N, SystemTemplateSystemSignalRef=(unset):
            GS_CI_Z_AXIS_RateHInfo2_7FB: ComBitPosition=0, ComBitSize=8, ComHandleId=202, ComSignalLength=1
            GS_CI_Z_AXIS_AccHInfo2_7FB: ComBitPosition=8, ComBitSize=8, ComHandleId=203, ComSignalLength=1
            GS_CI_Z_AXIS_Error_Bits_7FB: ComBitPosition=16, ComBitSize=40, ComHandleId=204, ComSignalLength=5
            GS_CI_Z_AXIS_Info2_Reserved_7FB: ComBitPosition=56, ComBitSize=8, ComHandleId=205, ComSignalLength=1
        SG_Debug_Reserve_Tx_7FD: category=SignalGroup_Tx, ComBitSize=64, ComHandleId=36, ComTransferProperty=TRIGGERED
          8 x ComGroupSignal, all with ComBitSize=8, ComSignalEndianess=opaque, ComSignalInitValue=0, ComSignalLength=1, ComSignalType=UINT8_N, SystemTemplateSystemSignalRef=(unset):
            GS_Data1_7FD: ComBitPosition=0, ComHandleId=206
            GS_Data2_7FD: ComBitPosition=8, ComHandleId=207
            GS_Data3_7FD: ComBitPosition=16, ComHandleId=208
            GS_Data4_7FD: ComBitPosition=24, ComHandleId=209
            GS_Data5_7FD: ComBitPosition=32, ComHandleId=210
            GS_Data6_7FD: ComBitPosition=40, ComHandleId=211
            GS_Data7_7FD: ComBitPosition=48, ComHandleId=212
            GS_Data8_7FD: ComBitPosition=56, ComHandleId=213
        SG_CLAS_Status_100: category=SignalGroup_Tx, ComBitSize=64, ComHandleId=37, ComTransferProperty=TRIGGERED
          5 x ComGroupSignal, all with ComSignalInitValue=0, SystemTemplateSystemSignalRef=(unset):
            GS_StatusWord_100: ComBitPosition=0, ComBitSize=8, ComHandleId=214, ComSignalEndianess=opaque, ComSignalLength=1, ComSignalType=UINT8_N
            GS_HeartBeat_100: ComBitPosition=8, ComBitSize=8, ComHandleId=215, ComSignalEndianess=opaque, ComSignalLength=1, ComSignalType=UINT8_N
            GS_Msg1_100: ComBitPosition=16, ComBitSize=16, ComHandleId=216, ComSignalEndianess=LITTLE_ENDIAN, ComSignalType=UINT16
            GS_Msg2_100: ComBitPosition=32, ComBitSize=16, ComHandleId=217, ComSignalEndianess=LITTLE_ENDIAN, ComSignalType=UINT16
            GS_Msg3_100: ComBitPosition=48, ComBitSize=16, ComHandleId=218, ComSignalEndianess=LITTLE_ENDIAN, ComSignalType=UINT16
        SG_BSIDebugData_111: category=SignalGroup_Tx, ComBitSize=64, ComHandleId=38, ComTransferProperty=TRIGGERED
          8 x ComGroupSignal, all with ComBitSize=8, ComSignalEndianess=opaque, ComSignalInitValue=0, ComSignalType=UINT8_N, ComSignalLength=1, SystemTemplateSystemSignalRef=(unset):
            GS_DebugDataID_111: ComBitPosition=0, ComHandleId=219
            GS_DebugData0_111: ComBitPosition=8, ComHandleId=220
            GS_DebugData1_111: ComBitPosition=16, ComHandleId=221
            GS_DebugData2_111: ComBitPosition=24, ComHandleId=222
            GS_DebugData3_111: ComBitPosition=32, ComHandleId=223
            GS_DebugData4_111: ComBitPosition=40, ComHandleId=224
            GS_DebugData5_111: ComBitPosition=48, ComHandleId=225
            GS_DebugData6_111: ComBitPosition=56, ComHandleId=226
        SG_IHMDebugData_112: category=SignalGroup_Tx, ComBitSize=64, ComHandleId=39, ComTransferProperty=TRIGGERED
          8 x ComGroupSignal, all with ComBitSize=8, ComSignalEndianess=opaque, ComSignalInitValue=0, ComSignalType=UINT8_N, ComSignalLength=1, SystemTemplateSystemSignalRef=(unset):
            GS_DebugDataID_112: ComBitPosition=0, ComHandleId=227
            GS_DebugData0_112: ComBitPosition=8, ComHandleId=228
            GS_DebugData1_112: ComBitPosition=16, ComHandleId=229
            GS_DebugData2_112: ComBitPosition=24, ComHandleId=230
            GS_DebugData3_112: ComBitPosition=32, ComHandleId=231
            GS_DebugData4_112: ComBitPosition=40, ComHandleId=232
            GS_DebugData5_112: ComBitPosition=48, ComHandleId=233
            GS_DebugData6_112: ComBitPosition=56, ComHandleId=234
        SG_EXTDebugData_113: category=SignalGroup_Tx, ComBitSize=64, ComHandleId=40, ComTransferProperty=TRIGGERED
          8 x ComGroupSignal, all with ComBitSize=8, ComSignalEndianess=opaque, ComSignalInitValue=0, ComSignalType=UINT8_N, ComSignalLength=1, SystemTemplateSystemSignalRef=(unset):
            GS_DebugDataID_113: ComBitPosition=0, ComHandleId=235
            GS_DebugData0_113: ComBitPosition=8, ComHandleId=236
            GS_DebugData1_113: ComBitPosition=16, ComHandleId=237
            GS_DebugData2_113: ComBitPosition=24, ComHandleId=238
            GS_DebugData3_113: ComBitPosition=32, ComHandleId=239
            GS_DebugData4_113: ComBitPosition=40, ComHandleId=240
            GS_DebugData5_113: ComBitPosition=48, ComHandleId=241
            GS_DebugData6_113: ComBitPosition=56, ComHandleId=242
        SG_CLASToIHM_500: category=SignalGroup_Tx, ComBitSize=64, ComHandleId=41, ComTransferProperty=PENDING
          8 x ComGroupSignal, all with ComBitSize=8, ComSignalInitValue=0, SystemTemplateSystemSignalRef=(unset):
            GS_CarModeState_500: ComBitPosition=0, ComHandleId=243, ComSignalEndianess=opaque, ComSignalType=UINT8_N, ComSignalLength=1
            GS_CruiseControlSpeedLimitor_500: ComBitPosition=8, ComHandleId=244, ComSignalEndianess=opaque, ComSignalType=UINT8_N, ComSignalLength=1
            GS_Power_500: ComBitPosition=16, ComHandleId=245, ComSignalEndianess=opaque, ComSignalType=UINT8_N, ComSignalLength=1
            GS_Tilting_500: ComBitPosition=24, ComHandleId=246, ComSignalEndianess=LITTLE_ENDIAN, ComSignalType=SINT8
            GS_Warning_500: ComBitPosition=32, ComHandleId=247, ComSignalEndianess=opaque, ComSignalType=UINT8_N, ComSignalLength=1
            GS_RangeEstimate_500: ComBitPosition=40, ComHandleId=248, ComSignalEndianess=opaque, ComSignalType=UINT8_N, ComSignalLength=1
            GS_TBD1_500: ComBitPosition=48, ComHandleId=249, ComSignalEndianess=opaque, ComSignalType=UINT8_N, ComSignalLength=1
            GS_TBD2_500: ComBitPosition=56, ComHandleId=250, ComSignalEndianess=opaque, ComSignalType=UINT8_N, ComSignalLength=1
        SG_RightSKAI_SingleInverter_CommandData_210: category=SignalGroup_Tx, ComBitSize=64, ComHandleId=42, ComTransferProperty=TRIGGERED
          4 x ComGroupSignal, all with ComSignalInitValue=0, SystemTemplateSystemSignalRef=(unset):
            GS_SkaiMode_210: ComBitPosition=0, ComBitSize=8, ComHandleId=251, ComSignalEndianess=opaque, ComSignalLength=1, ComSignalType=UINT8_N
            GS_StayAliveCounter_210: ComBitPosition=8, ComBitSize=8, ComHandleId=252, ComSignalEndianess=opaque, ComSignalLength=1, ComSignalType=UINT8_N
            GS_TorqueCommand_210: ComBitPosition=32, ComBitSize=16, ComHandleId=253, ComSignalEndianess=LITTLE_ENDIAN, ComSignalType=SINT16
            GS_RPMmax_210: ComBitPosition=48, ComBitSize=16, ComHandleId=254, ComSignalEndianess=LITTLE_ENDIAN, ComSignalType=UINT16
        SG_LeftSKAI_SingleInverter_CommandData_213: category=SignalGroup_Tx, ComBitSize=64, ComHandleId=43, ComTransferProperty=TRIGGERED
          4 x ComGroupSignal, all with ComSignalInitValue=0, SystemTemplateSystemSignalRef=(unset):
            GS_SkaiMode_213: ComBitPosition=0, ComBitSize=8, ComHandleId=255, ComSignalEndianess=opaque, ComSignalLength=1, ComSignalType=UINT8_N
            GS_StayAliveCounter_213: ComBitPosition=8, ComBitSize=8, ComHandleId=256, ComSignalEndianess=opaque, ComSignalLength=1, ComSignalType=UINT8_N
            GS_TorqueCommand_213: ComBitPosition=32, ComBitSize=16, ComHandleId=257, ComSignalEndianess=LITTLE_ENDIAN, ComSignalType=SINT16
            GS_RPMmax_213: ComBitPosition=48, ComBitSize=16, ComHandleId=258, ComSignalEndianess=LITTLE_ENDIAN, ComSignalType=UINT16
        SG_RightSKAI_SingleInverter_ClearError_610: category=SignalGroup_Tx, ComBitSize=32, ComHandleId=44, ComTransferProperty=TRIGGERED
          GS_0x23x20x10x00_610 (ComGroupSignal):
            ComBitPosition = 0
            ComBitSize = 32
            ComHandleId = 259
            ComSignalEndianess = opaque
            ComSignalInitValue = 1056803
            ComSignalLength = 4
            ComSignalType = UINT8_N
            SystemTemplateSystemSignalRef = (unset)
        SG_LeftSKAI_SingleInverter_ClearError_613: category=SignalGroup_Tx, ComBitSize=32, ComHandleId=45, ComTransferProperty=TRIGGERED
          GS_0x23x20x10x00_613 (ComGroupSignal):
            ComBitPosition = 0
            ComBitSize = 32
            ComHandleId = 260
            ComSignalEndianess = opaque
            ComSignalInitValue = 1056803
            ComSignalLength = 4
            ComSignalType = UINT8_N
            SystemTemplateSystemSignalRef = (unset)
        SG_CopleyAccelnetAmplifier_CommandData_201: category=SignalGroup_Tx, ComBitSize=40, ComHandleId=46, ComTransferProperty=TRIGGERED
          3 x ComGroupSignal, all with ComSignalInitValue=0, SystemTemplateSystemSignalRef=(unset):
            GS_ControlWord_201: ComBitPosition=0, ComBitSize=16, ComHandleId=261, ComSignalEndianess=LITTLE_ENDIAN, ComSignalType=UINT16
            GS_ModeOfOperation_201: ComBitPosition=16, ComBitSize=8, ComHandleId=262, ComSignalEndianess=opaque, ComSignalLength=1, ComSignalType=UINT8_N
            GS_TorqueCommand_201: ComBitPosition=24, ComBitSize=16, ComHandleId=263, ComSignalEndianess=LITTLE_ENDIAN, ComSignalType=SINT16
        SG_CopleyAccelnetAmplifier_Mode_000: category=SignalGroup_Tx, ComBitSize=16, ComHandleId=47, ComTransferProperty=TRIGGERED
          GS_AccelnetModeData1_000 (ComGroupSignal):
            ComBitPosition = 0
            ComBitSize = 8
            ComHandleId = 264
            ComSignalEndianess = opaque
            ComSignalInitValue = 0
            ComSignalLength = 1
            ComSignalType = UINT8_N
            SystemTemplateSystemSignalRef = (unset)
          GS_AccelnetModeData2_000 (ComGroupSignal):
            ComBitPosition = 8
            ComBitSize = 8
            ComHandleId = 265
            ComSignalEndianess = opaque
            ComSignalInitValue = 0
            ComSignalLength = 1
            ComSignalType = UINT8_N
            SystemTemplateSystemSignalRef = (unset)
        SG_CopleyAccelnetAmplifier_ConfigurationTxFrame_601: category=SignalGroup_Tx, ComBitSize=64, ComHandleId=48, ComTransferProperty=TRIGGERED, ComNotification=TxCbk_CopleyAccelnetAmplifier_ConfigurationTxFrame_601
          7 x ComGroupSignal, all with ComSignalInitValue=0, SystemTemplateSystemSignalRef=(unset):
            GS_Command_601: ComBitPosition=0, ComBitSize=8, ComHandleId=266, ComSignalEndianess=opaque, ComSignalLength=1, ComSignalType=UINT8_N
            GS_Index_601: ComBitPosition=8, ComBitSize=16, ComHandleId=267, ComSignalEndianess=LITTLE_ENDIAN, ComSignalType=UINT16
            GS_SubIndex_601: ComBitPosition=24, ComBitSize=8, ComHandleId=268, ComSignalEndianess=LITTLE_ENDIAN, ComSignalLength=1, ComSignalType=UINT8_N
            GS_ConfigData0_601: ComBitPosition=32, ComBitSize=8, ComHandleId=269, ComSignalEndianess=opaque, ComSignalLength=1, ComSignalType=UINT8_N
            GS_ConfigData1_601: ComBitPosition=40, ComBitSize=8, ComHandleId=270, ComSignalEndianess=opaque, ComSignalLength=1, ComSignalType=UINT8_N
            GS_ConfigData2_601: ComBitPosition=48, ComBitSize=8, ComHandleId=271, ComSignalEndianess=opaque, ComSignalLength=1, ComSignalType=UINT8_N
            GS_ConfigData3_601: ComBitPosition=56, ComBitSize=8, ComHandleId=272, ComSignalEndianess=opaque, ComSignalLength=1, ComSignalType=UINT8_N
        SG_IMMOData_591: category=SignalGroup_Tx, ComBitSize=64, ComHandleId=49, ComTransferProperty=TRIGGERED
          8 x ComGroupSignal, all with ComBitSize=8, ComSignalEndianess=opaque, ComSignalInitValue=0, ComSignalType=UINT8_N, ComSignalLength=1, SystemTemplateSystemSignalRef=(unset):
            GS_Command_591: ComBitPosition=0, ComHandleId=273
            GS_Data0_591: ComBitPosition=8, ComHandleId=274
            GS_Data1_591: ComBitPosition=16, ComHandleId=275
            GS_Data2_591: ComBitPosition=24, ComHandleId=276
            GS_Data3_591: ComBitPosition=32, ComHandleId=277
            GS_Data4_591: ComBitPosition=40, ComHandleId=278
            GS_Data5_591: ComBitPosition=48, ComHandleId=279
            GS_Data6_591: ComBitPosition=56, ComHandleId=280
        SG_IMMODiagConfiguration_594: category=SignalGroup_Tx, ComBitSize=64, ComHandleId=50, ComTransferProperty=TRIGGERED
          8 x ComGroupSignal, all with ComBitSize=8, ComSignalEndianess=opaque, ComSignalInitValue=0, ComSignalType=UINT8_N, ComSignalLength=1, SystemTemplateSystemSignalRef=(unset):
            GS_Command_594: ComBitPosition=0, ComHandleId=281
            GS_Data0_594: ComBitPosition=8, ComHandleId=282
            GS_Data1_594: ComBitPosition=16, ComHandleId=283
            GS_Data2_594: ComBitPosition=24, ComHandleId=284
            GS_Data3_594: ComBitPosition=32, ComHandleId=285
            GS_Data4_594: ComBitPosition=40, ComHandleId=286
            GS_Data5_594: ComBitPosition=48, ComHandleId=287
            GS_Data6_594: ComBitPosition=56, ComHandleId=288
        SG_IMMORcuConfiguration_595: category=SignalGroup_Tx, ComBitSize=64, ComHandleId=51, ComTransferProperty=TRIGGERED
          8 x ComGroupSignal, all with ComBitSize=8, ComSignalEndianess=opaque, ComSignalInitValue=0, ComSignalType=UINT8_N, ComSignalLength=1, SystemTemplateSystemSignalRef=(unset):
            GS_Command_595: ComBitPosition=0, ComHandleId=289
            GS_Data0_595: ComBitPosition=8, ComHandleId=290
            GS_Data1_595: ComBitPosition=16, ComHandleId=291
            GS_Data2_595: ComBitPosition=24, ComHandleId=292
            GS_Data3_595: ComBitPosition=32, ComHandleId=293
            GS_Data4_595: ComBitPosition=40, ComHandleId=294
            GS_Data5_595: ComBitPosition=48, ComHandleId=295
            GS_Data6_595: ComBitPosition=56, ComHandleId=296
        SG_CopleyAccelnetAmplifierConfigurationRxFrame_581: category=SignalGroup_Rx, ComBitSize=64, ComHandleId=4, ComNotification=RxCbk_CopleyAccelnetAmplifierConfigurationRxFrame_581
          7 x ComGroupSignal, all with ComSignalInitValue=0, SystemTemplateSystemSignalRef=(unset):
            GS_Command_581: ComBitPosition=0, ComBitSize=8, ComHandleId=41, ComSignalEndianess=opaque, ComSignalLength=1, ComSignalType=UINT8_N
            GS_Index_581: ComBitPosition=8, ComBitSize=16, ComHandleId=42, ComSignalEndianess=LITTLE_ENDIAN, ComSignalType=UINT16
            GS_SubIndex_581: ComBitPosition=24, ComBitSize=8, ComHandleId=43, ComSignalEndianess=opaque, ComSignalLength=1, ComSignalType=UINT8_N
            GS_ConfigData0_581: ComBitPosition=32, ComBitSize=8, ComHandleId=44, ComSignalEndianess=opaque, ComSignalLength=1, ComSignalType=UINT8_N
            GS_ConfigData1_581: ComBitPosition=40, ComBitSize=8, ComHandleId=45, ComSignalEndianess=opaque, ComSignalLength=1, ComSignalType=UINT8_N
            GS_ConfigData2_581: ComBitPosition=48, ComBitSize=8, ComHandleId=46, ComSignalEndianess=opaque, ComSignalLength=1, ComSignalType=UINT8_N
            GS_ConfigData3_581: ComBitPosition=56, ComBitSize=8, ComHandleId=47, ComSignalEndianess=opaque, ComSignalLength=1, ComSignalType=UINT8_N
      4 x ComIPdu, all with category=IPDU_Rx, ComIPduSignalProcessing=DEFERED, ComIPduSize=8, ComIpduDirection=RECEIVE, ComIPduGroupRef=ComIPduGroupRx:
        F_ACTIA_CellVoltage_Confort_203: ComIPduRxHandleId=24, PduIdRef=ECUC_CAN_Confort_203, ComIPduSignalRef=S_0x07_203, ComIPduSignalRef=S_AverageCell_Voltage_203, ComIPduSignalRef=S_MinCellVoltage_203, ComIPduSignalRef=S_MaxCellVoltage_203
        F_IMMODiagConfiguration_Confort_592: ComIPduRxHandleId=25, PduIdRef=ECUC_CAN_Confort_592, ComIPduSignalGroupRef=SG_IMMODiagConfiguration_592
        F_IMMORcuConfiguration_Confort_593: ComIPduRxHandleId=26, PduIdRef=ECUC_CAN_Confort_593, ComIPduSignalGroupRef=SG_IMMORcuConfiguration_593
        F_IMMOData_Confort_603: ComIPduRxHandleId=27, PduIdRef=ECUC_CAN_Confort_603, ComIPduSignalGroupRef=SG_IMMODataConfiguration_603
      17 x ComSignalGroup, all with category=SignalGroup_Rx, ComBitPosition=0, SystemTemplateSignalGroupRef=(unset):
        SG_CopleyAccelnetAmplifierPDO1_181: ComBitSize=64, ComHandleId=5, ComNotification=RxCbk_CopleyAccelnetAmplifierPDO1_181
          3 x ComGroupSignal, all with ComSignalEndianess=LITTLE_ENDIAN, ComSignalInitValue=0, SystemTemplateSystemSignalRef=(unset):
            GS_StatusWord_181: ComBitPosition=0, ComBitSize=16, ComHandleId=48, ComSignalType=UINT16
            GS_EncoderPosition_181: ComBitPosition=16, ComBitSize=32, ComHandleId=49, ComSignalType=SINT32
            GS_ActualCurrent_181: ComBitPosition=48, ComBitSize=16, ComHandleId=50, ComSignalType=SINT16
        SG_BoschSteeringWheelSensorData_305: ComBitSize=48, ComHandleId=6, ComNotification=RxCbk_BoschSteeringWheelSensorData_305
          5 x ComGroupSignal, all with ComSignalInitValue=0, SystemTemplateSystemSignalRef=(unset):
            GS_SteeringWheelAngle_305: ComBitPosition=8, ComBitSize=16, ComHandleId=51, ComSignalEndianess=BIG_ENDIAN, ComSignalType=SINT16
            GS_SteeringWheelSpeed_305: ComBitPosition=16, ComBitSize=8, ComHandleId=52, ComSignalEndianess=opaque, ComSignalType=UINT8_N, ComSignalLength=1
            GS_StatusWord_305: ComBitPosition=24, ComBitSize=8, ComHandleId=53, ComSignalEndianess=opaque, ComSignalType=UINT8_N, ComSignalLength=1
            GS_CheckSumCounter_305: ComBitPosition=32, ComBitSize=8, ComHandleId=54, ComSignalEndianess=opaque, ComSignalType=UINT8_N, ComSignalLength=1
            GS_SteeringWheelSpeed2_305: ComBitPosition=40, ComBitSize=8, ComHandleId=55, ComSignalEndianess=opaque, ComSignalType=UINT8_N, ComSignalLength=1
        SG_BSI_Status_101: ComBitSize=64, ComHandleId=7, ComNotification=RxCbk_BSI_Status_101
          5 x ComGroupSignal, all with ComSignalInitValue=0, SystemTemplateSystemSignalRef=(unset):
            GS_StatusWord_101: ComBitPosition=0, ComBitSize=8, ComHandleId=56, ComSignalEndianess=opaque, ComSignalType=UINT8_N, ComSignalLength=1
            GS_HeartBeat_101: ComBitPosition=8, ComBitSize=8, ComHandleId=57, ComSignalEndianess=opaque, ComSignalType=UINT8_N, ComSignalLength=1
            GS_Msg1_101: ComBitPosition=16, ComBitSize=16, ComHandleId=58, ComSignalEndianess=LITTLE_ENDIAN, ComSignalType=UINT16
            GS_Msg2_101: ComBitPosition=32, ComBitSize=16, ComHandleId=59, ComSignalEndianess=LITTLE_ENDIAN, ComSignalType=UINT16
            GS_Msg3_101: ComBitPosition=48, ComBitSize=16, ComHandleId=60, ComSignalEndianess=LITTLE_ENDIAN, ComSignalType=UINT16
        SG_IHM_Status_102: ComBitSize=64, ComHandleId=8, ComNotification=RxCbk_IHM_Status_102
          5 x ComGroupSignal, all with ComSignalInitValue=0, SystemTemplateSystemSignalRef=(unset):
            GS_StatusWord_102: ComBitPosition=0, ComBitSize=8, ComHandleId=61, ComSignalEndianess=opaque, ComSignalType=UINT8_N, ComSignalLength=1
            GS_HeartBeat_102: ComBitPosition=8, ComBitSize=8, ComHandleId=62, ComSignalEndianess=opaque, ComSignalType=UINT8_N, ComSignalLength=1
            GS_Msg1_102: ComBitPosition=16, ComBitSize=16, ComHandleId=63, ComSignalEndianess=LITTLE_ENDIAN, ComSignalType=UINT16
            GS_Msg2_102: ComBitPosition=32, ComBitSize=16, ComHandleId=64, ComSignalEndianess=LITTLE_ENDIAN, ComSignalType=UINT16
            GS_Msg3_102: ComBitPosition=48, ComBitSize=16, ComHandleId=65, ComSignalEndianess=LITTLE_ENDIAN, ComSignalType=UINT16
        SG_EXT_Status_103: ComBitSize=64, ComHandleId=9, ComNotification=RxCbk_EXT_Status_103
          5 x ComGroupSignal, all with ComSignalInitValue=0, SystemTemplateSystemSignalRef=(unset):
            GS_StatusWord_103: ComBitPosition=0, ComBitSize=8, ComHandleId=66, ComSignalEndianess=opaque, ComSignalType=UINT8_N, ComSignalLength=1
            GS_HeartBeat_103: ComBitPosition=8, ComBitSize=8, ComHandleId=67, ComSignalEndianess=opaque, ComSignalType=UINT8_N, ComSignalLength=1
            GS_Msg1_103: ComBitPosition=16, ComBitSize=16, ComHandleId=68, ComSignalEndianess=LITTLE_ENDIAN, ComSignalType=UINT16
            GS_Msg2_103: ComBitPosition=32, ComBitSize=16, ComHandleId=69, ComSignalEndianess=LITTLE_ENDIAN, ComSignalType=UINT16
            GS_Msg3_103: ComBitPosition=48, ComBitSize=16, ComHandleId=70, ComSignalEndianess=LITTLE_ENDIAN, ComSignalType=UINT16
        SG_CLASDebugData_110: ComBitSize=64, ComHandleId=10
          8 x ComGroupSignal, all with ComBitSize=8, ComSignalEndianess=opaque, ComSignalInitValue=0, ComSignalType=UINT8_N, ComSignalLength=1, SystemTemplateSystemSignalRef=(unset):
            GS_DebugDataID_110: ComBitPosition=0, ComHandleId=71
            GS_DebugData0_110: ComBitPosition=8, ComHandleId=72
            GS_DebugData1_110: ComBitPosition=16, ComHandleId=73
            GS_DebugData2_110: ComBitPosition=24, ComHandleId=74
            GS_DebugData3_110: ComBitPosition=32, ComHandleId=75
            GS_DebugData4_110: ComBitPosition=40, ComHandleId=76
            GS_DebugData5_110: ComBitPosition=48, ComHandleId=77
            GS_DebugData6_110: ComBitPosition=56, ComHandleId=78
        SG_RightSKAISingleInverterErrorDebug_190: ComBitSize=64, ComHandleId=11, ComNotification=RxCbk_RightSKAISingleInverterErrorDebug_190
          7 x ComGroupSignal, all with ComSignalInitValue=0, SystemTemplateSystemSignalRef=(unset):
            GS_ModeOfOperation_190: ComBitPosition=0, ComBitSize=8, ComHandleId=79, ComSignalEndianess=opaque, ComSignalType=UINT8_N, ComSignalLength=1
            GS_PowerModuleError_190: ComBitPosition=8, ComBitSize=8, ComHandleId=80, ComSignalEndianess=opaque, ComSignalType=UINT8_N, ComSignalLength=1
            GS_HardwareError_190: ComBitPosition=16, ComBitSize=8, ComHandleId=81, ComSignalEndianess=opaque, ComSignalType=UINT8_N, ComSignalLength=1
            GS_DriveError_190: ComBitPosition=24, ComBitSize=8, ComHandleId=82, ComSignalEndianess=opaque, ComSignalType=UINT8_N, ComSignalLength=1
            GS_DriveWarning_190: ComBitPosition=32, ComBitSize=8, ComHandleId=83, ComSignalEndianess=opaque, ComSignalType=UINT8_N, ComSignalLength=1
            GS_Unused_190: ComBitPosition=40, ComBitSize=8, ComHandleId=84, ComSignalEndianess=opaque, ComSignalType=UINT8_N, ComSignalLength=1
            GS_NominalTorque_190: ComBitPosition=48, ComBitSize=16, ComHandleId=85, ComSignalEndianess=LITTLE_ENDIAN, ComSignalType=UINT16
        SG_RightSKAISingleInverterData1_Chassis_290: ComBitSize=64, ComHandleId=12, ComNotification=RxCbk_RightSKAISingleInverterData1_Chassis_290
          4 x ComGroupSignal, all with ComBitSize=16, ComSignalEndianess=LITTLE_ENDIAN, ComSignalInitValue=0, ComSignalType=SINT16, SystemTemplateSystemSignalRef=(unset):
            GS_ActualTorque_290: ComBitPosition=0, ComHandleId=86
            GS_AbsoluteCurrent_290: ComBitPosition=16, ComHandleId=87
            GS_BatteryVoltage_290: ComBitPosition=32, ComHandleId=88
            GS_IqCurrent_290: ComBitPosition=48, ComHandleId=89
        SG_RightSKAISingleInverterData2_Chassis_390: ComBitSize=64, ComHandleId=13, ComNotification=RxCbk_RightSKAISingleInverterData2_Chassis_390
          4 x ComGroupSignal, all with ComBitSize=16, ComSignalEndianess=LITTLE_ENDIAN, ComSignalInitValue=0, SystemTemplateSystemSignalRef=(unset):
            GS_MotorSpeed_390: ComBitPosition=0, ComHandleId=90, ComSignalType=SINT16
            GS_LifeTimeCounter_390: ComBitPosition=16, ComHandleId=91, ComSignalType=UINT16
            GS_ThetaElec_390: ComBitPosition=32, ComHandleId=92, ComSignalType=SINT16
            GS_IdCurrent_390: ComBitPosition=48, ComHandleId=93, ComSignalType=SINT16
        SG_RightSKAISingleInverterData3_Chassis_490: ComBitSize=64, ComHandleId=14, ComNotification=RxCbk_RightSKAISingleInverterData3_Chassis_490
          5 x ComGroupSignal, all with ComSignalInitValue=0, SystemTemplateSystemSignalRef=(unset):
            GS_MotorTemperature_490: ComBitPosition=0, ComBitSize=16, ComHandleId=94, ComSignalEndianess=LITTLE_ENDIAN, ComSignalType=SINT16
            GS_InverterTemperature1_490: ComBitPosition=16, ComBitSize=16, ComHandleId=95, ComSignalEndianess=LITTLE_ENDIAN, ComSignalType=UINT16
            GS_InverterTemperature2_490: ComBitPosition=32, ComBitSize=16, ComHandleId=96, ComSignalEndianess=LITTLE_ENDIAN, ComSignalType=SINT16
            GS_HallSector_490: ComBitPosition=48, ComBitSize=8, ComHandleId=97, ComSignalEndianess=opaque, ComSignalType=UINT8_N, ComSignalLength=1
            GS_Unused_490: ComBitPosition=56, ComBitSize=8, ComHandleId=98, ComSignalEndianess=opaque, ComSignalType=UINT8_N, ComSignalLength=1
        SG_LeftSKAISingleInverterErrorDebug_Chassis_193: ComBitSize=64, ComHandleId=15, ComNotification=RxCbk_LeftSKAISingleInverterErrorDebug_Chassis_193
          7 x ComGroupSignal, all with ComSignalInitValue=0, SystemTemplateSystemSignalRef=(unset):
            GS_ModeOfOperation_193: ComBitPosition=0, ComBitSize=8, ComHandleId=99, ComSignalEndianess=opaque, ComSignalType=UINT8_N, ComSignalLength=1
            GS_PowerModuleError_193: ComBitPosition=8, ComBitSize=8, ComHandleId=100, ComSignalEndianess=opaque, ComSignalType=UINT8_N, ComSignalLength=1
            GS_HardwareError_193: ComBitPosition=16, ComBitSize=8, ComHandleId=101, ComSignalEndianess=opaque, ComSignalType=UINT8_N, ComSignalLength=1
            GS_DriveError_193: ComBitPosition=24, ComBitSize=8, ComHandleId=102, ComSignalEndianess=opaque, ComSignalType=UINT8_N, ComSignalLength=1
            GS_DriveWarning_193: ComBitPosition=32, ComBitSize=8, ComHandleId=103, ComSignalEndianess=opaque, ComSignalType=UINT8_N, ComSignalLength=1
            GS_Unused_193: ComBitPosition=40, ComBitSize=8, ComHandleId=104, ComSignalEndianess=opaque, ComSignalType=UINT8_N, ComSignalLength=1
            GS_NominalTorque_193: ComBitPosition=48, ComBitSize=16, ComHandleId=105, ComSignalEndianess=LITTLE_ENDIAN, ComSignalType=UINT16
        SG_LeftSKAISingleInverterData1_Chassis_293: ComBitSize=64, ComHandleId=16, ComNotification=RxCbk_LeftSKAISingleInverterData1_Chassis_293
          4 x ComGroupSignal, all with ComBitSize=16, ComSignalEndianess=LITTLE_ENDIAN, ComSignalInitValue=0, ComSignalType=SINT16, SystemTemplateSystemSignalRef=(unset):
            GS_ActualTorque_293: ComBitPosition=0, ComHandleId=106
            GS_AbsoluteCurrent_293: ComBitPosition=16, ComHandleId=107
            GS_BatteryVoltage_293: ComBitPosition=32, ComHandleId=108
            GS_IqCurrent_293: ComBitPosition=48, ComHandleId=109
        SG_LeftSKAISingleInverterData2_Chassis_393: ComBitSize=64, ComHandleId=17, ComNotification=RxCbk_LeftSKAISingleInverterData2_Chassis_393
          4 x ComGroupSignal, all with ComBitSize=16, ComSignalEndianess=LITTLE_ENDIAN, ComSignalInitValue=0, SystemTemplateSystemSignalRef=(unset):
            GS_MotorSpeed_393: ComBitPosition=0, ComHandleId=110, ComSignalType=SINT16
            GS_LifeTimeCounter_393: ComBitPosition=16, ComHandleId=111, ComSignalType=UINT16
            GS_ThetaElec_393: ComBitPosition=32, ComHandleId=112, ComSignalType=SINT16
            GS_IdCurrent_393: ComBitPosition=48, ComHandleId=113, ComSignalType=SINT16
        SG_LeftSKAISingleInverterData3_Chassis_493: ComBitSize=64, ComHandleId=18, ComNotification=RxCbk_LeftSKAISingleInverterData3_Chassis_493
          5 x ComGroupSignal, all with ComSignalInitValue=0, SystemTemplateSystemSignalRef=(unset):
            GS_MotorTemperature_493: ComBitPosition=0, ComBitSize=16, ComHandleId=114, ComSignalEndianess=LITTLE_ENDIAN, ComSignalType=SINT16
            GS_InverterTemperature1_493: ComBitPosition=16, ComBitSize=16, ComHandleId=115, ComSignalEndianess=LITTLE_ENDIAN, ComSignalType=UINT16
            GS_InverterTemperature2_493: ComBitPosition=32, ComBitSize=16, ComHandleId=116, ComSignalEndianess=LITTLE_ENDIAN, ComSignalType=SINT16
            GS_HallSector_493: ComBitPosition=48, ComBitSize=8, ComHandleId=117, ComSignalEndianess=opaque, ComSignalType=UINT8_N, ComSignalLength=1
            GS_Unused_493: ComBitPosition=56, ComBitSize=8, ComHandleId=118, ComSignalEndianess=opaque, ComSignalType=UINT8_N, ComSignalLength=1
        SG_IMMODiagConfiguration_592: ComBitSize=64, ComHandleId=19, ComNotification=RxCbk_IMMODiagConfiguration_592
          8 x ComGroupSignal, all with ComBitSize=8, ComSignalEndianess=opaque, ComSignalInitValue=0, ComSignalLength=1, ComSignalType=UINT8_N, SystemTemplateSystemSignalRef=(unset):
            GS_Command_592: ComBitPosition=0, ComHandleId=119
            GS_Data0_592: ComBitPosition=8, ComHandleId=120
            GS_Data1_592: ComBitPosition=16, ComHandleId=121
            GS_Data2_592: ComBitPosition=24, ComHandleId=122
            GS_Data3_592: ComBitPosition=32, ComHandleId=123
            GS_Data4_592: ComBitPosition=40, ComHandleId=124
            GS_Data5_592: ComBitPosition=48, ComHandleId=125
            GS_Data6_592: ComBitPosition=56, ComHandleId=126
        SG_IMMORcuConfiguration_593: ComBitSize=64, ComHandleId=20, ComNotification=RxCbk_IMMORcuConfiguration_593
          8 x ComGroupSignal, all with ComBitSize=8, ComSignalEndianess=opaque, ComSignalInitValue=0, ComSignalLength=1, ComSignalType=UINT8_N, SystemTemplateSystemSignalRef=(unset):
            GS_Command_593: ComBitPosition=0, ComHandleId=127
            GS_Data0_593: ComBitPosition=8, ComHandleId=128
            GS_Data1_593: ComBitPosition=16, ComHandleId=129
            GS_Data2_593: ComBitPosition=24, ComHandleId=130
            GS_Data3_593: ComBitPosition=32, ComHandleId=131
            GS_Data4_593: ComBitPosition=40, ComHandleId=132
            GS_Data5_593: ComBitPosition=48, ComHandleId=133
            GS_Data6_593: ComBitPosition=56, ComHandleId=134
        SG_IMMODataConfiguration_603: ComBitSize=64, ComHandleId=21, ComNotification=RxCbk_IMMODataConfiguration_603
          9 x ComGroupSignal, all with ComBitSize=8, ComSignalEndianess=opaque, ComSignalInitValue=0, ComSignalLength=1, ComSignalType=UINT8_N, SystemTemplateSystemSignalRef=(unset):
            GS_Command_603: ComBitPosition=0, ComHandleId=135
            GS_Data0_603: ComBitPosition=8, ComHandleId=136
            GS_Data1_603: ComBitPosition=16, ComHandleId=137
            GS_Data2_603: ComBitPosition=24, ComHandleId=138
            GS_Data2duplicated_603: ComBitPosition=24, ComHandleId=139
            GS_Data3_603: ComBitPosition=32, ComHandleId=140
            GS_Data4_603: ComBitPosition=40, ComHandleId=141
            GS_Data5_603: ComBitPosition=48, ComHandleId=142
            GS_Data6_603: ComBitPosition=56, ComHandleId=143
    ComGeneral:
      ComConfigurationTimeBase = 0.0010
      ComConfigurationUseDet = true
      ComVersionInfoApi = true
      ComRteCbkIncludeFile = Cdd_Common_Bsw.h
      ComPduRGeneralRef = PduRGeneral
      ComCanIfInitConfigurationRef = CanIfInitConfiguration
  module config PduR_Config: definition=PduR, implementation-config-variant=VARIANT-PRE-COMPILE, module-description=PduR_Impl
    PduRGeneral:
      PduRCanIfSupport = true
      PduRCanTpSupport = false
      PduRComSupport = true
      PduRDcmSupport = false
      PduRDevErrorDetect = true
      PduRFifoTxBufferSupport = false
      PduRFrIfSupport = false
      PduRFrTpSupport = false
      PduRGatewayOperation = false
      PduRIPduMSupport = false
      PduRLinIfSupport = false
      PduRLinTpSupport = false
      PduRMemorySize = 0
      PduRMulticastFromIfSupport = false
      PduRMulticastFromTpSupport = false
      PduRMulticastToIfSupport = false
      PduRMulticastToTpSupport = false
      PduRSbTxBufferSupport = false
      PduRSingleIf = CAN_IF
      PduRVersionInfoApi = true
      PduRZeroCostOperation = true
      PduRLinTpChangeParameterSupport = false
      PduRFrTpChangeParameterSupport = false
      PduRCanTpChangeParameterSupport = false
      PduRUseConsecutiveTxIdInLowLayer = false
      PduRMinimumRoutingUsed = false
      PduRUseConsecutiveHandleId = false
      PduRComRef = ComConfig
      PduRCanIfRef = CanIfInitConfiguration
    PduRGlobalConfig: PduRConfigurationId=0
      PduRRoutingTable
  module config Stub_FrIf_Config: definition=FrIf, implementation-config-variant=VARIANT-PRE-COMPILE, module-description=FrIf_Impl
    FrIfGeneral:
      FrIfDevErrorDetect = (unset)
      FrIfNumClstSupported = (unset)
      FrIfNumCtrlSupported = (unset)
      FrIfVersionInfoApi = (unset)
      FrIfNumAbsTimerSupported = (unset)
      FrIfNumRelTimerSupported = (unset)
      FrIfFrInstanceNameRuleUsed = true
      FrIfFrTrcvInstanceNameRuleUsed = true
      FrIfPduRModuleRef = (unset)
      FrIfFrNmModuleRef = (unset)
      FrIfFrTpModuleRef = (unset)
      FrIfComModuleRef = (unset)
      FrIfFrDrvModuleRef = (unset)
      FrIfFrTrcvDrvModuleRef = (unset)
    FrIfConfig
      FrIfCluster:
        FrIfClstIdx = (unset)
        FrIfMainFunctionPeriod = (unset)
        FrIfMaxIsrDelay = (unset)
        GAssumedPreciscion = (unset)
        GChannels = 
        GClusterDriftDamping = (unset)
        GColdStartAttempts = (unset)
        GListenNoise = (unset)
        GMacroPerCycle = (unset)
        GMaxWithoutClockCorrectFatal = (unset)
        GMaxWithoutClockCorrectPassive = (unset)
        GNetworkManagementVectLength = (unset)
        GNumberOfMinislots = (unset)
        GNumberOfStaticSlots = (unset)
        GOffsetCorrectionMax = (unset)
        GOffsetCorrectionStart = (unset)
        GPayloadLengthStatic = (unset)
        GSyncNodeMax = (unset)
        GdActionPointOffset = (unset)
        GdBit = (unset)
        GdBitMax = (unset)
        GdBitMin = (unset)
        GdCasRxLowMax = (unset)
        GdCycle = (unset)
        GdDynamicSlotIdlePhase = (unset)
        GdMacrotick = (unset)
        GdMaxInitializationError = (unset)
        GdMaxMicrotick = 
        GdMaxPropagationDelay = (unset)
        GdMinPropagationDelay = (unset)
        GdMiniSlotActionPointOffset = (unset)
        GdMinislot = (unset)
        GdNit = (unset)
        GdSampleClockPeriod = 
        GdStaticSlot = (unset)
        GdSymbolWindow = (unset)
        GdTssTransmitter = (unset)
        GdWakeupSymbolRxIdle = (unset)
        GdWakeupSymbolRxLow = (unset)
        GdWakeupSymbolRxWindow = (unset)
        GdWakeupSymbolTxIdle = (unset)
        GdWakeupSymbolTxLow = (unset)
        FrIfController: FrIfCtrlIdx=(unset), FrIfFrCtrlRef=(unset)
          FrIfAbsTimer: FrIfAbsTimerIdx=(unset), FrIfFrAbsTimerRef=(unset)
          FrIfFrameTriggering:
            FrIfAllowDynamicLSduLength = (unset)
            FrIfAlwaysTransmit = (unset)
            FrIfBaseCycle = (unset)
            FrIfChannel = 
            FrIfCycleRepetition = (unset)
            FrIfLSduLength = (unset)
            FrIfNoneMode = (unset)
            FrIfPayloadPreamble = (unset)
            FrIfSlotId = (unset)
            FrIfFrameStructureRef = (unset)
          FrIfLPdu: FrIfLPduIdx=(unset), FrIfVBTriggeringRef=(unset)
          FrIfRelTimer: FrIfRelTimerIdx=(unset), FrIfFrRelTimerRef=(unset)
          FrIfTransceiver: FrIfClusterChannel=, FrIfFrTrcvChannelRef=(unset)
        FrIfJobList: FrIfAbsTimerRef=(unset)
          FrIfJob: FrIfCycle=(unset), FrIfMacrotick=(unset)
            FrIfCommunicationOperation: FrIfCommunicationAction=, FrIfCommunicationOperationIdx=(unset), FrIfLPduIdxRef=(unset)
      FrIfFrameStructure
        FrIfPdusInFrame: FrIfPduOffset=(unset), FrIfPduUpdateBitOffset=(unset), FrFrIfPduRef=(unset)
      6 x FrIfPdu:
        FrIfPduTx1
          FrIfTxPdu1 (FrIfTxPdu): FrIfConfirm=true, FrIfCounterLimit=(unset), FrIfImmediate=true, FrIfTxPduId=0, FrIfPduRef=PduTxData1
        FrIfPduTx2
          FrIfTxPdu2 (FrIfTxPdu): FrIfConfirm=true, FrIfCounterLimit=(unset), FrIfImmediate=true, FrIfTxPduId=1, FrIfPduRef=PduTxData2
        FrIfPduTx3
          FrIfTxPdu3 (FrIfTxPdu): FrIfConfirm=true, FrIfCounterLimit=(unset), FrIfImmediate=true, FrIfTxPduId=2, FrIfPduRef=PduTxData3
        FrIfPduRx1
          FrIfRxPdu1 (FrIfRxPdu): FrIfPduRef=PduRxData1
        FrIfPduRx2
          FrIfRxPdu2 (FrIfRxPdu): FrIfPduRef=PduRxData2
        FrIfPduRx3
          FrIfRxPdu3 (FrIfRxPdu): FrIfPduRef=PduRxData3
    FrIfGeneral:
      FrIfDevErrorDetect = (unset)
      FrIfNumClstSupported = (unset)
      FrIfNumCtrlSupported = (unset)
      FrIfVersionInfoApi = (unset)
      FrIfNumAbsTimerSupported = (unset)
      FrIfNumRelTimerSupported = (unset)
      FrIfFrInstanceNameRuleUsed = true
      FrIfFrTrcvInstanceNameRuleUsed = true
      FrIfPduRModuleRef = (unset)
      FrIfFrNmModuleRef = (unset)
      FrIfFrTpModuleRef = (unset)
      FrIfComModuleRef = (unset)
      FrIfFrDrvModuleRef = (unset)
      FrIfFrTrcvDrvModuleRef = (unset)
    FrIfPduLimits: FrIfNbPduMaxSupported=(unset), FrIfMaxPduStored=(unset), FrIfMaxPduStoredLength=(unset)
    FrIfOptionalAPI:
      FrIfSetAbsoluteTimerApi = true
      FrIfCancelAbsoluteTimerApi = true
      FrIfEnableAbsoluteTimerIRQApi = true
      FrIfGetAbsoluteTimerIRQStatusApi = true
      FrIfAckAbsoluteTimerIRQApi = true
      FrIfDisableAbsoluteTimerIRQApi = true
      FrIfSetRelativeTimerApi = true
      FrIfCancelRelativeTimerApi = true
      FrIfEnableRelativeTimerIRQApi = true
      FrIfGetRelativeTimerIRQStatusApi = true
      FrIfAckRelativeTimerIRQApi = true
      FrIfDisableRelativeTimerIRQApi = true
  module config EcuC_Config: definition=EcuC, implementation-config-variant=VARIANT-PRE-COMPILE
    PduCollection
      62 x Pdu, all with SysTPduToFrameMappingRef=(unset):
        ECUC_CAN_Chassis_80: PduLength=1
        ECUC_CAN_Tilt_80: PduLength=1
        ECUC_CAN_Confort_504: PduLength=8
        ECUC_CAN_Chassis_210: PduLength=8
        ECUC_CAN_Chassis_213: PduLength=8
        ECUC_CAN_Chassis_610: PduLength=4
        ECUC_CAN_Chassis_613: PduLength=4
        ECUC_CAN_Tilt_201: PduLength=5
        ECUC_CAN_Tilt_701: PduLength=1
        ECUC_CAN_Tilt_000: PduLength=2
        ECUC_CAN_Tilt_601: PduLength=8
        ECUC_CAN_Tilt_7C0: PduLength=2
        ECUC_CAN_Confort_250: PduLength=1
        ECUC_CAN_Chassis_190: PduLength=8
        ECUC_CAN_Chassis_290: PduLength=8
        ECUC_CAN_Chassis_390: PduLength=8
        ECUC_CAN_Chassis_490: PduLength=8
        ECUC_CAN_Chassis_193: PduLength=8
        ECUC_CAN_Chassis_293: PduLength=8
        ECUC_CAN_Chassis_393: PduLength=8
        ECUC_CAN_Chassis_493: PduLength=8
        ECUC_CAN_Tilt_581: PduLength=8
        ECUC_CAN_Tilt_181: PduLength=8
        ECUC_CAN_Tilt_281: PduLength=2
        ECUC_CAN_Tilt_381: PduLength=2
        ECUC_CAN_Tilt_305: PduLength=6
        ECUC_CAN_Confort_506: PduLength=8
        ECUC_CAN_Confort_201: PduLength=8
        ECUC_CAN_Confort_202: PduLength=8
        ECUC_CAN_Confort_221: PduLength=1
        ECUC_CAN_Confort_251: PduLength=8
        ECUC_CAN_Confort_{100..103}: PduLength=8
        ECUC_CAN_Confort_{110..113}: PduLength=8
        ECUC_CAN_Confort_500: PduLength=8
        ECUC_CAN_Confort_{591..595}: PduLength=8
        ECUC_CAN_Confort_603: PduLength=8
        CAN_Confort_7F{0..9}: PduLength=8
        CAN_Confort_7FA: PduLength=8
        CAN_Confort_7FB: PduLength=8
        CAN_Confort_7FC: PduLength=2
        CAN_Confort_7FD: PduLength=8
        CAN_Confort_7FE: PduLength=8
        ECUC_CAN_Confort_203: PduLength=8
  module config CanIf_Config: definition=CanIf, implementation-config-variant=VARIANT-PRE-COMPILE, module-description=CanIf_Impl
    3 x CanIfControllerConfig, all with CanIfWakeupSupport=CONTROLLER, CanIfDriverNameRef=CanIfDriverConfig:
      CanIfControllerConfig_A_Tilt: CanIfInitControllerRef=CanIfInitControllerConfig_A_Tilt, CanIfControllerIdRef=CanController_A_Tilt
      CanIfControllerConfig_B_Chassis: CanIfInitControllerRef=CanIfInitControllerConfig_B_Chassis, CanIfControllerIdRef=CanController_B_Chassis
      CanIfControllerConfig_C_Confort: CanIfInitControllerRef=CanIfInitControllerConfig_C_Confort, CanIfControllerIdRef=CanController_C_Confort
    CanIfDriverConfig:
      CanIfBusoffNotification = false
      CanIfReceiveIndication = true
      CanIfTransmitCancellation = false
      CanIfTxConfirmation = true
      CanIfWakeupNotification = false
      CanIfDriverName = Can_MPC5668
      CanIfDriverRefConfig = NULL_PTR
      CanIfDriverNameRef = CanGeneral
      CanIfInitHohConfigRef = CanIfInitHohConfig
    CanIfInitConfiguration: CanIfConfigSet=NULL_PTR, CanIfNumberOfCanRxPduIds=28, CanIfNumberOfCanTXPduIds=34, CanIfNumberOfDynamicCanTXPduIds=0
      CanIfInitHohConfig: CanIfRefConfigSet=CanConfigSet
        28 x CanIfHrhConfig, all with CanIfHrhType=BASIC_CAN, CanIfSoftwareFilterHrh=false:
          R_CanIfHrhConfig_Tilt_581: CanIfCanControllerHrhIdRef=CanIfControllerConfig_A_Tilt, CanIfHrhIdSymRef=CanHwObj_Hrh_0_Tilt_581
          R_CanIfHrhConfig_Tilt_181: CanIfCanControllerHrhIdRef=CanIfControllerConfig_A_Tilt, CanIfHrhIdSymRef=CanHwObj_Hrh_1_Tilt_181
          R_CanIfHrhConfig_Tilt_281: CanIfCanControllerHrhIdRef=CanIfControllerConfig_A_Tilt, CanIfHrhIdSymRef=CanHwObj_Hrh_2_Tilt_281
          R_CanIfHrhConfig_Tilt_381: CanIfCanControllerHrhIdRef=CanIfControllerConfig_A_Tilt, CanIfHrhIdSymRef=CanHwObj_Hrh_3_Tilt_381
          R_CanIfHrhConfig_Chassis_190: CanIfCanControllerHrhIdRef=CanIfControllerConfig_B_Chassis, CanIfHrhIdSymRef=CanHwObj_Hrh_4_Chassis_190
          R_CanIfHrhConfig_Chassis_290: CanIfCanControllerHrhIdRef=CanIfControllerConfig_B_Chassis, CanIfHrhIdSymRef=CanHwObj_Hrh_5_Chassis_290
          R_CanIfHrhConfig_Chassis_390: CanIfCanControllerHrhIdRef=CanIfControllerConfig_B_Chassis, CanIfHrhIdSymRef=CanHwObj_Hrh_6_Chassis_390
          R_CanIfHrhConfig_Chassis_490: CanIfCanControllerHrhIdRef=CanIfControllerConfig_B_Chassis, CanIfHrhIdSymRef=CanHwObj_Hrh_7_Chassis_490
          R_CanIfHrhConfig_Chassis_193: CanIfCanControllerHrhIdRef=CanIfControllerConfig_B_Chassis, CanIfHrhIdSymRef=CanHwObj_Hrh_8_Chassis_193
            CanIfHrhRangeConfig: CanIfRxPduLowerCanId=0, CanIfRxPduUpperCanId=2047
          R_CanIfHrhConfig_Chassis_293: CanIfCanControllerHrhIdRef=CanIfControllerConfig_B_Chassis, CanIfHrhIdSymRef=CanHwObj_Hrh_9_Chassis_293
          R_CanIfHrhConfig_Chassis_393: CanIfCanControllerHrhIdRef=CanIfControllerConfig_B_Chassis, CanIfHrhIdSymRef=CanHwObj_Hrh_10_Chassis_393
          R_CanIfHrhConfig_Chassis_493: CanIfCanControllerHrhIdRef=CanIfControllerConfig_B_Chassis, CanIfHrhIdSymRef=CanHwObj_Hrh_11_Chassis_493
          R_CanIfHrhConfig_Tilt_305: CanIfCanControllerHrhIdRef=CanIfControllerConfig_A_Tilt, CanIfHrhIdSymRef=CanHwObj_Hrh_12_Tilt_305
          R_CanIfHrhConfig_Confort_506: CanIfCanControllerHrhIdRef=CanIfControllerConfig_C_Confort, CanIfHrhIdSymRef=CanHwObj_Hrh_13_Confort_506
          R_CanIfHrhConfig_Confort_101: CanIfCanControllerHrhIdRef=CanIfControllerConfig_C_Confort, CanIfHrhIdSymRef=CanHwObj_Hrh_14_Confort_101
          R_CanIfHrhConfig_Confort_102: CanIfCanControllerHrhIdRef=CanIfControllerConfig_C_Confort, CanIfHrhIdSymRef=CanHwObj_Hrh_15_Confort_102
          R_CanIfHrhConfig_Confort_103: CanIfCanControllerHrhIdRef=CanIfControllerConfig_C_Confort, CanIfHrhIdSymRef=CanHwObj_Hrh_16_Confort_103
          R_CanIfHrhConfig_Confort_110: CanIfCanControllerHrhIdRef=CanIfControllerConfig_C_Confort, CanIfHrhIdSymRef=CanHwObj_Hrh_17_Confort_110
          R_CanIfHrhConfig_Confort_201: CanIfCanControllerHrhIdRef=CanIfControllerConfig_C_Confort, CanIfHrhIdSymRef=CanHwObj_Hrh_18_Confort_201
          R_CanIfHrhConfig_Confort_202: CanIfCanControllerHrhIdRef=CanIfControllerConfig_C_Confort, CanIfHrhIdSymRef=CanHwObj_Hrh_19_Confort_202
          R_CanIfHrhConfig_Confort_203: CanIfCanControllerHrhIdRef=CanIfControllerConfig_C_Confort, CanIfHrhIdSymRef=CanHwObj_Hrh_20_Confort_203
          R_CanIfHrhConfig_Confort_221: CanIfCanControllerHrhIdRef=CanIfControllerConfig_C_Confort, CanIfHrhIdSymRef=CanHwObj_Hrh_21_Confort_221
          R_CanIfHrhConfig_Confort_251: CanIfCanControllerHrhIdRef=CanIfControllerConfig_C_Confort, CanIfHrhIdSymRef=CanHwObj_Hrh_22_Confort_251
          R_CanIfHrhConfig_Confort_592: CanIfCanControllerHrhIdRef=CanIfControllerConfig_C_Confort, CanIfHrhIdSymRef=CanHwObj_Hrh_23_Confort_592
          R_CanIfHrhConfig_Confort_593: CanIfCanControllerHrhIdRef=CanIfControllerConfig_C_Confort, CanIfHrhIdSymRef=CanHwObj_Hrh_24_Confort_593
          R_CanIfHrhConfig_Confort_603: CanIfCanControllerHrhIdRef=CanIfControllerConfig_C_Confort, CanIfHrhIdSymRef=CanHwObj_Hrh_25_Confort_603
          CanIfHrhConfig_Confort_7FC: CanIfCanControllerHrhIdRef=CanIfControllerConfig_C_Confort, CanIfHrhIdSymRef=CanHwObj_Hrh_26_Confort_7FC
          CanIfHrhConfig_Confort_7FE: CanIfCanControllerHrhIdRef=CanIfControllerConfig_C_Confort, CanIfHrhIdSymRef=CanHwObj_Hrh_27_Confort_7FE
        34 x CanIfHthConfig, all with CanIfHthType=BASIC_CAN:
          T_CanIfHthConfig_Tilt_80: CanIfCanControllerIdRef=CanIfControllerConfig_A_Tilt, CanIfHthIdSymRef=CanHwObj_Hth_28_Tilt_80
          T_CanIfHthConfig_Tilt_201: CanIfCanControllerIdRef=CanIfControllerConfig_A_Tilt, CanIfHthIdSymRef=CanHwObj_Hth_29_Tilt_201
          T_CanIfHthConfig_Tilt_701: CanIfCanControllerIdRef=CanIfControllerConfig_A_Tilt, CanIfHthIdSymRef=CanHwObj_Hth_30_Tilt_701
          T_CanIfHthConfig_Tilt_000: CanIfCanControllerIdRef=CanIfControllerConfig_A_Tilt, CanIfHthIdSymRef=CanHwObj_Hth_31_Tilt_000
          T_CanIfHthConfig_Tilt_601: CanIfCanControllerIdRef=CanIfControllerConfig_A_Tilt, CanIfHthIdSymRef=CanHwObj_Hth_32_Tilt_601
          T_CanIfHthConfig_Tilt_7C0: CanIfCanControllerIdRef=CanIfControllerConfig_A_Tilt, CanIfHthIdSymRef=CanHwObj_Hth_33_Tilt_7C0
          T_CanIfHthConfig_Chassis_80: CanIfCanControllerIdRef=CanIfControllerConfig_B_Chassis, CanIfHthIdSymRef=CanHwObj_Hth_34_Chassis_80
          T_CanIfHthConfig_Chassis_210: CanIfCanControllerIdRef=CanIfControllerConfig_B_Chassis, CanIfHthIdSymRef=CanHwObj_Hth_35_Chassis_210
          T_CanIfHthConfig_Chassis_213: CanIfCanControllerIdRef=CanIfControllerConfig_B_Chassis, CanIfHthIdSymRef=CanHwObj_Hth_36_Chassis_213
          T_CanIfHthConfig_Chassis_610: CanIfCanControllerIdRef=CanIfControllerConfig_B_Chassis, CanIfHthIdSymRef=CanHwObj_Hth_37_Chassis_610
          T_CanIfHthConfig_Chassis_613: CanIfCanControllerIdRef=CanIfControllerConfig_B_Chassis, CanIfHthIdSymRef=CanHwObj_Hth_38_Chassis_613
          T_CanIfHthConfig_Confort_100: CanIfCanControllerIdRef=CanIfControllerConfig_C_Confort, CanIfHthIdSymRef=CanHwObj_Hth_39_Confort_100
          T_CanIfHthConfig_Confort_111: CanIfCanControllerIdRef=CanIfControllerConfig_C_Confort, CanIfHthIdSymRef=CanHwObj_Hth_40_Confort_111
          T_CanIfHthConfig_Confort_112: CanIfCanControllerIdRef=CanIfControllerConfig_C_Confort, CanIfHthIdSymRef=CanHwObj_Hth_41_Confort_112
          T_CanIfHthConfig_Confort_113: CanIfCanControllerIdRef=CanIfControllerConfig_C_Confort, CanIfHthIdSymRef=CanHwObj_Hth_42_Confort_113
          T_CanIfHthConfig_Confort_250: CanIfCanControllerIdRef=CanIfControllerConfig_C_Confort, CanIfHthIdSymRef=CanHwObj_Hth_43_Confort_250
          T_CanIfHthConfig_Confort_500: CanIfCanControllerIdRef=CanIfControllerConfig_C_Confort, CanIfHthIdSymRef=CanHwObj_Hth_44_Confort_500
          T_CanIfHthConfig_Confort_504: CanIfCanControllerIdRef=CanIfControllerConfig_C_Confort, CanIfHthIdSymRef=CanHwObj_Hth_45_Confort_504
          T_CanIfHthConfig_Confort_591: CanIfCanControllerIdRef=CanIfControllerConfig_C_Confort, CanIfHthIdSymRef=CanHwObj_Hth_46_Confort_591
          T_CanIfHthConfig_Confort_594: CanIfCanControllerIdRef=CanIfControllerConfig_C_Confort, CanIfHthIdSymRef=CanHwObj_Hth_47_Confort_594
          T_CanIfHthConfig_Confort_595: CanIfCanControllerIdRef=CanIfControllerConfig_C_Confort, CanIfHthIdSymRef=CanHwObj_Hth_48_Confort_595
          T_CanIfHthConfig_Confort_7F0: CanIfCanControllerIdRef=CanIfControllerConfig_C_Confort, CanIfHthIdSymRef=CanHwObj_Hth_49_Confort_7F0
          T_CanIfHthConfig_Confort_7F1: CanIfCanControllerIdRef=CanIfControllerConfig_C_Confort, CanIfHthIdSymRef=CanHwObj_Hth_50_Confort_7F1
          T_CanIfHthConfig_Confort_7F2: CanIfCanControllerIdRef=CanIfControllerConfig_C_Confort, CanIfHthIdSymRef=CanHwObj_Hth_51_Confort_7F2
          T_CanIfHthConfig_Confort_7F3: CanIfCanControllerIdRef=CanIfControllerConfig_C_Confort, CanIfHthIdSymRef=CanHwObj_Hth_52_Confort_7F3
          T_CanIfHthConfig_Confort_7F4: CanIfCanControllerIdRef=CanIfControllerConfig_C_Confort, CanIfHthIdSymRef=CanHwObj_Hth_53_Confort_7F4
          T_CanIfHthConfig_Confort_7F5: CanIfCanControllerIdRef=CanIfControllerConfig_C_Confort, CanIfHthIdSymRef=CanHwObj_Hth_54_Confort_7F5
          T_CanIfHthConfig_Confort_7F6: CanIfCanControllerIdRef=CanIfControllerConfig_C_Confort, CanIfHthIdSymRef=CanHwObj_Hth_55_Confort_7F6
          T_CanIfHthConfig_Confort_7F7: CanIfCanControllerIdRef=CanIfControllerConfig_C_Confort, CanIfHthIdSymRef=CanHwObj_Hth_56_Confort_7F7
          T_CanIfHthConfig_Confort_7F8: CanIfCanControllerIdRef=CanIfControllerConfig_C_Confort, CanIfHthIdSymRef=CanHwObj_Hth_57_Confort_7F8
          T_CanIfHthConfig_Confort_7F9: CanIfCanControllerIdRef=CanIfControllerConfig_C_Confort, CanIfHthIdSymRef=CanHwObj_Hth_58_Confort_7F9
          T_CanIfHthConfig_Confort_7FA: CanIfCanControllerIdRef=CanIfControllerConfig_C_Confort, CanIfHthIdSymRef=CanHwObj_Hth_59_Confort_7FA
          T_CanIfHthConfig_Confort_7FB: CanIfCanControllerIdRef=CanIfControllerConfig_C_Confort, CanIfHthIdSymRef=CanHwObj_Hth_60_Confort_7FB
          T_CanIfHthConfig_Confort_7FD: CanIfCanControllerIdRef=CanIfControllerConfig_C_Confort, CanIfHthIdSymRef=CanHwObj_Hth_61_Confort_7FD
      CanIfInitControllerConfig_A_Tilt (CanIfInitControllerConfig): CanIfControllerConfig=ControllerConfigs0_PC[CanController_A_Tilt], CanIfControllerRefConfigSet=CanController_A_Tilt
      T_CanOpenSynchFrame_Chassis_80 (CanIfTxPduConfig):
        category = Tx_Pdu
        CanIfCanTxPduId = 0
        CanIfCanTxPduIdCanId = 128
        CanIfCanTxPduIdDlc = 1
        CanIfCanTxPduType = STATIC
        CanIfReadTxPduNotifyStatus = false
        CanIfTxPduIdCanIdType = STANDARD_CAN
        CanIfTxUserType = PDUR
        CanIfUserTxConfirmation = PduR_CanIfTxConfirmation
        CanIfCanTxPduHthRef = T_CanIfHthConfig_Chassis_80
        PduIdRef = ECUC_CAN_Chassis_80
      R_CAN_Confort_506 (CanIfRxPduConfig):
        category = Rx_Pdu
        CanIfCanRxPduCanId = 1286
        CanIfCanRxPduDlc = 8
        CanIfCanRxPduId = 0
        CanIfReadRxPduData = false
        CanIfReadRxPduNotifyStatus = false
        CanIfRxPduIdCanIdType = STANDARD_CAN
        CanIfRxUserType = PDUR
        CanIfUserRxIndication = PduR_CanIfRxIndication
        CanIfCanRxPduHrhRef = R_CanIfHrhConfig_Confort_506
        PduIdRef = ECUC_CAN_Confort_506
        ComSignalRef = ComConfig
      10 x CanIfTxPduConfig, all with category=Tx_Pdu, CanIfCanTxPduType=STATIC, CanIfReadTxPduNotifyStatus=false, CanIfTxPduIdCanIdType=STANDARD_CAN, CanIfTxUserType=PDUR, CanIfUserTxConfirmation=PduR_CanIfTxConfirmation:
        T_CanOpenSynchFrame_Tilt_80: CanIfCanTxPduId=1, CanIfCanTxPduIdCanId=128, CanIfCanTxPduIdDlc=1, CanIfCanTxPduHthRef=T_CanIfHthConfig_Tilt_80, PduIdRef=ECUC_CAN_Tilt_80
        T_DataTransferToUcConfort_Confort_504: CanIfCanTxPduId=2, CanIfCanTxPduIdCanId=1284, CanIfCanTxPduIdDlc=8, CanIfCanTxPduHthRef=T_CanIfHthConfig_Confort_504, PduIdRef=ECUC_CAN_Confort_504
        T_RightSKAISingleInverterCommandData_Chassis_210: CanIfCanTxPduId=3, CanIfCanTxPduIdCanId=528, CanIfCanTxPduIdDlc=8, CanIfCanTxPduHthRef=T_CanIfHthConfig_Chassis_210, PduIdRef=ECUC_CAN_Chassis_210
        T_LeftSKAISingleInverterCommandData_Chassis_213: CanIfCanTxPduId=4, CanIfCanTxPduIdCanId=531, CanIfCanTxPduIdDlc=8, CanIfCanTxPduHthRef=T_CanIfHthConfig_Chassis_213, PduIdRef=ECUC_CAN_Chassis_213
        T_RightSKAISingleInverterClearError_Chassis_610: CanIfCanTxPduId=5, CanIfCanTxPduIdCanId=1552, CanIfCanTxPduIdDlc=4, CanIfCanTxPduHthRef=T_CanIfHthConfig_Chassis_610, PduIdRef=ECUC_CAN_Chassis_610
        T_LeftSKAISingleInverterClearError_Chassis_613: CanIfCanTxPduId=6, CanIfCanTxPduIdCanId=1555, CanIfCanTxPduIdDlc=4, CanIfCanTxPduHthRef=T_CanIfHthConfig_Chassis_613, PduIdRef=ECUC_CAN_Chassis_613
        T_CopleyAccelnetAmplifierCommandData_Tilt_201: CanIfCanTxPduId=7, CanIfCanTxPduIdCanId=513, CanIfCanTxPduIdDlc=5, CanIfCanTxPduHthRef=T_CanIfHthConfig_Tilt_201, PduIdRef=ECUC_CAN_Tilt_201
        T_CopleyAccelnetAmplifierNodeGuarding_Tilt_701: CanIfCanTxPduId=8, CanIfCanTxPduIdCanId=1793, CanIfCanTxPduIdDlc=1, CanIfCanTxPduHthRef=T_CanIfHthConfig_Tilt_701, PduIdRef=ECUC_CAN_Tilt_701
        T_CopleyAccelnetAmplifierMode_Tilt_000: CanIfCanTxPduId=9, CanIfCanTxPduIdCanId=0, CanIfCanTxPduIdDlc=2, CanIfCanTxPduHthRef=T_CanIfHthConfig_Tilt_000, PduIdRef=ECUC_CAN_Tilt_000
        T_CopleyAccelnetAmplifierConfigTxFrame_Tilt_601: CanIfCanTxPduId=10, CanIfCanTxPduIdCanId=1537, CanIfCanTxPduIdDlc=8, CanIfCanTxPduHthRef=T_CanIfHthConfig_Tilt_601, PduIdRef=ECUC_CAN_Tilt_601
      13 x CanIfRxPduConfig, all with category=Rx_Pdu, CanIfReadRxPduData=false, CanIfReadRxPduNotifyStatus=false, CanIfRxPduIdCanIdType=STANDARD_CAN, CanIfRxUserType=PDUR, CanIfUserRxIndication=PduR_CanIfRxIndication, ComSignalRef=ComConfig:
        R_CAN_Chassis_190: CanIfCanRxPduCanId=400, CanIfCanRxPduDlc=8, CanIfCanRxPduId=1, CanIfCanRxPduHrhRef=R_CanIfHrhConfig_Chassis_190, PduIdRef=ECUC_CAN_Chassis_190
        R_CAN_Chassis_290: CanIfCanRxPduCanId=656, CanIfCanRxPduDlc=8, CanIfCanRxPduId=2, CanIfCanRxPduHrhRef=R_CanIfHrhConfig_Chassis_290, PduIdRef=ECUC_CAN_Chassis_290
        R_CAN_Chassis_390: CanIfCanRxPduCanId=912, CanIfCanRxPduDlc=8, CanIfCanRxPduId=3, CanIfCanRxPduHrhRef=R_CanIfHrhConfig_Chassis_390, PduIdRef=ECUC_CAN_Chassis_390
        R_CAN_Chassis_490: CanIfCanRxPduCanId=1168, CanIfCanRxPduDlc=8, CanIfCanRxPduId=4, CanIfCanRxPduHrhRef=R_CanIfHrhConfig_Chassis_490, PduIdRef=ECUC_CAN_Chassis_490
        R_CAN_Chassis_193: CanIfCanRxPduCanId=403, CanIfCanRxPduDlc=8, CanIfCanRxPduId=5, CanIfCanRxPduHrhRef=R_CanIfHrhConfig_Chassis_193, PduIdRef=ECUC_CAN_Chassis_193
        R_CAN_Chassis_293: CanIfCanRxPduCanId=659, CanIfCanRxPduDlc=8, CanIfCanRxPduId=6, CanIfCanRxPduHrhRef=R_CanIfHrhConfig_Chassis_293, PduIdRef=ECUC_CAN_Chassis_293
        R_CAN_Chassis_393: CanIfCanRxPduCanId=915, CanIfCanRxPduDlc=8, CanIfCanRxPduId=7, CanIfCanRxPduHrhRef=R_CanIfHrhConfig_Chassis_393, PduIdRef=ECUC_CAN_Chassis_393
        R_CAN_Chassis_493: CanIfCanRxPduCanId=1171, CanIfCanRxPduDlc=8, CanIfCanRxPduId=8, CanIfCanRxPduHrhRef=R_CanIfHrhConfig_Chassis_493, PduIdRef=ECUC_CAN_Chassis_493
        R_CAN_Tilt_581: CanIfCanRxPduCanId=1409, CanIfCanRxPduDlc=8, CanIfCanRxPduId=9, CanIfCanRxPduHrhRef=R_CanIfHrhConfig_Tilt_581, PduIdRef=ECUC_CAN_Tilt_581
        R_CAN_Tilt_181: CanIfCanRxPduCanId=385, CanIfCanRxPduDlc=8, CanIfCanRxPduId=10, CanIfCanRxPduHrhRef=R_CanIfHrhConfig_Tilt_181, PduIdRef=ECUC_CAN_Tilt_181
        R_CAN_Tilt_281: CanIfCanRxPduCanId=641, CanIfCanRxPduDlc=2, CanIfCanRxPduId=11, CanIfCanRxPduHrhRef=R_CanIfHrhConfig_Tilt_281, PduIdRef=ECUC_CAN_Tilt_281
        R_CAN_Tilt_381: CanIfCanRxPduCanId=897, CanIfCanRxPduDlc=4, CanIfCanRxPduId=12, CanIfCanRxPduHrhRef=R_CanIfHrhConfig_Tilt_381, PduIdRef=ECUC_CAN_Tilt_381
        R_CAN_Tilt_305: CanIfCanRxPduCanId=773, CanIfCanRxPduDlc=6, CanIfCanRxPduId=13, CanIfCanRxPduHrhRef=R_CanIfHrhConfig_Tilt_305, PduIdRef=ECUC_CAN_Tilt_305
      CanIfInitControllerConfig_B_Chassis (CanIfInitControllerConfig): CanIfControllerConfig=ControllerConfigs0_PC[CanController_B_Chassis], CanIfControllerRefConfigSet=CanController_B_Chassis
      CanIfInitControllerConfig_C_Confort (CanIfInitControllerConfig): CanIfControllerConfig=ControllerConfigs0_PC[CanController_C_Confort], CanIfControllerRefConfigSet=CanController_C_Confort
      10 x CanIfTxPduConfig, all with category=Tx_Pdu, CanIfCanTxPduType=STATIC, CanIfReadTxPduNotifyStatus=false, CanIfTxPduIdCanIdType=STANDARD_CAN, CanIfTxUserType=PDUR, CanIfUserTxConfirmation=PduR_CanIfTxConfirmation:
        T_BoshSteeringWheelSensor_Tilt_7C0: CanIfCanTxPduId=11, CanIfCanTxPduIdCanId=1984, CanIfCanTxPduIdDlc=2, CanIfCanTxPduHthRef=T_CanIfHthConfig_Tilt_7C0, PduIdRef=ECUC_CAN_Tilt_7C0
        T_ACTIA_DataRequest_Confort_250: CanIfCanTxPduId=12, CanIfCanTxPduIdCanId=592, CanIfCanTxPduIdDlc=1, CanIfCanTxPduHthRef=T_CanIfHthConfig_Confort_250, PduIdRef=ECUC_CAN_Confort_250
        T_CLAS_Status_Confort_100: CanIfCanTxPduId=13, CanIfCanTxPduIdCanId=256, CanIfCanTxPduIdDlc=8, CanIfCanTxPduHthRef=T_CanIfHthConfig_Confort_100, PduIdRef=ECUC_CAN_Confort_100
        T_BSIDebugData_Confort_111: CanIfCanTxPduId=14, CanIfCanTxPduIdCanId=273, CanIfCanTxPduIdDlc=8, CanIfCanTxPduHthRef=T_CanIfHthConfig_Confort_111, PduIdRef=ECUC_CAN_Confort_111
        T_IHMDebugData_Confort_112: CanIfCanTxPduId=15, CanIfCanTxPduIdCanId=274, CanIfCanTxPduIdDlc=8, CanIfCanTxPduHthRef=T_CanIfHthConfig_Confort_112, PduIdRef=ECUC_CAN_Confort_112
        T_EXTDebugData_Confort_113: CanIfCanTxPduId=16, CanIfCanTxPduIdCanId=275, CanIfCanTxPduIdDlc=8, CanIfCanTxPduHthRef=T_CanIfHthConfig_Confort_113, PduIdRef=ECUC_CAN_Confort_113
        T_CLASToIHM_Confort_500: CanIfCanTxPduId=17, CanIfCanTxPduIdCanId=1280, CanIfCanTxPduIdDlc=8, CanIfCanTxPduHthRef=T_CanIfHthConfig_Confort_500, PduIdRef=ECUC_CAN_Confort_500
        T_IMMOData_Confort_591: CanIfCanTxPduId=18, CanIfCanTxPduIdCanId=1425, CanIfCanTxPduIdDlc=8, CanIfCanTxPduHthRef=T_CanIfHthConfig_Confort_591, PduIdRef=ECUC_CAN_Confort_591
        T_IMMODiagConfiguration_Confort_594: CanIfCanTxPduId=19, CanIfCanTxPduIdCanId=1428, CanIfCanTxPduIdDlc=8, CanIfCanTxPduHthRef=T_CanIfHthConfig_Confort_594, PduIdRef=ECUC_CAN_Confort_594
        T_IMMORcuConfiguration_Confort_595: CanIfCanTxPduId=20, CanIfCanTxPduIdCanId=1429, CanIfCanTxPduIdDlc=8, CanIfCanTxPduHthRef=T_CanIfHthConfig_Confort_595, PduIdRef=ECUC_CAN_Confort_595
      12 x CanIfRxPduConfig, all with category=Rx_Pdu, CanIfReadRxPduData=false, CanIfReadRxPduNotifyStatus=false, CanIfRxPduIdCanIdType=STANDARD_CAN, CanIfRxUserType=PDUR, CanIfUserRxIndication=PduR_CanIfRxIndication, ComSignalRef=ComConfig:
        R_CAN_Confort_201: CanIfCanRxPduCanId=513, CanIfCanRxPduDlc=8, CanIfCanRxPduId=14, CanIfCanRxPduHrhRef=R_CanIfHrhConfig_Confort_201, PduIdRef=ECUC_CAN_Confort_201
        R_CAN_Confort_202: CanIfCanRxPduCanId=514, CanIfCanRxPduDlc=8, CanIfCanRxPduId=15, CanIfCanRxPduHrhRef=R_CanIfHrhConfig_Confort_202, PduIdRef=ECUC_CAN_Confort_202
        R_CAN_Confort_203: CanIfCanRxPduCanId=515, CanIfCanRxPduDlc=8, CanIfCanRxPduId=16, CanIfCanRxPduHrhRef=R_CanIfHrhConfig_Confort_203, PduIdRef=ECUC_CAN_Confort_203
        R_CAN_Confort_221: CanIfCanRxPduCanId=545, CanIfCanRxPduDlc=1, CanIfCanRxPduId=17, CanIfCanRxPduHrhRef=R_CanIfHrhConfig_Confort_221, PduIdRef=ECUC_CAN_Confort_221
        R_CAN_Confort_251: CanIfCanRxPduCanId=593, CanIfCanRxPduDlc=8, CanIfCanRxPduId=18, CanIfCanRxPduHrhRef=R_CanIfHrhConfig_Confort_251, PduIdRef=ECUC_CAN_Confort_251
        R_CAN_Confort_101: CanIfCanRxPduCanId=257, CanIfCanRxPduDlc=8, CanIfCanRxPduId=19, CanIfCanRxPduHrhRef=R_CanIfHrhConfig_Confort_101, PduIdRef=ECUC_CAN_Confort_101
        R_CAN_Confort_102: CanIfCanRxPduCanId=258, CanIfCanRxPduDlc=8, CanIfCanRxPduId=20, CanIfCanRxPduHrhRef=R_CanIfHrhConfig_Confort_102, PduIdRef=ECUC_CAN_Confort_102
        R_CAN_Confort_103: CanIfCanRxPduCanId=259, CanIfCanRxPduDlc=8, CanIfCanRxPduId=21, CanIfCanRxPduHrhRef=R_CanIfHrhConfig_Confort_103, PduIdRef=ECUC_CAN_Confort_103
        R_CAN_Confort_110: CanIfCanRxPduCanId=272, CanIfCanRxPduDlc=8, CanIfCanRxPduId=22, CanIfCanRxPduHrhRef=R_CanIfHrhConfig_Confort_110, PduIdRef=ECUC_CAN_Confort_110
        R_CAN_Confort_592: CanIfCanRxPduCanId=1426, CanIfCanRxPduDlc=8, CanIfCanRxPduId=23, CanIfCanRxPduHrhRef=R_CanIfHrhConfig_Confort_592, PduIdRef=ECUC_CAN_Confort_592
        R_CAN_Confort_593: CanIfCanRxPduCanId=1427, CanIfCanRxPduDlc=8, CanIfCanRxPduId=24, CanIfCanRxPduHrhRef=R_CanIfHrhConfig_Confort_593, PduIdRef=ECUC_CAN_Confort_593
        R_CAN_Confort_603: CanIfCanRxPduCanId=1539, CanIfCanRxPduDlc=8, CanIfCanRxPduId=25, CanIfCanRxPduHrhRef=R_CanIfHrhConfig_Confort_603, PduIdRef=ECUC_CAN_Confort_603
      13 x CanIfTxPduConfig, all with category=Tx_Pdu, CanIfCanTxPduIdDlc=8, CanIfCanTxPduType=STATIC, CanIfReadTxPduNotifyStatus=false, CanIfTxPduIdCanIdType=STANDARD_CAN, CanIfTxUserType=PDUR, CanIfUserTxConfirmation=PduR_CanIfTxConfirmation:
        CAN_Confort_7F0: CanIfCanTxPduId=21, CanIfCanTxPduIdCanId=2032, CanIfCanTxPduHthRef=T_CanIfHthConfig_Confort_7F0, PduIdRef=PduCollection/CAN_Confort_7F0
        CAN_Confort_7F1: CanIfCanTxPduId=22, CanIfCanTxPduIdCanId=2033, CanIfCanTxPduHthRef=T_CanIfHthConfig_Confort_7F1, PduIdRef=PduCollection/CAN_Confort_7F1
        CAN_Confort_7F2: CanIfCanTxPduId=23, CanIfCanTxPduIdCanId=2034, CanIfCanTxPduHthRef=T_CanIfHthConfig_Confort_7F2, PduIdRef=PduCollection/CAN_Confort_7F2
        CAN_Confort_7F3: CanIfCanTxPduId=24, CanIfCanTxPduIdCanId=2035, CanIfCanTxPduHthRef=T_CanIfHthConfig_Confort_7F3, PduIdRef=PduCollection/CAN_Confort_7F3
        CAN_Confort_7F4: CanIfCanTxPduId=25, CanIfCanTxPduIdCanId=2036, CanIfCanTxPduHthRef=T_CanIfHthConfig_Confort_7F4, PduIdRef=PduCollection/CAN_Confort_7F4
        CAN_Confort_7F5: CanIfCanTxPduId=26, CanIfCanTxPduIdCanId=2037, CanIfCanTxPduHthRef=T_CanIfHthConfig_Confort_7F5, PduIdRef=PduCollection/CAN_Confort_7F5
        CAN_Confort_7F6: CanIfCanTxPduId=27, CanIfCanTxPduIdCanId=2038, CanIfCanTxPduHthRef=T_CanIfHthConfig_Confort_7F6, PduIdRef=PduCollection/CAN_Confort_7F6
        CAN_Confort_7F7: CanIfCanTxPduId=28, CanIfCanTxPduIdCanId=2039, CanIfCanTxPduHthRef=T_CanIfHthConfig_Confort_7F7, PduIdRef=PduCollection/CAN_Confort_7F7
        CAN_Confort_7F8: CanIfCanTxPduId=29, CanIfCanTxPduIdCanId=2040, CanIfCanTxPduHthRef=T_CanIfHthConfig_Confort_7F8, PduIdRef=PduCollection/CAN_Confort_7F8
        CAN_Confort_7F9: CanIfCanTxPduId=30, CanIfCanTxPduIdCanId=2041, CanIfCanTxPduHthRef=T_CanIfHthConfig_Confort_7F9, PduIdRef=PduCollection/CAN_Confort_7F9
        CAN_Confort_7FA: CanIfCanTxPduId=31, CanIfCanTxPduIdCanId=2042, CanIfCanTxPduHthRef=T_CanIfHthConfig_Confort_7FA, PduIdRef=PduCollection/CAN_Confort_7FA
        CAN_Confort_7FB: CanIfCanTxPduId=32, CanIfCanTxPduIdCanId=2043, CanIfCanTxPduHthRef=T_CanIfHthConfig_Confort_7FB, PduIdRef=PduCollection/CAN_Confort_7FB
        CAN_Confort_7FD: CanIfCanTxPduId=33, CanIfCanTxPduIdCanId=2045, CanIfCanTxPduHthRef=T_CanIfHthConfig_Confort_7FD, PduIdRef=PduCollection/CAN_Confort_7FD
      CAN_Confort_7FC (CanIfRxPduConfig):
        category = Rx_Pdu
        CanIfCanRxPduCanId = 2044
        CanIfCanRxPduDlc = 2
        CanIfCanRxPduId = 26
        CanIfReadRxPduData = false
        CanIfReadRxPduNotifyStatus = false
        CanIfRxPduIdCanIdType = STANDARD_CAN
        CanIfRxUserType = PDUR
        CanIfUserRxIndication = PduR_CanIfRxIndication
        CanIfCanRxPduHrhRef = CanIfHrhConfig_Confort_7FC
        PduIdRef = PduCollection/CAN_Confort_7FC
        ComSignalRef = ComConfig
      CAN_Confort_7FE (CanIfRxPduConfig):
        category = Rx_Pdu
        CanIfCanRxPduCanId = 2046
        CanIfCanRxPduDlc = 8
        CanIfCanRxPduId = 27
        CanIfReadRxPduData = false
        CanIfReadRxPduNotifyStatus = false
        CanIfRxPduIdCanIdType = STANDARD_CAN
        CanIfRxUserType = PDUR
        CanIfUserRxIndication = PduR_CanIfRxIndication
        CanIfCanRxPduHrhRef = CanIfHrhConfig_Confort_7FE
        PduIdRef = PduCollection/CAN_Confort_7FE
        ComSignalRef = ComConfig
    CanIfPrivateConfiguration:
      CanIfDlcCheck = false
      CanIfNumberOfTxBuffers = 1
      CanIfSoftwareFilterType = LINEAR
      CanIfEcuMRef = EcuMConfiguration
      CanIfPduRRef = PduRGeneral
      CanIfCanSMRef = CanStateManagerConfiguration
    CanIfPublicConfiguration:
      CanIfDevErrorDetect = true
      CanIfMultipleDriverSupport = false
      CanIfNumberOfCanHwUnits = 3
      CanIfReadRxPduDataApi = false
      CanIfReadRxPduNotifyStatusApi = false
      CanIfReadTxPduNotifyStatusApi = false
      CanIfSetDynamicTxIdApi = false
      CanIfVersionInfoApi = false
      CanIfWakeupEventApi = false
      CanIfWakeUpValidationApi = false
    CanIfTransceiverDrvConfig: CanIfTrcvWakeupNotification=false, CanIfTrcvName=(unset)
    CanIfDispatchConfig: CanIfBusOffNotification=NULL_PTR, CanIfWakeupNotification=NULL_PTR, CanIfWakeupValidNotification=NULL_PTR
  module config CanSM_Config: definition=CanSM, implementation-config-variant=VARIANT-PRE-COMPILE, module-description=CanSM_Implementation
    CanStateManagerConfiguration:
      CanSMBorCounterL1ToL2 = 5
      CanSMBorCounterL2Err = 5
      CanSMBorDisableRxDlMonitoring = false
      CanSMBorTimeL1 = 0.1
      CanSMBorTimeL2 = 0.1
      CanSMBorTimeTxEnsured = 1.0
      CanSMDevErrorDetect = true
      CanSMVersionInfoAPI = false
      CanSMMainFunctionPeriod = 0.02
      CanStateManagerNetworks: CanSMNetworkHandle=ComMChannel, CanSMRxPduGroupId=ComIPduGroupRx, CanSMTransceiverId=CanTrcvChannel, CanSMTxPduGroupId=ComIPduGroupTX
        3 x CanStateManagerControllers:
          CanStateManagerController_A_Tilt: CanSMControllerId=CanController_A_Tilt
          CanStateManagerControllers_B_Chassis: CanSMControllerId=CanController_B_Chassis
          CanStateManagerControllers_C_Confort: CanSMControllerId=CanController_C_Confort
  module config Stub_CanTrcv_Config: definition=CanTrcv, implementation-config-variant=VARIANT-PRE-COMPILE, module-description=CanTrcv_Impl
    CanTrcvChannel:
      CanTrcvChannelId = (unset)
      CanTrcvChannelUsed = true
      CanTrcvControlsPowerSupply = false
      CanTrcvInitState = CANTRCV_OP_MODE_NORMAL
      CanTrcvMaxBaudrate = (unset)
      CanTrcvWakeupByBusUsed = false
      CanTrcvWakeupSourceRef = (unset)
      CanTrcvDioAccess: CanTrcvHardwareInterfaceName=, CanTrcvDioSymNameRef=(unset)
    CanTrcvGeneral: CanTrcvDevErrorDetect=(unset), CanTrcvGetVersionInfo=false, CanTrcvIndex=(unset), CanTrcvWakeUpSupport=
  module config Stub_ComM_Config: definition=ComM, implementation-config-variant=VARIANT-PRE-COMPILE, module-description=ComM_Impl
    ComMChannel:
      ComMBusType = 
      ComMChannelId = (unset)
      ComMMainFunctionPeriod = 0.02
      ComMNoCom = false
      ComMNoFullCom = false
      ComMNoWakeup = false
      ComMNvmBlockDescriptor = (unset)
      ComMNetworkManagement: ComMNmLightTimeout=10.0, ComMNmVariant=FULL
      ComMUserPerChannel: ComMUserChannel=(unset)
    ComMGeneral:
      ComMDevErrorDetect = false
      ComMTimerSchedulerTime = (unset)
      ComMEcuGroupClassification = 3
      ComMModeLimitationEnabled = false
      ComMNoCom = false
      ComMResetAfterForcingNoComm = false
      ComMSynchronousWakeUp = true
      ComMTMinFullComModeDuration = 5.0
      ComMVersionInfoApi = true
      ComMWakeupInhibitionEnabled = false
      COMM_DCM_ENABLED = false
      ComMGlobalNvmBlockDescriptor = (unset)
    ComMUser: ComMUserIdentifier=(unset)
  module config SpiCustom_Config: definition=SpiCustom, implementation-config-variant=VARIANT-PRE-COMPILE
    4 x SpiHwUnit, all with category=SpiHwUnit:
      SpiHwUnit_ForADC: SpiPhysicalUnit=Unit_A, SpiMode=MODE_MASTER, Spi_CLK_Continious=false, SpiHwConfig=SpiBusConfiguration_ForADC, SpiHwConfig=SpiBusConfiguration_ForADCMUX
        4 x SpiCsConfig, all with CS_Continious=false:
          SpiCsConfig_CS0: SpiCsNumber=CS0, SpiCsPolarity=CS_ACTIVE_LOW
          SpiCsConfig_CS1: SpiCsNumber=CS1, SpiCsPolarity=CS_ACTIVE_LOW
          SpiCsConfig_CS2: SpiCsNumber=CS2, SpiCsPolarity=CS_ACTIVE_HIGH
          SpiCsConfig_CS3: SpiCsNumber=CS3, SpiCsPolarity=CS_ACTIVE_HIGH
      SpiHwUnit_ForSD755: SpiPhysicalUnit=Unit_B, SpiMode=MODE_MASTER, Spi_CLK_Continious=true, SpiHwConfig=SpiBusConfiguration_ForSD755
        3 x SpiCsConfig, all with SpiCsPolarity=CS_ACTIVE_LOW, CS_Continious=true:
          SpiCsConfig_CS{0..2}: SpiCsNumber=CS{0..2}
      SpiHwUnit_ForMcuSup: SpiPhysicalUnit=Unit_C, SpiMode=MODE_SLAVE, Spi_CLK_Continious=false, SpiHwConfig=SpiBusConfiguration_ForMcuSup
        SpiCsConfig_CS0 (SpiCsConfig): SpiCsNumber=CS0, SpiCsPolarity=CS_ACTIVE_LOW, CS_Continious=false
      SpiHwUnit_ForEthernet: SpiPhysicalUnit=Unit_D, SpiMode=MODE_MASTER, Spi_CLK_Continious=false, SpiHwConfig=SpiBusConfiguration_ForEthernet
        SpiCsConfig_CS0 (SpiCsConfig): SpiCsNumber=CS0, SpiCsPolarity=CS_ACTIVE_LOW, CS_Continious=false
    5 x SpiBusConfiguration, all with category=SpiBusConfiguration, SpiDBR=DBR_0:
      SpiBusConfiguration_ForADCMUX: SpiClockPolarity=CPOL_LOW, SpiClockPhase=CPHA_LEADING, SpiPBR=PBR_3, SpiSBR=SBR_128, SpiBusFormat=8_BITS
        SpiTimeCs2Clk: SpiCs2ClkPrescaler_PCSSCK=PCSCLK_1, SpiCs2ClkDelay_CSSCK=SCSCLK_128
        SpiTimeClk2Cs: SpiClk2CsPrescaler_PASC=PASC_1, SpiClk2CsDelay_ASC=SASC_128
        SpiTimeCs2Cs: SpiCs2CsPrescaler_PDT=PDT_1, SpiCs2CsDelay_DT=SDT_2
      SpiBusConfiguration_ForADC: SpiClockPolarity=CPOL_LOW, SpiClockPhase=CPHA_LEADING, SpiPBR=PBR_3, SpiSBR=SBR_128, SpiBusFormat=16_BITS
        SpiTimeCs2Clk: SpiCs2ClkPrescaler_PCSSCK=PCSCLK_1, SpiCs2ClkDelay_CSSCK=SCSCLK_128
        SpiTimeClk2Cs: SpiClk2CsPrescaler_PASC=PASC_1, SpiClk2CsDelay_ASC=SASC_128
        SpiTimeCs2Cs: SpiCs2CsPrescaler_PDT=PDT_1, SpiCs2CsDelay_DT=SDT_2
      SpiBusConfiguration_ForSD755: SpiClockPolarity=CPOL_LOW, SpiClockPhase=CPHA_TRAILING, SpiPBR=PBR_5, SpiSBR=SBR_8, SpiBusFormat=16_BITS
        SpiTimeCs2Clk: SpiCs2ClkPrescaler_PCSSCK=PCSCLK_1, SpiCs2ClkDelay_CSSCK=SCSCLK_64
        SpiTimeClk2Cs: SpiClk2CsPrescaler_PASC=PASC_1, SpiClk2CsDelay_ASC=SASC_64
        SpiTimeCs2Cs: SpiCs2CsPrescaler_PDT=PDT_1, SpiCs2CsDelay_DT=SDT_2
      SpiBusConfiguration_ForMcuSup: SpiClockPolarity=CPOL_HIGH, SpiClockPhase=CPHA_TRAILING, SpiPBR=PBR_0, SpiSBR=SBR_0, SpiBusFormat=16_BITS
        SpiTimeCs2Clk: SpiCs2ClkPrescaler_PCSSCK=PCSCLK_0, SpiCs2ClkDelay_CSSCK=SCSCLK_0
        SpiTimeClk2Cs: SpiClk2CsPrescaler_PASC=PASC_0, SpiClk2CsDelay_ASC=SASC_0
        SpiTimeCs2Cs: SpiCs2CsPrescaler_PDT=PDT_0, SpiCs2CsDelay_DT=SDT_0
      SpiBusConfiguration_ForEthernet: SpiClockPolarity=CPOL_HIGH, SpiClockPhase=CPHA_TRAILING, SpiPBR=PBR_2, SpiSBR=SBR_64, SpiBusFormat=16_BITS
        SpiTimeCs2Clk: SpiCs2ClkPrescaler_PCSSCK=PCSCLK_1, SpiCs2ClkDelay_CSSCK=SCSCLK_128
        SpiTimeClk2Cs: SpiClk2CsPrescaler_PASC=PASC_1, SpiClk2CsDelay_ASC=SASC_128
        SpiTimeCs2Cs: SpiCs2CsPrescaler_PDT=PDT_3, SpiCs2CsDelay_DT=SDT_256
    9 x SpiDevice, all with category=SpiDevice:
      SpiDevice_ADC1: SpiEndNotification=Adc_Ext_LTC1594_SpiNotification, SpiDeviceHwUnit=SpiHwUnit_ForADC, SpiDeviceCS=SpiHwUnit_ForADC/SpiCsConfig_CS0, SpiDeviceBusConfiguration=SpiBusConfiguration_ForADC
      SpiDevice_ADC2: SpiEndNotification=Adc_Ext_LTC1594_SpiNotification, SpiDeviceHwUnit=SpiHwUnit_ForADC, SpiDeviceCS=SpiHwUnit_ForADC/SpiCsConfig_CS1, SpiDeviceBusConfiguration=SpiBusConfiguration_ForADC
      SpiDevice_ADCMUX1: SpiEndNotification=Adc_Ext_LTC1594_SpiNotification, SpiDeviceHwUnit=SpiHwUnit_ForADC, SpiDeviceCS=SpiHwUnit_ForADC/SpiCsConfig_CS2, SpiDeviceBusConfiguration=SpiBusConfiguration_ForADCMUX
      SpiDevice_ADCMUX2: SpiEndNotification=Adc_Ext_LTC1594_SpiNotification, SpiDeviceHwUnit=SpiHwUnit_ForADC, SpiDeviceCS=SpiCsConfig_CS3, SpiDeviceBusConfiguration=SpiBusConfiguration_ForADCMUX
      SpiDevice_CI_SD_Y: SpiEndNotification=SD755_SpiNotificationY, SpiDeviceHwUnit=SpiHwUnit_ForSD755, SpiDeviceCS=SpiHwUnit_ForSD755/SpiCsConfig_CS0, SpiDeviceBusConfiguration=SpiBusConfiguration_ForSD755
      SpiDevice_CI_SD_X: SpiEndNotification=SD755_SpiNotificationX, SpiDeviceHwUnit=SpiHwUnit_ForSD755, SpiDeviceCS=SpiHwUnit_ForSD755/SpiCsConfig_CS1, SpiDeviceBusConfiguration=SpiBusConfiguration_ForSD755
      SpiDevice_CI_SD_Z: SpiEndNotification=SD755_SpiNotificationZ, SpiDeviceHwUnit=SpiHwUnit_ForSD755, SpiDeviceCS=SpiHwUnit_ForSD755/SpiCsConfig_CS2, SpiDeviceBusConfiguration=SpiBusConfiguration_ForSD755
      SpiDevice_McuSup: SpiEndNotification=CT_InterMcus_Main_SpiNotification, SpiDeviceHwUnit=SpiHwUnit_ForMcuSup, SpiDeviceCS=SpiHwUnit_ForMcuSup/SpiCsConfig_CS0, SpiDeviceBusConfiguration=SpiBusConfiguration_ForMcuSup
      SpiDevice_Ethernet: SpiEndNotification=Ethernet_SepEndNotification, SpiDeviceHwUnit=SpiHwUnit_ForEthernet, SpiDeviceCS=SpiHwUnit_ForEthernet/SpiCsConfig_CS0, SpiDeviceBusConfiguration=SpiBusConfiguration_ForEthernet
    SpiGeneral: SpiDevErrorDetect=true, SpiBufferSize=4
