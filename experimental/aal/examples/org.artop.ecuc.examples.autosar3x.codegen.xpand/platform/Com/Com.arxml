AUTOSAR XML (schema 3.1.1)
package /ARRoot
  module definition Com: refined-module-def=Com
    container ComConfig: multiple-configuration-container=true  # This container contains the configuration parameters and sub containers of the COM module. This container is a MultipleConfigurationContainer, i.e. this container and its sub-containers exist once per configuration set.
      integer ComConfigurationId: set at link in variant link-time / pre-compile in variant pre-compile / post-build in variant post-build  # This ID is returned by a call to Com_GetConfigurationId.
      container ComGwMapping [0..*]  # Each instance of this container defines one mapping of the integrated Signal Gateway.
        choice container ComGwDestination [1..*]  # Each instance of this choice container allows to define one routing destination either by reference to an already configured COM signal / signal group or by a destination description container.
          container ComGwSignalDest [0..1]  # This container allows specifying a gateway source or destination respectively with a reference to a ComSignal, a ComGroupSignal or a ComSignalGroup.
            choice reference ComGwSignalRef: set at link in variant link-time / pre-compile in variant pre-compile / post-build in variant post-build, destination=[ComGroupSignal, ComSignalGroup, ComSignal]  # Reference to an object of a gateway relation. Either to a ComSignal, ComGroupSignal or to a SignalGroup.
        choice container ComGwSource  # This choice container allows the definition of the gateway source signal either by reference to an already configured COM signal / signal group or by a source description container.
          container ComGwSignalSrc [0..1]  # This container allows specifying a gateway source or destination respectively with a reference to a ComSignal, a ComGroupSignal or a ComSignalGroup.
            choice reference ComGwSignalRef: set at link in variant link-time / pre-compile in variant pre-compile / post-build in variant post-build, destination=[ComGroupSignal, ComSignalGroup, ComSignal]  # Reference to an object of a gateway relation. Either to a ComSignal, ComGroupSignal or to a SignalGroup.
      container ComIPdu [0..*]  # Contains the configuration parameters of Com I-Pdus. COM174: The shortName is used as the symbolic name (ComIpduName) of this I-Pdu when communicating with the PduR. Is optional because the Com module might be used for internal communication only. This parameter is only stored in the XML file, and must not be used within the implementation.
        function name ComIPduCallout [0..1]: set at pre-compile  # If there is a callout defined for this I-PDU this parameter contains the name of the callout function..
        integer ComIPduRxHandleId [0..1]: set at link in variant link-time+post-build / pre-compile in variant pre-compile, symbolic-name-value=true  # The numerical value used as the ID of this I-PDU. The Com_IPduRxHandleId is required by the API calls to receive I-PDUs from the PduR.It is only present for I-PDU is received from the PduR, because Com is the starting module for Tx I-PDUs and there is no need to define IDs for Tx I-PDUs in the Com module.
        enumeration ComIPduSignalProcessing [0..1]: {DEFERED, IMMEDIATE}, set at link in variant link-time / pre-compile in variant pre-compile / post-build in variant post-build  # For the definition of the two modes Immediate and Defered, see COM298.
        integer ComIPduSize: 0..254, set at link in variant link-time / pre-compile in variant pre-compile / post-build in variant post-build  # The size of the I-PDU in bytes. The maximum size is limited by the underlying communication interface.0-8 for CAN and LIN0-254 for FlexRay
        enumeration ComIpduDirection: {RECEIVE, SEND}, set at link in variant link-time / pre-compile in variant pre-compile / post-build in variant post-build  # The direction defines if this I-PDU, and therefore the contributing signals and signal groups, shall be send or received.
        reference ComIPduGroupRef: set at link in variant link-time / pre-compile in variant pre-compile / post-build in variant post-build, destination=ComIPduGroup  # Reference to the I-PDU group this I-PDU belongs to.
        reference ComIPduSignalGroupRef [0..*]: set at link in variant link-time / pre-compile in variant pre-compile / post-build in variant post-build, destination=ComSignalGroup  # References to all signal groups contained in this I-Pdu
        reference ComIPduSignalRef [0..*]: set at link in variant link-time / pre-compile in variant pre-compile / post-build in variant post-build, destination=ComSignal  # References to all signals contained in this I-PDU.
        reference PduIdRef: set at pre-compile in variant pre-compile / link in variant post-build+link-time, destination=Pdu  # Reference to the "global" Pdu structure to allow harmonization of handle IDs in the COM-Stack.
        container ComTxIPdu [0..1]  # This container contains additional transmission related configuration parameters of COM I-PDUs
          integer ComTxIPduMinimumDelayTimeFactor [0..1]: set at link in variant link-time / pre-compile in variant pre-compile / post-build in variant post-build, origin=AUTOSAR_ECUC V3.0  # COM181: Minimum delay between successive transmissions of this I-PDU, independent of the transmission mode.There is only one minimum delay time parameter for the I-PDU. This minimum delay time does not change with mode changes. Neither is the timer reset. This means that mode changes are not allowed to violate the minimum delay time. It is not possible to monitor the minumum delay time for I-PDUs that are requested using the Com_TriggerTransmit API.Depending on the implementation, this timeout may be implemented as a 32-bit or a 16-bit counter.COM471: No minimum delay time monitoring shall take place, if ComTxIPduMinimumDelayTimeFactor is omitted or configured to 0.
          integer ComTxIPduUnusedAreasDefault: 0..255, set at link in variant link-time+post-build / pre-compile in variant pre-compile  # AUTOSAR COM fills not used areas of an I-PDU with this bit-pattern. This attribute is mandatory to avoid undefined behaviour. This byte-pattern will be repeated throughout the I-PDU.
          container ComTxModeFalse [0..1]  # This container contains the configuration parameters of COM transmission modes in the case the ComFilter evaluates to false.
            container ComTxMode  # This container contains the configuration parameters of COM transmission modes.
              enumeration ComTxModeMode: {DIRECT, MIXED, NONE, PERIODIC}, set at link in variant link-time / pre-compile in variant pre-compile / post-build in variant post-build  # The available transmission modes described in [18] shall be extended by the additional mode None.The transmission mode None shall not have any further sub-attributes in the ComTxMode object.
              integer ComTxModeNumberOfRepetitions [0..1]: 0..255, set at link in variant link-time / pre-compile in variant pre-compile / post-build in variant post-build  # Defines the number of repetitions for the Direct/N-Times transmission mode and the event driven part of Mixed transmission mode.
              integer ComTxModeRepetitionPeriodFactor [0..1]: set at link in variant link-time / pre-compile in variant pre-compile / post-build in variant post-build  # Period of the repetition of the n transmission for the Direct/NTimes transmission mode and the event driven part of the Mixed transmission mode.Depending on the implementation, this timeout may be implemented as a 32-bit or a 16-bit counter.
              integer ComTxModeTimeOffsetFactor [0..1]: set at link in variant link-time / pre-compile in variant pre-compile / post-build in variant post-build  # Time until first transmission of this I-PDU.ComTxModeTimeOffsetFactor defines the time between Com_IpduGroupStart and the first transmission of the cyclic part of this transmission request for this I-PDU.Depending on the implementation, this timeout may be implemented as a 32-bit or a 16-bit counter.
              integer ComTxModeTimePeriodFactor [0..1]: set at link in variant link-time / pre-compile in variant pre-compile / post-build in variant post-build  # Period of the repetition of cyclic transmissions.Depending on the implementation, this timeout may be implemented as a 32-bit or a 16-bit counter.
          container ComTxModeTrue [0..1]  # This container contains the configuration parameters of COM transmission modes in the case the ComFilter evaluates to true.
            container ComTxMode  # This container contains the configuration parameters of COM transmission modes.
              enumeration ComTxModeMode: {DIRECT, MIXED, NONE, PERIODIC}, set at link in variant link-time / pre-compile in variant pre-compile / post-build in variant post-build  # The available transmission modes described in [18] shall be extended by the additional mode None.The transmission mode None shall not have any further sub-attributes in the ComTxMode object.
              integer ComTxModeNumberOfRepetitions [0..1]: 0..255, set at link in variant link-time / pre-compile in variant pre-compile / post-build in variant post-build  # Defines the number of repetitions for the Direct/N-Times transmission mode and the event driven part of Mixed transmission mode.
              integer ComTxModeRepetitionPeriodFactor [0..1]: set at link in variant link-time / pre-compile in variant pre-compile / post-build in variant post-build  # Period of the repetition of the n transmission for the Direct/NTimes transmission mode and the event driven part of the Mixed transmission mode.Depending on the implementation, this timeout may be implemented as a 32-bit or a 16-bit counter.
              integer ComTxModeTimeOffsetFactor [0..1]: set at link in variant link-time / pre-compile in variant pre-compile / post-build in variant post-build  # Time until first transmission of this I-PDU.ComTxModeTimeOffsetFactor defines the time between Com_IpduGroupStart and the first transmission of the cyclic part of this transmission request for this I-PDU.Depending on the implementation, this timeout may be implemented as a 32-bit or a 16-bit counter.
              integer ComTxModeTimePeriodFactor [0..1]: set at link in variant link-time / pre-compile in variant pre-compile / post-build in variant post-build  # Period of the repetition of cyclic transmissions.Depending on the implementation, this timeout may be implemented as a 32-bit or a 16-bit counter.
      container ComIPduGroup [0..*]  # Contains the configuration parameters of Com I-Pdu groups.COM126: The shortName is used as the symbolic name of the I-Pdu group (ComIpduGroupName).This parameter is only stored in the XML file, and must not be used within the implementation.
        integer ComIPduGroupHandleId: 0..31, set at link in variant link-time+post-build / pre-compile in variant pre-compile, symbolic-name-value=true  # The numerical value used as the ID of this I-PDU Group .The ComIPduGroupHandleId is required by the API calls to start and stop I-PDU Groups.For the rational for the range see COM187.
        reference ComIPduGroupGroupRef [0..1]: set at link in variant link-time / pre-compile in variant pre-compile / post-build in variant post-build, destination=ComIPduGroup  # If the I-PDU Group belongs to an I-PDU group, this is the name of the I-PDU group it belongs to. This I-PDU Group does not belong to another I-PDU group, if this reference is omitted.
      container ComSignal [0..*]  # Contains the configuration parameters of Com signals.COM163: The shortName is used as the symbolic name of the signal (ComSignalName). This name is also used as the handle name for the signal. This parameter is only stored in the XML file, and must not be used within the implementation.
        integer ComBitPosition: 0..63, set at link in variant link-time / pre-compile in variant pre-compile / post-build in variant post-build  # Starting position within the I-PDU. This parameter refers to the position in the I-PDU and not in the shadow buffer.
        integer ComBitSize: 0..64, set at link in variant link-time / pre-compile in variant pre-compile / post-build in variant post-build  # Size in bits.
        enumeration ComDataInvalidAction [0..1]: {NOTIFY, REPLACE}, set at link in variant link-time+post-build / pre-compile in variant pre-compile  # This parameter defines the action performed upon reception of an invalid signal.Relating to signal groups the action in case if one of the included signals is an invalid signal.If Replace is used the ComSignalInitValue will be used for the replacement.
        function name ComErrorNotification [0..1]: set at link in variant link-time+post-build / pre-compile in variant pre-compile  # Only valid on sender side: Name of Com_CbkTxErr callback function to be called.If this parameter is omitted no error notification shall take place.
        integer ComFirstTimeoutFactor [0..1]: set at link in variant link-time+post-build / pre-compile in variant pre-compile  # Defines the first timeout period for the deadline monitoring. Details can be found in [17].Note: See also COM263 for the configuration of the remaining timeout periods.Depending on the implementation, this timeout may be implemented as a 32-bit or a 16-bit counter.
        integer ComHandleId: set at link in variant link-time+post-build / pre-compile in variant pre-compile, symbolic-name-value=true  # The numerical value used as the ID.For signals it is required by the API calls Com_UpdateShadowSignal, Com_ReceiveShadowSignal and Com_InvalidateShadowSignal.For signals groups it is required by the Com_SendSignalGroup and Com_ReceiveSignalGroup calls.
        function name ComInvalidNotification [0..1]: set at link in variant link-time+post-build / pre-compile in variant pre-compile  # Only valid on receiver side: Name of Com_CbkRxInv callback function to be called.Name of the function which notifies the RTE about the reception of an invalidated signal/ signal group. Only applicable if ComSignalDataInvalidAction is configured to Notify.
        function name ComNotification [0..1]: set at link in variant link-time+post-build / pre-compile in variant pre-compile  # On sender side: Name of Com_CbkTxAck callback function to be called.On receiver side: Name of Com_CbkRxAck callback function to be called.If this parameter is omitted no notification shall take place.
        enumeration ComRxDataTimeoutAction [0..1]: {NONE, REPLACE}, set at link in variant link-time+post-build / pre-compile in variant pre-compile  # COM412: This parameter defines the action performed upon a reception timeout violation.COM500: If this parameter is omitted or configured to None no replacement shall take place.COM470: Relating to signals: When this parameter is set to Replace, the replacement value used shall be the ComInitValue.COM513: Relating to signal groups: When this parameter is set to Replace, all included signals shall be set to their ComInitValue.
        integer ComSignalDataInvalidValue [0..1]: set at link in variant link-time+post-build / pre-compile in variant pre-compile  # COM391: On receiver side: When this value is received it is recognized as the invalid value and the appropriate invalid action (as specified by ComDataInvalidAction) is performed.COM501: On sender side:This configures the data invalid value that is used by a call to Com_InvalidateSignal.
        enumeration ComSignalEndianess: {BIG_ENDIAN, LITTLE_ENDIAN, OPAQUE}, set at link in variant link-time / pre-compile in variant pre-compile / post-build in variant post-build  # Defines the endianness of the signal's network representation.
        integer ComSignalInitValue [0..1]: set at link in variant link-time / pre-compile in variant pre-compile / post-build in variant post-build, default-value=0  # COM170: Initial value for this signal. The default value is 0.The lower n-bits of the configured Integer shall be used as init-value for an n-bit sized signal type.COM483: If the signal is of type UINT[n], the Integer's least significant byte shall be assigned to the byte array’s last byte. The second-least significant byte shall be assigned to the byte array’s last but one byte, and so on.
        integer ComSignalLength [0..1]: 1..8, set at link in variant link-time+post-build / pre-compile in variant pre-compile  # The ComSignalLength specifies the n (in Bytes: 1..8) of the type UINT8[n]. For other types it will be ignored.
        enumeration ComSignalType: {BOOLEAN, SINT16, SINT32, SINT8, UINT16, UINT32, UINT8, UINT8_N}, set at link in variant link-time / pre-compile in variant pre-compile / post-build in variant post-build  # The AUTOSAR type of the signal. Whether or not the signal is signed or unsigned can be found by examining the value of this attribute.This type could also be used to reserved appropriate storage in AUTOSAR COM.
        integer ComTimeoutFactor [0..1]: set at link in variant link-time+post-build / pre-compile in variant pre-compile  # COM263: Defines the timeout period for the deadline monitoring. Details can be found in [17]. Note: The period for the ComFirstTimeoutFactor could differ from the ComTimeoutFactor.Depending on the implementation, this timeout may be implemented as a 32-bit or a 16-bit counter.COM264: If deadline monitoring is used on a signal with an update-bit this defines the timeout for deadline monitoring. COM333: If the timeout is omitted or configured to 0 than no timeout monitoring shall take place. In this case ComFirstTimeoutFactor shall be ignored.
        function name ComTimeoutNotification [0..1]: set at link in variant link-time+post-build / pre-compile in variant pre-compile  # On sender side: Name of Com_CbkTxTOut callback function to be called.On receiver side: Name of Com_CbkRxTOut callback function to be called.
        enumeration ComTransferProperty [0..1]: {PENDING, TRIGGERED}, set at link in variant link-time / pre-compile in variant pre-compile / post-build in variant post-build  # Derived from [18].
        integer ComUpdateBitPosition [0..1]: 0..63, set at link in variant link-time / pre-compile in variant pre-compile / post-build in variant post-build  # Bit position of update-bit inside I-PDU.If this attribute is omitted then there is no update-bit.This setting must be consistently on sender and on receiver side.
        foreign reference SystemTemplateSystemSignalRef: set at pre-compile in variant pre-compile / link in variant link-time / post-build in variant post-build, destination-type=ISignalToIPduMapping  # Reference to the ISignalToIPduMapping that contains a reference to the ISignal (System Template) which this ComSignal (or ComGroupSignal) represents.
        container ComFilter [0..1]  # This container contains the configuration parameters of COM Filters.Note: On sender side the container is used to specify the transmission mode conditions.
          enumeration ComFilterAlgorithm: {ALWAYS, MASKED_NEW_DIFFERS_MASKED_OLD, MASKED_NEW_DIFFERS_X, MASKED_NEW_EQUALS_X, NEVER, NEW_IS_OUTSIDE, NEW_IS_WITHIN, ONE_EVERY_N}, set at link in variant link-time+post-build / pre-compile in variant pre-compile  # The range of values is specified in the [17] specification, chapter 2.2.2, Reception Filtering.
          integer ComFilterMask [0..1]: set at link in variant link-time+post-build / pre-compile in variant pre-compile  # The name of this attribute corresponds to the parameter name in the [17] specification of Reception Filtering. Only the least significant 32 bits are significant.
          integer ComFilterMax [0..1]: set at link in variant link-time+post-build / pre-compile in variant pre-compile  # The name of this attribute corresponds to the parameter name in the [17] specification of Reception Filtering. Only the least significant 32 bits are significant.
          integer ComFilterMin [0..1]: set at link in variant link-time+post-build / pre-compile in variant pre-compile  # The name of this attribute corresponds to the parameter name in the [17] specification of Reception Filtering. Only the least significant 32 bits are significant.
          integer ComFilterOffset [0..1]: set at link in variant link-time+post-build / pre-compile in variant pre-compile  # The name of this attribute corresponds to the parameter name in the [17] specification of Reception Filtering. Only the least significant 32 bits are significant.Range = 0..(ComFilterPeriodFactor-1)
          integer ComFilterPeriodFactor [0..1]: set at link in variant link-time+post-build / pre-compile in variant pre-compile  # The name of this attribute corresponds to the parameter name in the [17] specification of Reception Filtering. Only the least significant 32 are significant.
          integer ComFilterX [0..1]: set at link in variant link-time+post-build / pre-compile in variant pre-compile  # The name of this attribute corresponds to the parameter name in the [17] specification of Reception Filtering. Only the least significant 32 bits are significant.
      container ComSignalGroup [0..*]  # Contains the configuration parameters of Com signal groups.COM044: The shortName is used as the symbolic name of the signal group (ComSignalGroupName). This name is also used as the handle name for the signal group. This parameter is only stored in the XML file, and must not be used within the implementation.
        integer ComBitPosition: 0..63, set at link in variant link-time / pre-compile in variant pre-compile / post-build in variant post-build  # Starting position within the I-PDU. This parameter refers to the position in the I-PDU and not in the shadow buffer.
        integer ComBitSize: 0..64, set at link in variant link-time+post-build / pre-compile in variant pre-compile  # Size in bits.
        enumeration ComDataInvalidAction [0..1]: {NOTIFY, REPLACE}, set at link in variant link-time+post-build / pre-compile in variant pre-compile  # This parameter defines the action performed upon reception of an invalid signal.Relating to signal groups the action in case if one of the included signals is an invalid signal.If Replace is used the ComSignalInitValue will be used for the replacement.
        function name ComErrorNotification [0..1]: set at link in variant link-time+post-build / pre-compile in variant pre-compile  # Only valid on sender side: Name of Com_CbkTxErr callback function to be called.If this parameter is omitted no error notification shall take place.
        integer ComFirstTimeoutFactor [0..1]: set at link in variant link-time+post-build / pre-compile in variant pre-compile  # Defines the first timeout period for the deadline monitoring. Details can be found in [17].Note: See also COM263 for the configuration of the remaining timeout periods.Depending on the implementation, this timeout may be implemented as a 32-bit or a 16-bit counter.
        integer ComHandleId: set at link in variant link-time+post-build / pre-compile in variant pre-compile, symbolic-name-value=true  # The numerical value used as the ID.For signals it is required by the API calls Com_UpdateShadowSignal, Com_ReceiveShadowSignal and Com_InvalidateShadowSignal.For signals groups it is required by the Com_SendSignalGroup and Com_ReceiveSignalGroup calls.
        function name ComInvalidNotification [0..1]: set at link in variant link-time+post-build / pre-compile in variant pre-compile  # Only valid on receiver side: Name of Com_CbkRxInv callback function to be called.Name of the function which notifies the RTE about the reception of an invalidated signal/ signal group. Only applicable if ComSignalDataInvalidAction is configured to Notify.
        function name ComNotification [0..1]: set at link in variant link-time+post-build / pre-compile in variant pre-compile  # On sender side: Name of Com_CbkTxAck callback function to be called.On receiver side: Name of Com_CbkRxAck callback function to be called.If this parameter is omitted no notification shall take place.
        enumeration ComRxDataTimeoutAction [0..1]: {NONE, REPLACE}, set at link in variant link-time+post-build / pre-compile in variant pre-compile  # COM412: This parameter defines the action performed upon a reception timeout violation.COM500: If this parameter is omitted or configured to None no replacement shall take place.COM470: Relating to signals: When this parameter is set to Replace, the replacement value used shall be the ComInitValue.COM513: Relating to signal groups: When this parameter is set to Replace, all included signals shall be set to their ComInitValue.
        integer ComTimeoutFactor [0..1]: set at link in variant link-time+post-build / pre-compile in variant pre-compile  # COM263: Defines the timeout period for the deadline monitoring. Details can be found in [17]. Note: The period for the ComFirstTimeoutFactor could differ from the ComTimeoutFactor.Depending on the implementation, this timeout may be implemented as a 32-bit or a 16-bit counter.COM264: If deadline monitoring is used on a signal with an update-bit this defines the timeout for deadline monitoring. COM333: If the timeout is omitted or configured to 0 than no timeout monitoring shall take place. In this case ComFirstTimeoutFactor shall be ignored.
        function name ComTimeoutNotification [0..1]: set at link in variant link-time+post-build / pre-compile in variant pre-compile  # On sender side: Name of Com_CbkTxTOut callback function to be called.On receiver side: Name of Com_CbkRxTOut callback function to be called.
        enumeration ComTransferProperty [0..1]: {PENDING, TRIGGERED}, set at link in variant link-time / pre-compile in variant pre-compile / post-build in variant post-build  # Derived from [18].
        integer ComUpdateBitPosition [0..1]: 0..63, set at link in variant link-time / pre-compile in variant pre-compile / post-build in variant post-build  # Bit position of update-bit inside I-PDU.If this attribute is omitted then there is no update-bit.This setting must be consistently on sender and on receiver side.
        foreign reference SystemTemplateSignalGroupRef: set at pre-compile in variant pre-compile / link in variant link-time / post-build in variant post-build, destination-type=ISignalToIPduMapping  # Reference to the ISignalToIPduMapping that contains a reference to the ISignal (SystemTemplate) which this ComSignalGroup represents.
        container ComGroupSignal [0..*]  # COM520: This container contains the configuration parameters of group signals. I.e. signals that are included within a signal group.COM521: The shortName is used as the symbolic name of the signal (ComSignalName). This name is also used as the handle name for the signal. This parameter is only stored in the XML file, and must not be used within the implementation.
          integer ComBitPosition: 0..63, set at link in variant link-time / pre-compile in variant pre-compile / post-build in variant post-build  # Starting position within the I-PDU. This parameter refers to the position in the I-PDU and not in the shadow buffer.
          integer ComBitSize: 0..64, set at link in variant link-time / pre-compile in variant pre-compile / post-build in variant post-build  # Size in bits.
          integer ComHandleId: set at link in variant link-time+post-build / pre-compile in variant pre-compile, symbolic-name-value=true  # The numerical value used as the ID.For signals it is required by the API calls Com_UpdateShadowSignal, Com_ReceiveShadowSignal and Com_InvalidateShadowSignal.For signals groups it is required by the Com_SendSignalGroup and Com_ReceiveSignalGroup calls.
          function name ComInvalidNotification [0..1]: set at link in variant link-time+post-build / pre-compile in variant pre-compile  # Only valid on receiver side: Name of Com_CbkRxInv callback function to be called.Name of the function which notifies the RTE about the reception of an invalidated signal/ signal group. Only applicable if ComSignalDataInvalidAction is configured to Notify.
          integer ComSignalDataInvalidValue [0..1]: set at link in variant link-time+post-build / pre-compile in variant pre-compile  # COM391: On receiver side: When this value is received it is recognized as the invalid value and the appropriate invalid action (as specified by ComDataInvalidAction) is performed.COM501: On sender side:This configures the data invalid value that is used by a call to Com_InvalidateSignal.
          enumeration ComSignalEndianess: {BIG_ENDIAN, LITTLE_ENDIAN, OPAQUE}, set at link in variant link-time / pre-compile in variant pre-compile / post-build in variant post-build  # Defines the endianness of the signal's network representation.
          integer ComSignalInitValue [0..1]: set at link in variant link-time / pre-compile in variant pre-compile / post-build in variant post-build, default-value=0  # COM170: Initial value for this signal. The default value is 0.The lower n-bits of the configured Integer shall be used as init-value for an n-bit sized signal type.COM483: If the signal is of type UINT[n], the Integer's least significant byte shall be assigned to the byte array’s last byte. The second-least significant byte shall be assigned to the byte array’s last but one byte, and so on.
          integer ComSignalLength [0..1]: 1..8, set at link in variant link-time+post-build / pre-compile in variant pre-compile  # The ComSignalLength specifies the n (in Bytes: 1..8) of the type UINT8[n]. For other types it will be ignored.
          enumeration ComSignalType: {BOOLEAN, SINT16, SINT32, SINT8, UINT16, UINT32, UINT8, UINT8_N}, set at link in variant link-time / pre-compile in variant pre-compile / post-build in variant post-build  # The AUTOSAR type of the signal. Whether or not the signal is signed or unsigned can be found by examining the value of this attribute.This type could also be used to reserved appropriate storage in AUTOSAR COM.
          foreign reference SystemTemplateSystemSignalRef: set at pre-compile in variant pre-compile / link in variant link-time / post-build in variant post-build, destination-type=ISignalToIPduMapping  # Reference to the ISignalToIPduMapping that contains a reference to the ISignal (System Template) which this ComSignal (or ComGroupSignal) represents.
          container ComFilter [0..1]  # This container contains the configuration parameters of COM Filters.Note: On sender side the container is used to specify the transmission mode conditions.
            enumeration ComFilterAlgorithm: {ALWAYS, MASKED_NEW_DIFFERS_MASKED_OLD, MASKED_NEW_DIFFERS_X, MASKED_NEW_EQUALS_X, NEVER, NEW_IS_OUTSIDE, NEW_IS_WITHIN, ONE_EVERY_N}, set at link in variant link-time+post-build / pre-compile in variant pre-compile  # The range of values is specified in the [17] specification, chapter 2.2.2, Reception Filtering.
            integer ComFilterMask [0..1]: set at link in variant link-time+post-build / pre-compile in variant pre-compile  # The name of this attribute corresponds to the parameter name in the [17] specification of Reception Filtering. Only the least significant 32 bits are significant.
            integer ComFilterMax [0..1]: set at link in variant link-time+post-build / pre-compile in variant pre-compile  # The name of this attribute corresponds to the parameter name in the [17] specification of Reception Filtering. Only the least significant 32 bits are significant.
            integer ComFilterMin [0..1]: set at link in variant link-time+post-build / pre-compile in variant pre-compile  # The name of this attribute corresponds to the parameter name in the [17] specification of Reception Filtering. Only the least significant 32 bits are significant.
            integer ComFilterOffset [0..1]: set at link in variant link-time+post-build / pre-compile in variant pre-compile  # The name of this attribute corresponds to the parameter name in the [17] specification of Reception Filtering. Only the least significant 32 bits are significant.Range = 0..(ComFilterPeriodFactor-1)
            integer ComFilterPeriodFactor [0..1]: set at link in variant link-time+post-build / pre-compile in variant pre-compile  # The name of this attribute corresponds to the parameter name in the [17] specification of Reception Filtering. Only the least significant 32 are significant.
            integer ComFilterX [0..1]: set at link in variant link-time+post-build / pre-compile in variant pre-compile  # The name of this attribute corresponds to the parameter name in the [17] specification of Reception Filtering. Only the least significant 32 bits are significant.
    container ComGeneral  # Contains the general configuration parameters of the Com module.
      string ComRteCbkIncludeFile [0..*]: set at pre-compile in variant pre-compile / link in variant link-time+post-build
      float ComConfigurationTimeBase: set at pre-compile  # The period between successive calls to the Main Functions (Rx, Tx, Routing) of AUTOSAR COM in seconds.
      boolean ComConfigurationUseDet [0..1]: set at pre-compile  # The error hook shall contain code to call the Det.If this parameter is configured COM_DEV_ERROR_DETECT shall be set to ON as output of the configuration tool. (as input for the source code), see COM028.
      boolean ComVersionInfoApi: set at pre-compile  # Activate/Deactivate the version information API (Com_GetVersionInfo).True: version information API activatedFalse: version information API deactivated
      reference ComPduRGeneralRef: destination=PduRGeneral
      reference ComCanIfInitConfigurationRef [0..1]: destination=CanIfInitConfiguration
      reference ComFrIfConfigRef [0..1]: destination=FrIfConfig
      reference ComLinIfGlobalConfigRef [0..1]: destination=LinIfGlobalConfig
  bsw module description Com_Desc
  bsw behavior Com_Beh: module=Com_Desc
  bsw implementation Com_Impl: programming-language=C, behavior=Com_Beh, preconfigured-configuration=Com_Impl_preconfigured, recommended-configuration=Com_Impl_recommended, vendor-specific-module-def=Com
  module config Com_Impl_preconfigured: definition=Com, implementation-config-variant=VARIANT-PRE-COMPILE, module-description=Com_Impl
    ComConfig: ComConfigurationId=(unset)
      ComGwMapping
        ComGwSignal (ComGwSignalDest): ComGwSignalRef=(unset)
        ComGwSignal (ComGwSignalSrc): ComGwSignalRef=(unset)
      ComIPdu:
        ComIPduCallout = (unset)
        ComIPduRxHandleId = (unset)
        ComIPduSignalProcessing = (unset)
        ComIPduSize = (unset)
        ComIpduDirection = (unset)
        ComIPduGroupRef = (unset)
        ComIPduSignalGroupRef = (unset)
        ComIPduSignalRef = (unset)
        PduIdRef = (unset)
        ComTxIPdu: ComTxIPduMinimumDelayTimeFactor=(unset), ComTxIPduUnusedAreasDefault=(unset)
          ComTxModeFalse
            ComTxMode:
              ComTxModeMode = (unset)
              ComTxModeNumberOfRepetitions = (unset)
              ComTxModeRepetitionPeriodFactor = (unset)
              ComTxModeTimeOffsetFactor = (unset)
              ComTxModeTimePeriodFactor = (unset)
          ComTxModeTrue
            ComTxMode:
              ComTxModeMode = (unset)
              ComTxModeNumberOfRepetitions = (unset)
              ComTxModeRepetitionPeriodFactor = (unset)
              ComTxModeTimeOffsetFactor = (unset)
              ComTxModeTimePeriodFactor = (unset)
      ComIPduGroup: ComIPduGroupHandleId=(unset), ComIPduGroupGroupRef=(unset)
      ComSignal:
        ComBitPosition = (unset)
        ComBitSize = (unset)
        ComDataInvalidAction = (unset)
        ComErrorNotification = (unset)
        ComFirstTimeoutFactor = (unset)
        ComHandleId = (unset)
        ComInvalidNotification = (unset)
        ComNotification = (unset)
        ComRxDataTimeoutAction = (unset)
        ComSignalDataInvalidValue = (unset)
        ComSignalEndianess = (unset)
        ComSignalInitValue = (unset)
        ComSignalLength = (unset)
        ComSignalType = (unset)
        ComTimeoutFactor = (unset)
        ComTimeoutNotification = (unset)
        ComTransferProperty = (unset)
        ComUpdateBitPosition = (unset)
        SystemTemplateSystemSignalRef = (unset)
        ComFilter:
          ComFilterAlgorithm = (unset)
          ComFilterMask = (unset)
          ComFilterMax = (unset)
          ComFilterMin = (unset)
          ComFilterOffset = (unset)
          ComFilterPeriodFactor = (unset)
          ComFilterX = (unset)
      ComSignalGroup:
        ComBitPosition = (unset)
        ComBitSize = (unset)
        ComDataInvalidAction = (unset)
        ComErrorNotification = (unset)
        ComFirstTimeoutFactor = (unset)
        ComHandleId = (unset)
        ComInvalidNotification = (unset)
        ComNotification = (unset)
        ComRxDataTimeoutAction = (unset)
        ComTimeoutFactor = (unset)
        ComTimeoutNotification = (unset)
        ComTransferProperty = (unset)
        ComUpdateBitPosition = (unset)
        SystemTemplateSignalGroupRef = (unset)
        ComGroupSignal:
          ComBitPosition = (unset)
          ComBitSize = (unset)
          ComHandleId = (unset)
          ComInvalidNotification = (unset)
          ComSignalDataInvalidValue = (unset)
          ComSignalEndianess = (unset)
          ComSignalInitValue = (unset)
          ComSignalLength = (unset)
          ComSignalType = (unset)
          SystemTemplateSystemSignalRef = (unset)
          ComFilter:
            ComFilterAlgorithm = (unset)
            ComFilterMask = (unset)
            ComFilterMax = (unset)
            ComFilterMin = (unset)
            ComFilterOffset = (unset)
            ComFilterPeriodFactor = (unset)
            ComFilterX = (unset)
    ComGeneral:
      ComConfigurationTimeBase = (unset)
      ComConfigurationUseDet = (unset)
      ComVersionInfoApi = (unset)
      ComRteCbkIncludeFile = (unset)
      ComPduRGeneralRef = (unset)
      ComCanIfInitConfigurationRef = (unset)
      ComFrIfConfigRef = (unset)
      ComLinIfGlobalConfigRef = (unset)
  module config Com_Impl_recommended: definition=Com, implementation-config-variant=VARIANT-PRE-COMPILE, module-description=Com_Impl
    ComConfig: ComConfigurationId=(unset)
      ComGwMapping
        ComGwSignal (ComGwSignalDest): ComGwSignalRef=(unset)
        ComGwSignal (ComGwSignalSrc): ComGwSignalRef=(unset)
      ComIPdu:
        ComIPduCallout = (unset)
        ComIPduRxHandleId = (unset)
        ComIPduSignalProcessing = (unset)
        ComIPduSize = (unset)
        ComIpduDirection = (unset)
        ComIPduGroupRef = (unset)
        ComIPduSignalGroupRef = (unset)
        ComIPduSignalRef = (unset)
        PduIdRef = (unset)
        ComTxIPdu: ComTxIPduMinimumDelayTimeFactor=(unset), ComTxIPduUnusedAreasDefault=(unset)
          ComTxModeFalse
            ComTxMode:
              ComTxModeMode = (unset)
              ComTxModeNumberOfRepetitions = (unset)
              ComTxModeRepetitionPeriodFactor = (unset)
              ComTxModeTimeOffsetFactor = (unset)
              ComTxModeTimePeriodFactor = (unset)
          ComTxModeTrue
            ComTxMode:
              ComTxModeMode = (unset)
              ComTxModeNumberOfRepetitions = (unset)
              ComTxModeRepetitionPeriodFactor = (unset)
              ComTxModeTimeOffsetFactor = (unset)
              ComTxModeTimePeriodFactor = (unset)
      ComIPduGroup: ComIPduGroupHandleId=(unset), ComIPduGroupGroupRef=(unset)
      ComSignal:
        ComBitPosition = (unset)
        ComBitSize = (unset)
        ComDataInvalidAction = (unset)
        ComErrorNotification = (unset)
        ComFirstTimeoutFactor = (unset)
        ComHandleId = (unset)
        ComInvalidNotification = (unset)
        ComNotification = (unset)
        ComRxDataTimeoutAction = (unset)
        ComSignalDataInvalidValue = (unset)
        ComSignalEndianess = (unset)
        ComSignalInitValue = 0
        ComSignalLength = (unset)
        ComSignalType = (unset)
        ComTimeoutFactor = (unset)
        ComTimeoutNotification = (unset)
        ComTransferProperty = (unset)
        ComUpdateBitPosition = (unset)
        SystemTemplateSystemSignalRef = (unset)
        ComFilter:
          ComFilterAlgorithm = (unset)
          ComFilterMask = (unset)
          ComFilterMax = (unset)
          ComFilterMin = (unset)
          ComFilterOffset = (unset)
          ComFilterPeriodFactor = (unset)
          ComFilterX = (unset)
      ComSignalGroup:
        ComBitPosition = (unset)
        ComBitSize = (unset)
        ComDataInvalidAction = (unset)
        ComErrorNotification = (unset)
        ComFirstTimeoutFactor = (unset)
        ComHandleId = (unset)
        ComInvalidNotification = (unset)
        ComNotification = (unset)
        ComRxDataTimeoutAction = (unset)
        ComTimeoutFactor = (unset)
        ComTimeoutNotification = (unset)
        ComTransferProperty = (unset)
        ComUpdateBitPosition = (unset)
        SystemTemplateSignalGroupRef = (unset)
        ComGroupSignal:
          ComBitPosition = (unset)
          ComBitSize = (unset)
          ComHandleId = (unset)
          ComInvalidNotification = (unset)
          ComSignalDataInvalidValue = (unset)
          ComSignalEndianess = (unset)
          ComSignalInitValue = 0
          ComSignalLength = (unset)
          ComSignalType = (unset)
          SystemTemplateSystemSignalRef = (unset)
          ComFilter:
            ComFilterAlgorithm = (unset)
            ComFilterMask = (unset)
            ComFilterMax = (unset)
            ComFilterMin = (unset)
            ComFilterOffset = (unset)
            ComFilterPeriodFactor = (unset)
            ComFilterX = (unset)
    ComGeneral:
      ComConfigurationTimeBase = (unset)
      ComConfigurationUseDet = true
      ComVersionInfoApi = true
      ComRteCbkIncludeFile = Rte_Cbk.h
      ComPduRGeneralRef = (unset)
      ComCanIfInitConfigurationRef = (unset)
      ComFrIfConfigRef = (unset)
      ComLinIfGlobalConfigRef = (unset)
