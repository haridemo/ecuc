AUTOSAR XML (schema 3.1.4)
package /ARRoot
  module definition PduR: refined-module-def=PduR
    container PduRGeneral  # This container is a subcontainer of PduR and specifies the general configuration parameters of the PDU Router.
      boolean PduRCanIfSupport: set at pre-compile  # Configuration parameter to enable or disable PDU Router support for CAN interface.
      boolean PduRCanTpSupport: set at pre-compile  # Configuration parameter to enable or disable PDU Router support for CAN TP.
      boolean PduRComSupport: set at pre-compile  # Configuration parameter to enable or disable PDU Router support for COM.
      boolean PduRDcmSupport: set at pre-compile  # Configuration parameter to enable or disable PDU Router support for DCM.
      boolean PduRDevErrorDetect: set at pre-compile  # Switches the Development Error Detection and Notification ON or OFF.
      integer PduRTxMulticastToTpNumber [0..1]: 0..65535, origin=GEENSYS  # Number of Multicast transmission IPDU from DCM to TP modules. This parameter is useless if PDUR_MULTICAST_TOTP_SUPPORT = STD_OFF, else this parameter is not mandatory, if it doesnâ€™t exist it will be automatically filled with the number of multicast transmission IPDU from DCM but you won't be able to add multicast from DCM to TP I-PDU. (If you want to add in post build time Multicast transmission IPDU from DCM, you must fill this parameter, it will reserve RAM space for internal control variables).
      boolean PduRFifoTxBufferSupport: set at pre-compile  # Configuration parameter to enable or disable PDU Router support for FIFOs as PDU transmit buffers; if PDUR_GATEWAY_OPERATION is disabled, this parameter has to be disabled.
      boolean PduRFrIfSupport: set at pre-compile  # Configuration parameter to enable or disable PDU Router support for FlexRay interface.
      boolean PduRFrTpSupport: set at pre-compile  # Configuration parameter to enable or disable PDU Router support for FlexRay TP.
      boolean PduRGatewayOperation: set at pre-compile  # Configuration parameter to enable or disable PDU Router gateway operation; if PDUR_ZERO_COST_OPERATION is enabled, this parameter has to be disabled.
      boolean PduRIPduMSupport: set at pre-compile  # Configuration parameter to enable or disable PDU Router support for IPDUM; if PDUR_ZERO_COST_OPERATION is enabled, this parameter has to be disabled.
      boolean PduRLinIfSupport: set at pre-compile  # Configuration parameter to enable or disable PDU Router support for LIN interface.
      boolean PduRLinTpSupport: set at pre-compile  # Configuration parameter to enable or disable PDU Router support for LIN TP.
      integer PduRMemorySize: set at pre-compile  # Memory size reserved for PDU Router buffers. Only required for gateway operation.
      enumeration PduRMinimumRoutingLoModule [0..1]: {CAN_IF, CAN_TP, FR_IF, FR_TP, LIN_IF, LIN_TP}, set at link  # Lower layer module to be used for minimum routing; this parameter shall be used if PDUR_ZERO_COST_OPERATION is disabled; otherwise it shall not be used.
      integer PduRMinimumRoutingLoRxPduId [0..1]: 0..65535, set at link  # Receive PDU identifier of the lower layer module which shall be used at the PDU Router interface to the lower layer module specified by PDUR_MINIMUM_ROUTING_LO_MODULE for minimum routing; this parameter shall be used if PDUR_ZERO_COST_OPERATION is disabled; otherwise it shall not be used.
      integer PduRMinimumRoutingLoTxPduId [0..1]: 0..65535, set at link  # Transmit PDU identifier of the lower layer module which shall be used at the PDU Router interface to the lower layer module specified by PDUR_MINIMUM_ROUTING_LO_MODULE for minimum routing; this parameter shall be used if PDUR_ZERO_COST_OPERATION is disabled; otherwise it shall not be used.
      enumeration PduRMinimumRoutingUpModule [0..1]: {COM, DCM}, set at link  # Upper layer module to be used for minimum routing; this parameter shall be used if PDUR_ZERO_COST_OPERATION is disabled; otherwise it shall not be used.
      integer PduRMinimumRoutingUpRxPduId [0..1]: 0..65535, set at link  # Receive PDU identifier of the upper layer module which shall be used at the PDU Router interface to the upper layer module specified by PDUR_MINIMUM_ROUTING_UP_MODULE for minimum routing; this parameter shall be used if PDUR_ZERO_COST_OPERATION is disabled; otherwise it shall not be used.
      integer PduRMinimumRoutingUpTxPduId [0..1]: 0..65535, set at link  # Transmit PDU identifier of the upper layer module which shall be used at the PDU Router interface to the upper layer module specified by PDUR_MINIMUM_ROUTING_UP_MODULE for minimum routing; this parameter shall be used if PDUR_ZERO_COST_OPERATION is disabled; otherwise it shall not be used.
      boolean PduRCanTpChangeParameterSupport: set at pre-compile, origin=GEENSYS  # Activates/Deactivates the change parameter capability for CanTp.
      boolean PduRFrTpChangeParameterSupport: set at pre-compile, origin=GEENSYS  # Activates/Deactivates the change parameter capability for FrTp.
      boolean PduRLinTpChangeParameterSupport: set at pre-compile, origin=GEENSYS  # Activates/Deactivates the change parameter capability for LinTp.
      boolean PduRUseConsecutiveHandleId: set at pre-compile, origin=GEENSYS  # Confirm that all HandleId used are consecutive from 0 to HandleIdMax. This parameter permits to use the received HandleId as an Index of an area. It is more efficient, but if a HandleId in the middle (between 0 and HandleIdMax) is not used or not configured, it will be stub by the configuration tool and memory space will be reserved for it. If this option is not activated you can use any HandleId from 0 to 65535, each API will search the index of the area for the corresponding HandleId. For Instance: If you have only two IPDU with HandleId 72 and 145, don't use this option or you will reserved an area of 146 elements where just two are useful.
      boolean PduRTxBufferDefaultValueUsed [0..1]: set at pre-compile, origin=GEENSYS  # This parameter indicates if some default values for TxBuffer can be configured. This parameter is useful only when PduRGatewaySupport is enabled.
      boolean PduRMinimumRoutingUsed: set at pre-compile, origin=GEENSYS  # This parameter indicates if the minimum routing is used or not.
      boolean PduRUseConsecutiveTxIdInLowLayer: set at pre-compile, origin=GEENSYS  # Confirm that all TxId using by PduR in lower layer modules are consecutive from 0 to TxIdMax (in and between lower layer modules). For Instance: CANIF : TxId0 = 0 , TxId1 = 1 FRIF : TxId0 = 2 , TxId1 = 3, TxId2 = 4 LINIF : TxId0 = 5 IPDUM : TxId0 = 6 CANTP : TxId0 = 7 , TxId1 = 8 FRTP : TxId0 = 9 , TxId1 = 10, TxId2 = 11 LINTP : TxId0 = 12. If you use only one lower layer module, this parameter can be set to true. It permits to use the TxId as an Index of an area. It is more efficient. If a TxId in the middle (between 0 and TxIdMax) is not used or not configured, it will be stub by the configuration tool and memory space will be reserved for it. If this option is not activated you can use in lower layer module any TxId from 0 to 65535 but only one time by lower layer module; then each API (concerning Tx PDU) from lower layer module will search the index of the area for the corresponding TxId.
      boolean PduRMulticastFromIfSupport: set at pre-compile  # Configuration parameter to enable or disable PDU Router support for multicasts from an interface module to upper layer modules or lower layer interface modules; if PDUR_ZERO_COST_OPERATION is enabled, this parameter has to be disabled.
      boolean PduRMulticastFromTpSupport: set at pre-compile  # Configuration parameter to enable or disable PDU Router support for multicasts from a TP module to upper layer modules or lower layer TP modules; if PDUR_ZERO_COST_OPERATION is enabled, this parameter has to be disabled.
      boolean PduRMulticastToIfSupport: set at pre-compile  # Configuration parameter to enable or disable PDU Router support for multicasts from an upper layer module to interface modules; if PDUR_ZERO_COST_OPERATION is enabled, this parameter has to be disabled.
      boolean PduRMulticastToTpSupport: set at pre-compile  # Configuration parameter to enable or disable PDU Router support for multicasts from an upper layer module to TP modules; if PDUR_ZERO_COST_OPERATION is enabled, this parameter has to be disabled.
      boolean PduRSbTxBufferSupport: set at pre-compile  # Configuration parameter to enable or disable PDU Router support for single buffers as PDU transmit buffers; if PDUR_GATEWAY_OPERATION is disabled, this parameter has to be disabled.
      enumeration PduRSingleIf [0..1]: {CAN_IF, FR_IF, LIN_IF}, set at pre-compile  # Single interface module in case zero cost operation is enabled (PDUR_ZERO_COST_OPERATION).
      enumeration PduRSingleTp [0..1]: {CAN_TP, FR_TP, LIN_TP}, set at pre-compile  # Single transport protocol module in case zero cost operation is enabled (PDUR_ZERO_COST_OPERATION).
      boolean PduRVersionInfoApi: set at pre-compile  # Activates/Deactivates the Version Info API.
      boolean PduRZeroCostOperation: set at pre-compile  # All routing paths are implicitly defined and the communication modules directly above or below the PDU Router shall directly call each other without using PDU Router functions (zero cost operation). The configuration parameters PDUR_SINGLE_IF and PDUR_SINGLE_TP are used to specify the related lower layer module.
      reference PduRCanIfRef [0..1]: origin=GEENSYS, destination=CanIfInitConfiguration  # Reference to CanIf which is used for the current configuration. This parameter can be deleted if CanIf module is not used.
      reference PduRFrIfRef [0..1]: origin=GEENSYS, destination=FrIfConfig  # Reference to FrIf which is used for the current configuration. This parameter can be deleted if FrIf module is not used.
      reference PduRLinIfRef [0..1]: origin=GEENSYS, destination=LinIfGlobalConfig  # Reference to LinIf which is used for the current configuration. This parameter can be deleted if LinIf module is not used.
      reference PduRComRef [0..1]: origin=GEENSYS, destination=ComConfig  # Reference to Com which is used for the current configuration. This parameter can be deleted if Com module is not used.
      reference PduRIpduMRef [0..1]: origin=GEENSYS, destination=IPduMConfig  # Reference to IpduM which is used for the current configuration. This parameter can be deleted if IpduM module is not used.
      reference PduRCanTpRef [0..1]: origin=GEENSYS, destination=CanTpGeneral  # Reference to CanTp which is used for the current configuration. This parameter can be deleted if CanTp module is not used.
      reference PduRFrTpRef [0..1]: origin=GEENSYS, destination=FrTpMultipleConfig  # Reference to FrTp which is used for the current configuration. This parameter can be deleted if FrTp module is not used.
      reference PduRLinTpRef [0..1]: origin=GEENSYS, destination=LinTpGlobalConfig  # Reference to LinTp which is used for the current configuration. This parameter can be deleted if LinTp module is not used.
      reference PduRDcmRef [0..1]: origin=GEENSYS, destination=DcmDslProtocol  # Reference to Dcm which is used for the current configuration. This parameter can be deleted if Dcm module is not used.
    container PduRGlobalConfig: multiple-configuration-container=true  # This container contains the global configuration parameter of the PduR. It is a MultipleConfigurationContainer, i.e. this container and its sub-containers exit once per configuration set.
      integer PduRConfigurationId [0..1]: set at   # unique configuration identifier of post-build time configuration; this parameter shall be used if PDUR_ZERO_COST_OPERATION is disabled; otherwise it shall not be used.
      container PduRRoutingTable  # PDU Router routing table is a subcontainer ofPduR. This container shall only be considered by the PDU Router Configuration Generator if PduRGeneral/PDUR_ZERO_COST_OPERATION is disabled.
        container PduRRoutingPath [0..*]  # This container is a subcontainer of PduRRoutingTable and specifies the routing path of a PDU.
          integer SduLength [0..1]: 0..255, set at   # Length of PDU data (SDU). Only required if a TX buffer is configured.
          integer TpChunkSize [0..1]: 1..65535, set at   # Chunk size for routing on the fly. Defines the number of bytes which shall be received before transmission on the destination bus may start. Only required for TP gateway PDUs. The TpChunkSize shall not be larger than the length of the related TP Buffer.
          container PduRDefaultValue [0..1]  # This container is a subcontainer of PduRRoutingPath and specifies the default value of the I-PDU. Only required for gateway operation and if at least one PDU specified by PduRDestPdu uses TriggerTransmit Data provision. Represented as an array of IntegerParamDef.
            container PduRDefaultValueElement [0..*]  # Each value element is represented by the element and the position in an array.
              integer DefaultValueElement: 0..255, set at   # The default value consists of a number of elements. Each element is one byte long and the number of elements is specified by SduLength. The position of this parameter in the container is specified by the ElementBytePosition parameter.
              integer ElementBytePosition: set at   # This parameter specifies the byte position of the element within the default value
          container PduRDestPdu [1..*]  # This container is a subcontainer of PduRRoutingPath and specifies one destination for the PDU to be routed.
            enumeration DataProvision [0..1]: {DIRECT, TRIGGER_TRANSMIT}, set at   # Specifies how data are provided: direct (as part of the Transmit call) or via the TriggerTransmit callback function. Only required for non-TP gateway PDUs.
            reference DestPduRef: set at pre-compile in variant  /  in variant post-build, destination=Pdu  # Destination PDU reference; reference to unique PDU identifier which shall be used by the PDU Router instead of the source PDU ID when calling the related function of the destination module.
            reference TxBufferRef [0..1]: set at , destination=PduRTxBuffer  # Specifies the assigned transmit buffer. Only required for specific non-TP gateway PDUs.
          container PduRSrcPdu  # This container is a subcontainer of PduRRoutingPath and specifies the source of the PDU to be routed.
            integer HandleId: 0..65535, set at pre-compile in variant  /  in variant post-build, symbolic-name-value=true  # PDU identifier assigned by PDU Router.
            reference SrcPduRef: set at pre-compile in variant  /  in variant post-build, destination=Pdu  # Source PDU reference; reference to unique PDU identifier which shall be used for the requested PDU Router operation.
      container PduRTpBufferTable [0..1]  # This container is a subcontainer of PduR and contains the definition of all TP buffers (only required for PDU Router gateway operation). This container shall only be considered by the PDU Router Configuration Generator if PduRGeneral/PDUR_GATEWAY_OPERATION is enabled.
        integer PduRMaxTpBufferNumber: 0..65535, set at pre-compile  # maximum number of TP buffers.
        container PduRTpBuffer [0..*]  # This container is a subcontainer of PduRTpBufferTable and specifies a TP buffer.
          integer Length: 1..65535, set at   # Length of the buffer.
      container PduRTxBufferTable [0..1]  # This container is a subcontainer of PduR and contains the definition of all transmit buffers (used by specific non-TP PDUs; only required for PDU Router gateway operation). This container shall only be considered by the PDU Router Configuration Generator if PduRGeneral/PDUR_GATEWAY_OPERATION is enabled.
        integer PduRMaxTxBufferNumber: 0..65535, set at pre-compile  # maximum number of transmit buffers
        container PduRTxBuffer [0..*]  # This container is a subcontainer of PduRTxBufferTable and specifies a transmit buffer for a non-TP PDU.
          integer Depth: 0..255, set at   # Specifies the depth of the buffer
          integer Length: 1..255, set at   # Length of the buffer.
  bsw module description PduR_Desc
  bsw behavior PduR_Beh: module=PduR_Desc
  bsw implementation PduR_Impl: behavior=PduR_Beh, preconfigured-configuration=PduR_Impl_preconfigured, recommended-configuration=PduR_Impl_recommended, vendor-specific-module-def=PduR
  module config PduR_Impl_preconfigured: definition=PduR, module-description=PduR_Impl
    PduRGeneral:
      PduRCanIfSupport = (unset)
      PduRCanTpSupport = (unset)
      PduRComSupport = (unset)
      PduRDcmSupport = (unset)
      PduRDevErrorDetect = (unset)
      PduRTxMulticastToTpNumber = (unset)
      PduRFifoTxBufferSupport = (unset)
      PduRFrIfSupport = (unset)
      PduRFrTpSupport = (unset)
      PduRGatewayOperation = (unset)
      PduRIPduMSupport = (unset)
      PduRLinIfSupport = (unset)
      PduRLinTpSupport = (unset)
      PduRMemorySize = (unset)
      PduRMinimumRoutingLoModule = (unset)
      PduRMinimumRoutingLoRxPduId = (unset)
      PduRMinimumRoutingLoTxPduId = (unset)
      PduRMinimumRoutingUpModule = (unset)
      PduRMinimumRoutingUpRxPduId = (unset)
      PduRMinimumRoutingUpTxPduId = (unset)
      PduRCanTpChangeParameterSupport = (unset)
      PduRFrTpChangeParameterSupport = (unset)
      PduRLinTpChangeParameterSupport = (unset)
      PduRUseConsecutiveHandleId = (unset)
      PduRTxBufferDefaultValueUsed = (unset)
      PduRMinimumRoutingUsed = (unset)
      PduRUseConsecutiveTxIdInLowLayer = (unset)
      PduRMulticastFromIfSupport = (unset)
      PduRMulticastFromTpSupport = (unset)
      PduRMulticastToIfSupport = (unset)
      PduRMulticastToTpSupport = (unset)
      PduRSbTxBufferSupport = (unset)
      PduRSingleIf = (unset)
      PduRSingleTp = (unset)
      PduRVersionInfoApi = (unset)
      PduRZeroCostOperation = (unset)
      PduRCanIfRef = (unset)
      PduRFrIfRef = (unset)
      PduRLinIfRef = (unset)
      PduRComRef = (unset)
      PduRIpduMRef = (unset)
      PduRCanTpRef = (unset)
      PduRFrTpRef = (unset)
      PduRLinTpRef = (unset)
      PduRDcmRef = (unset)
    PduRGlobalConfig: PduRConfigurationId=(unset)
      PduRRoutingTable
        PduRRoutingPath: SduLength=(unset), TpChunkSize=(unset)
          PduRDefaultValue
            PduRDefaultValueElement: DefaultValueElement=(unset), ElementBytePosition=(unset)
          PduRDestPdu: DataProvision=(unset), DestPduRef=(unset), TxBufferRef=(unset)
          PduRSrcPdu: HandleId=(unset), SrcPduRef=(unset)
      PduRTpBufferTable: PduRMaxTpBufferNumber=(unset)
        PduRTpBuffer: Length=(unset)
      PduRTxBufferTable: PduRMaxTxBufferNumber=(unset)
        PduRTxBuffer: Depth=(unset), Length=(unset)
  module config PduR_Impl_recommended: definition=PduR, module-description=PduR_Impl
    PduRGeneral:
      PduRCanIfSupport = (unset)
      PduRCanTpSupport = (unset)
      PduRComSupport = (unset)
      PduRDcmSupport = (unset)
      PduRDevErrorDetect = (unset)
      PduRTxMulticastToTpNumber = (unset)
      PduRFifoTxBufferSupport = (unset)
      PduRFrIfSupport = (unset)
      PduRFrTpSupport = (unset)
      PduRGatewayOperation = (unset)
      PduRIPduMSupport = (unset)
      PduRLinIfSupport = (unset)
      PduRLinTpSupport = (unset)
      PduRMemorySize = (unset)
      PduRMinimumRoutingLoModule = (unset)
      PduRMinimumRoutingLoRxPduId = (unset)
      PduRMinimumRoutingLoTxPduId = (unset)
      PduRMinimumRoutingUpModule = (unset)
      PduRMinimumRoutingUpRxPduId = (unset)
      PduRMinimumRoutingUpTxPduId = (unset)
      PduRCanTpChangeParameterSupport = (unset)
      PduRFrTpChangeParameterSupport = (unset)
      PduRLinTpChangeParameterSupport = (unset)
      PduRUseConsecutiveHandleId = (unset)
      PduRTxBufferDefaultValueUsed = (unset)
      PduRMinimumRoutingUsed = (unset)
      PduRUseConsecutiveTxIdInLowLayer = (unset)
      PduRMulticastFromIfSupport = (unset)
      PduRMulticastFromTpSupport = (unset)
      PduRMulticastToIfSupport = (unset)
      PduRMulticastToTpSupport = (unset)
      PduRSbTxBufferSupport = (unset)
      PduRSingleIf = (unset)
      PduRSingleTp = (unset)
      PduRVersionInfoApi = (unset)
      PduRZeroCostOperation = (unset)
      PduRCanIfRef = (unset)
      PduRFrIfRef = (unset)
      PduRLinIfRef = (unset)
      PduRComRef = (unset)
      PduRIpduMRef = (unset)
      PduRCanTpRef = (unset)
      PduRFrTpRef = (unset)
      PduRLinTpRef = (unset)
      PduRDcmRef = (unset)
    PduRGlobalConfig: PduRConfigurationId=(unset)
      PduRRoutingTable
        PduRRoutingPath: SduLength=(unset), TpChunkSize=(unset)
          PduRDefaultValue
            PduRDefaultValueElement: DefaultValueElement=(unset), ElementBytePosition=(unset)
          PduRDestPdu: DataProvision=(unset), DestPduRef=(unset), TxBufferRef=(unset)
          PduRSrcPdu: HandleId=(unset), SrcPduRef=(unset)
      PduRTpBufferTable: PduRMaxTpBufferNumber=(unset)
        PduRTpBuffer: Length=(unset)
      PduRTxBufferTable: PduRMaxTxBufferNumber=(unset)
        PduRTxBuffer: Depth=(unset), Length=(unset)
