AUTOSAR XML
# Proprietary - Copyright (C) 2008
package /ARRoot
  module definition CanIf: refined-module-def=CanIf
    container CanIfControllerConfig [1..*]  # This container contains the configuration (parameters) of all addressed CAN controllers by each underlying CAN driver.
      enumeration CanIfWakeupSupport: {CONTROLLER, NO_WAKEUP, TRANSCEIVER}, set at link in variant link-time+post-build / pre-compile in variant pre-compile  # Enables wakeup support and defines the source device of a wakeup event.
      reference CanIfDriverNameRef: set at link in variant link-time+post-build / pre-compile in variant pre-compile, destination=CanIfDriverConfig  # Refers to the CAN Driver Name to which the controller belongs to. This parameter refers to CanIfDriverConfig container.
      reference CanIfInitControllerRef: set at link in variant link-time+post-build / pre-compile in variant pre-compile, destination=CanIfInitControllerConfig  # Reference to the Init Controller Configuration.
      symbolic name reference CanIfControllerIdRef [0..*]: destination=CanController  # Logical handle of the underlying CAN controller to be served by the CAN Interface. Range: 0..max. number of underlying supported
    container CanIfDispatchConfig [0..1]  # Callout functions with respect to the upper layers. This callout functions defined in this container are common to all configured underlying CAN Drivers / CAN Transceiver Drivers.
      function name CanIfBusOffNotification: set at link in variant link-time+post-build / pre-compile in variant pre-compile, default-value=CanSM_ControllerBusOff  # Name of target BusOff notification services to target upper layers (PduRouter, CanNm, CanTp and ComplexDeviceDrivers).
      function name CanIfWakeupNotification [0..1]: set at link in variant link-time+post-build / pre-compile in variant pre-compile  # Name of target wakeup notification services to target upper layers (PduRouter, CanNm, CanTp and ComplexDeviceDrivers). If parameter is 0 no call-out function is configured.
      function name CanIfWakeupValidNotification [0..1]: set at link in variant link-time+post-build / pre-compile in variant pre-compile  # Name of target wakeup validation notification services to target upper layers (ECU State Manager). If parameter is 0 no call-out function is configured.
    container CanIfDriverConfig [1..*]  # Configuration parameters for all the underlying CAN drivers are aggregated under this container.
      string CanIfDriverRefConfig: set at link in variant link-time+post-build / pre-compile in variant pre-compile, origin=INFOSYS
      string CanIfDriverName: set at link in variant link-time+post-build / pre-compile in variant pre-compile, origin=INFOSYS
      boolean CanIfBusoffNotification: set at link in variant link-time+post-build / pre-compile in variant pre-compile, default-value=true  # Selects whether BusOff indication notification is supported. True: Enabled False: Disabled
      boolean CanIfReceiveIndication: set at link in variant link-time+post-build / pre-compile in variant pre-compile  # Selects whether receive indication notification is supported. True: Enabled False: Disabled
      boolean CanIfTransmitCancellation: set at pre-compile  # Selects whether transmit cancellation is supported. True: Enabled False: Disabled
      boolean CanIfTxConfirmation: set at link in variant link-time+post-build / pre-compile in variant pre-compile  # Selects whether transmit confirmation notification is supported.
      boolean CanIfWakeupNotification: set at link in variant link-time+post-build / pre-compile in variant pre-compile, default-value=true  # Selects whether wakeup indication notification is supported. True: Enabled False: Disabled
      reference CanIfDriverNameRef: set at pre-compile, destination=CanGeneral  # CAN Interface Driver Reference. This reference can be used to get any information (Ex. Driver Name, Vendor ID) from the CAN driver. The CAN Driver name can be derived from the ShortName of the CAN driver module.
      reference CanIfInitHohConfigRef: set at link in variant link-time+post-build / pre-compile in variant pre-compile, destination=CanIfInitHohConfig  # Reference to the Init Hoh Configuration
    container CanIfInitConfiguration [1..*]: multiple-configuration-container=true  # This container contains the init parameters of the CAN Interface.
      string CanIfConfigSet: set at link in variant link-time / pre-compile in variant pre-compile / post-build in variant post-build  # Selects the CAN Interface specific configuration setup. This type of the external data structure shall contain the post build initialization data for the CAN Interface for all underlying CAN Dirvers. constant to CanIf_ConfigType
      integer CanIfNumberOfCanRxPduIds: set at link in variant link-time / pre-compile in variant pre-compile / post-build in variant post-build  # Total number of CanRxPduIds to be handled. Range: 0..max number of defined CanRxPduIds
      integer CanIfNumberOfCanTXPduIds: set at link in variant link-time / pre-compile in variant pre-compile / post-build in variant post-build  # Total number of CanTxPduIds to be handled. Range: 0..max number of defined CanTxPduIds
      integer CanIfNumberOfDynamicCanTXPduIds: set at link in variant link-time / pre-compile in variant pre-compile / post-build in variant post-build  # Total number of dynamic CanTxPduIds to be handled. Range: 0..max. nember of defined CanTxPduIds
      container CanIfInitControllerConfig [0..*]  # This container contains the references to the configuration setup of each underlying CAN driver.
        string CanIfControllerConfig: set at link in variant link-time+post-build / pre-compile in variant pre-compile, origin=INFOSYS
        symbolic name reference CanIfControllerRefConfigSet: destination=CanController  # References the corresponding CAN Controller configuration setup of the corresponding CAN Driver.
      container CanIfInitHohConfig [0..*]  # This container contains the references to the configuration setup of each underlying CAN Driver.
        reference CanIfRefConfigSet: set at link in variant link-time / pre-compile in variant pre-compile / post-build in variant post-build, destination=CanConfigSet  # Selects the CAN Interface specific configuration setup. This type of external data structure shall contain the post build initialization data for the CAN Interface for all underlying CAN Drivers.
        container CanIfHrhConfig [0..*]  # This container contains configuration parameters for each hardware receive object (HRH).
          enumeration CanIfHrhType: {BASIC_CAN, FULL_CAN}, set at link in variant link-time+post-build / pre-compile in variant pre-compile  # Defines the HRH type i.e, whether its a BasicCan or FullCan. If BasicCan is configured, software filtering is enabled.
          boolean CanIfSoftwareFilterHrh: set at link in variant link-time+post-build / pre-compile in variant pre-compile, default-value=true  # Selects the hardware receive objects by using the HRH range/list from CAN Driver configuration to define, for which HRH a software filtering has to be performed at during receive processing. True: Software filtering is enabled False: Software filtering is enabled
          reference CanIfCanControllerHrhIdRef: set at link in variant link-time+post-build / pre-compile in variant pre-compile, destination=CanIfControllerConfig  # Reference to controller Id to which the HRH belongs to. A controller can contain one or more HRHs.
          symbolic name reference CanIfHrhIdSymRef: destination=CanHardwareObject  # The parameter refers to a particular HRH object in the CAN Driver Module configuration. The HRH id is unique in a given CAN Driver. The HRH Ids are defined in the CAN Driver Module and hence it is derived from CAN Driver Configuration.
          container CanIfHrhRangeConfig [0..*]  # Defines the parameters required for configuraing multiple CANID ranges for a given same HRH.
            integer CanIfRxPduLowerCanId: set at link in variant link-time / pre-compile in variant pre-compile / post-build in variant post-build  # Lower CAN Identifier of a receive CAN L-PDU for identifier range definition, in which all CAN Ids shall pass the software filtering. Range: 11 Bit for Standard CAN Identifier 29 Bit for Extended CAN Identifer
            integer CanIfRxPduUpperCanId: set at link in variant link-time / pre-compile in variant pre-compile / post-build in variant post-build  # Upper CAN Identifier of a receive CAN L-PDU for identifier range definition, in which all CAN Ids shall pass the software filtering. Range: 11 Bit for Standard CAN Identifier 29 Bit for Extended CAN Identifer
        container CanIfHthConfig [0..*]  # This container contains parameters related to each HTH.
          enumeration CanIfHthType: {BASIC_CAN, FULL_CAN}, set at link in variant link-time+post-build / pre-compile in variant pre-compile  # Transmission method of the corresponding HTH.
          reference CanIfCanControllerIdRef: set at link in variant link-time+post-build / pre-compile in variant pre-compile, destination=CanIfControllerConfig  # Reference to controller Id to which the HTH belongs to. A controller can contain one or more HTHs.
          symbolic name reference CanIfHthIdSymRef: destination=CanHardwareObject  # The parameter refers to a particular HTH object in the CAN Driver Module configuration. The HTH id is unique in a given CAN Driver. The HTH Ids are defined in the CAN Driver Module and hence it is derived from CAN Driver Configuration.
      container CanIfRxPduConfig [0..*]  # This container contains the configuration (parameters) of each receive CAN L-PDU. The SHORT-NAME of "CanIfRxPduConfig" container itself represents the symolic name of Receive L-PDU.
        integer CanIfCanRxPduCanId: set at link in variant link-time / pre-compile in variant pre-compile / post-build in variant post-build  # CAN Identifier of Receive CAN L-PDUs used by the CAN Interface. Exa: Software Filtering. Range: 11 Bit For Standard CAN Identifier ... 29 Bit For Extended CAN identifier
        integer CanIfCanRxPduDlc: 0..8, set at link in variant link-time / pre-compile in variant pre-compile / post-build in variant post-build  # Data Length code of received CAN L-PDUs used by the CAN Interface. Exa: DLC check. The data area size of a CAN L-PDU can have a range from 0 to 8 bytes.
        integer CanIfCanRxPduId: set at link in variant link-time / pre-compile in variant pre-compile / post-build in variant post-build, symbolic-name-value=true  # ECU wide unique, symbolic handle for receive CAN L-PDU. The CanRxPduId is configurable at pre-compile and post-built time. It shall fulfill ANSI/AUTOSAR definitions for constant defines. Range: 0..max. number of defined CanRxPduIds
        boolean CanIfReadRxPduData: set at link in variant link-time / pre-compile in variant pre-compile / post-build in variant post-build, default-value=false  # Enables and disables the Rx buffering for reading of received L-PDU data. True: Enabled False: Disabled
        boolean CanIfReadRxPduNotifyStatus: set at link in variant link-time / pre-compile in variant pre-compile / post-build in variant post-build, default-value=false  # Enables and disables receive indication for each receive CAN L-PDU for reading its' notification status. True: Enabled False: Disabled
        enumeration CanIfRxPduIdCanIdType: {EXTENDED_CAN, STANDARD_CAN}, set at link in variant link-time / pre-compile in variant pre-compile / post-build in variant post-build  # CAN Identtifier of receive CAN L-PDUs used by the CAN Driver for CAN L-PDU reception.
        enumeration CanIfRxUserType: {CAN_NM, CAN_TP, PDUR}, set at link in variant link-time / pre-compile in variant pre-compile / post-build in variant post-build  # This parameter defines the type of the receive indication call-outs called to the corresponding upper layer the used TargetRxPduId belongs to.
        function name CanIfUserRxIndication: set at link in variant link-time+post-build / pre-compile in variant pre-compile  # Name of target indication services to target upper layers (PduRouter, CanNm, CanTp and ComplexDeviceDrivers). If parameter is 0 no call-out function is configured.
        reference CanIfCanRxPduHrhRef [0..*]: set at link in variant link-time / pre-compile in variant pre-compile / post-build in variant post-build, destination=CanIfHrhConfig  # The HRH to which Rx L-PDU belongs to, is referred through this parameter.
        reference PduIdRef: set at pre-compile, destination=Pdu  # Reference to the "global" Pdu structure to allow harmonization of handle IDs in the COM-Stack.
        reference SrcPduRef [0..1]: set at pre-compile, origin=INFOSYS, destination=PduRRoutingTable
        reference CanNmTxPduRef [0..1]: set at pre-compile, origin=INFOSYS, destination=CanNmChannelConfig
        reference CanTpRxPduRef [0..1]: set at pre-compile, origin=INFOSYS, destination=CanTpRxNSdu
        reference ComSignalRef [0..1]: set at pre-compile, origin=INFOSYS, destination=ComConfig
      container CanIfTxPduConfig [0..*]  # This container contains the configuration (parameters) of each transmit CAN L-PDU. The SHORT-NAME of "CanIfTxPduConfig" container represents the symolic name of Transmit L-PDU.
        integer CanIfCanTxPduId: set at link in variant link-time / pre-compile in variant pre-compile / post-build in variant post-build, symbolic-name-value=true  # ECU wide unique, symbolic handle for transmit CAN L-PDU. The CanIfCanTxPduId is configurable at pre-compile and post-built time. Range: 0..max. number of CantTxPduIds
        integer CanIfCanTxPduIdCanId: set at link in variant link-time / pre-compile in variant pre-compile / post-build in variant post-build  # CAN Identifier of transmit CAN L-PDUs used by the CAN Driver for CAN L-PDU transmission. Range: 11 Bit For Standard CAN Identifier ... 29 Bit For Extended CAN identifier
        integer CanIfCanTxPduIdDlc: 0..8, set at link in variant link-time / pre-compile in variant pre-compile / post-build in variant post-build  # Data length code (in bytes) of transmit CAN L-PDUs used by the CAN Driver for CAN L-PDU transmission. The data area size of a CAN L-Pdu can have a range from 0 to 8 bytes.
        enumeration CanIfCanTxPduType: {DYNAMIC, STATIC}, set at link in variant link-time / pre-compile in variant pre-compile / post-build in variant post-build  # Defines the type of each transmit CAN L-PDU.
        boolean CanIfReadTxPduNotifyStatus: set at link in variant link-time / pre-compile in variant pre-compile / post-build in variant post-build, default-value=false  # Enables and disables transmit confirmation for each transmit CAN L-PDU for reading its notification status. True: Enabled False: Disabled
        enumeration CanIfTxPduIdCanIdType: {EXTENDED_CAN, STANDARD_CAN}, set at link in variant link-time / pre-compile in variant pre-compile / post-build in variant post-build  # CAN Identifier of transmit CAN L-PDUs used by the CAN Driver for CAN L-PDU transmission.
        enumeration CanIfTxUserType: {CAN_NM, CAN_TP, PDUR}, set at link in variant link-time / pre-compile in variant pre-compile / post-build in variant post-build  # This parameter defines the type of the transmit confirmation call-out called to the corresponding upper layer the used TargetTxPduId belongs to.
        function name CanIfUserTxConfirmation [0..1]: set at link in variant link-time+post-build / pre-compile in variant pre-compile  # Name of target confirmation services to target upper layers (PduR, CanNm and CanTp. If parameter is not configured then no call-out function is provided by the upper layer for this Tx L-PDU.
        reference CanIfCanTxPduHthRef [0..*]: set at link in variant link-time / pre-compile in variant pre-compile / post-build in variant post-build, destination=CanIfHthConfig  # Handle, that defines the hardware object or the pool of hardware objects configured for transmission. The parameter refers HTH Id, to which the L-PDU belongs to.
        reference PduIdRef: set at pre-compile, destination=Pdu  # Reference to the "global" Pdu structure to allow harmonization of handle IDs in the COM-Stack.
    container CanIfPrivateConfiguration  # This container contains the private configuration (parameters) of the CAN Interface.
      boolean CanIfDlcCheck: set at pre-compile, default-value=true  # Selects whether the DLC check is supported. True: Enabled False: Disabled
      integer CanIfNumberOfTxBuffers: set at pre-compile  # Defined the number of L-PDU elements for the transmit buffering. The Tx L-PDU buffers shall be used to store an L-PDU once for each different L-PDU handle. Range: 0..max. number of Tx L-PDUs to be used. Default Value: NUMBER_OF_TX_PDUS
      enumeration CanIfSoftwareFilterType: {BINARY, INDEX, LINEAR, TABLE}, set at pre-compile  # Selects the desired software filter mechanism for reception only. Each implemented software filtering method is identified by this enumeration number. Range: Types implemented software filtering methods
      reference CanIfPduRRef: origin=INFOSYS, destination=PduRGeneral  # Reference to PduR Module.
      reference CanIfEcuMRef: origin=INFOSYS, destination=EcuMConfiguration  # Reference to EcuM Module.
      reference CanTp_Ref [0..1]: destination=CanTpGeneral
      reference CanIfCanNmRef [0..1]: destination=CanNmGlobalConfig  # Reference to CanNm Module.
      reference CanIfCanSMRef: destination=CanStateManagerConfiguration  # Reference to CanSM Module.
    container CanIfPublicConfiguration  # This container contains the public configuration (parameters) of the CAN Interface.
      boolean CanIfDevErrorDetect: set at pre-compile, default-value=true  # Enables and disables the development error detection and notification mechanism. True: Enabled False: Disabled
      boolean CanIfMultipleDriverSupport: set at pre-compile, default-value=true  # Selects support for multiple CAN Drivers. True: Enabled False: Disabled
      integer CanIfNumberOfCanHwUnits: set at link in variant link-time+post-build / pre-compile in variant pre-compile, default-value=1  # Number of served CAN hardware units. Range: 1..max. number of underlying supported CAN Hardware units
      boolean CanIfReadRxPduDataApi: set at pre-compile, default-value=false  # Enables / Disables the API CanIf_ReadRxPduData() for reading received L-PDU data. True: Enabled False: Disabled
      boolean CanIfReadRxPduNotifyStatusApi: set at pre-compile, default-value=false  # Enables and disables the API for reading the received L-PDU data. True: Enabled False: Disabled
      boolean CanIfReadTxPduNotifyStatusApi: set at pre-compile, default-value=false  # Enables and disables the API for reading the notification status of transmit and receive L-PDUs. True: Enabled False: Disabled
      boolean CanIfSetDynamicTxIdApi: set at pre-compile, default-value=false  # Enables and disables the API for reconfiguration of the CAN Identifier for each Transmit L-PDU. True: Enabled False: Disabled
      boolean CanIfVersionInfoApi: set at pre-compile, default-value=true  # Enables and disables the API for reading the version information about the CAN Interface. True: Enabled False: Disabled
      boolean CanIfWakeUpValidationApi: set at pre-compile, origin=INFOSYS
      boolean CanIfWakeupEventApi: set at pre-compile, default-value=true  # Enables and disables the API for wakeup support called by the CAN Driver. True: Enabled False: Disabled
    container CanIfTransceiverDrvConfig [1..*]  # This container contains the configuration (parameters) of all addressed CAN transceivers by each underlying CAN Transceiver Driver.
      string CanIfTrcvName: set at link in variant link-time+post-build / pre-compile in variant pre-compile, origin=INFOSYS
      boolean CanIfTrcvWakeupNotification: set at link in variant link-time+post-build / pre-compile in variant pre-compile, default-value=false  # Selects whether wakeup indication notification is supported. True: Enabled False: Disabled
      symbolic name reference CanIfTrcvIdRef [0..*]: destination=CanTrcvChannel  # Logical handle of the underlying CAN transceiver to be served by the CAN Interface.
  bsw module description CanIf_Desc
  bsw behavior CanIf_Beh: module=CanIf_Desc
  bsw implementation CanIf_Impl: programming-language=C, behavior=CanIf_Beh, preconfigured-configuration=CanIf_Impl_preconfigured, recommended-configuration=CanIf_Impl_recommended, vendor-specific-module-def=CanIf
  module config CanIf_Impl_preconfigured: definition=CanIf, implementation-config-variant=VARIANT-PRE-COMPILE, module-description=CanIf_Impl
    CanIfControllerConfig: CanIfWakeupSupport=(unset), CanIfDriverNameRef=(unset), CanIfInitControllerRef=(unset), CanIfControllerIdRef=(unset)
    CanIfDispatchConfig: CanIfBusOffNotification=(unset), CanIfWakeupNotification=(unset), CanIfWakeupValidNotification=(unset)
    CanIfDriverConfig:
      CanIfDriverRefConfig = (unset)
      CanIfDriverName = (unset)
      CanIfBusoffNotification = (unset)
      CanIfReceiveIndication = (unset)
      CanIfTransmitCancellation = (unset)
      CanIfTxConfirmation = (unset)
      CanIfWakeupNotification = (unset)
      CanIfDriverNameRef = (unset)
      CanIfInitHohConfigRef = (unset)
    CanIfInitConfiguration: CanIfConfigSet=(unset), CanIfNumberOfCanRxPduIds=(unset), CanIfNumberOfCanTXPduIds=(unset), CanIfNumberOfDynamicCanTXPduIds=(unset)
      CanIfInitControllerConfig: CanIfControllerConfig=(unset), CanIfControllerRefConfigSet=(unset)
      CanIfInitHohConfig: CanIfRefConfigSet=(unset)
        CanIfHrhConfig: CanIfHrhType=(unset), CanIfSoftwareFilterHrh=(unset), CanIfCanControllerHrhIdRef=(unset), CanIfHrhIdSymRef=(unset)
          CanIfHrhRangeConfig: CanIfRxPduLowerCanId=(unset), CanIfRxPduUpperCanId=(unset)
        CanIfHthConfig: CanIfHthType=(unset), CanIfCanControllerIdRef=(unset), CanIfHthIdSymRef=(unset)
      CanIfRxPduConfig:
        CanIfCanRxPduCanId = (unset)
        CanIfCanRxPduDlc = (unset)
        CanIfCanRxPduId = (unset)
        CanIfReadRxPduData = (unset)
        CanIfReadRxPduNotifyStatus = (unset)
        CanIfRxPduIdCanIdType = (unset)
        CanIfRxUserType = (unset)
        CanIfUserRxIndication = (unset)
        CanIfCanRxPduHrhRef = (unset)
        PduIdRef = (unset)
        SrcPduRef = (unset)
        CanNmTxPduRef = (unset)
        CanTpRxPduRef = (unset)
        ComSignalRef = (unset)
      CanIfTxPduConfig:
        CanIfCanTxPduId = (unset)
        CanIfCanTxPduIdCanId = (unset)
        CanIfCanTxPduIdDlc = (unset)
        CanIfCanTxPduType = (unset)
        CanIfReadTxPduNotifyStatus = (unset)
        CanIfTxPduIdCanIdType = (unset)
        CanIfTxUserType = (unset)
        CanIfUserTxConfirmation = (unset)
        CanIfCanTxPduHthRef = (unset)
        PduIdRef = (unset)
    CanIfPrivateConfiguration:
      CanIfDlcCheck = (unset)
      CanIfNumberOfTxBuffers = (unset)
      CanIfSoftwareFilterType = (unset)
      CanIfPduRRef = (unset)
      CanIfEcuMRef = (unset)
      CanIfCanNmRef = (unset)
      CanIfCanSMRef = (unset)
    CanIfPublicConfiguration:
      CanIfDevErrorDetect = (unset)
      CanIfMultipleDriverSupport = (unset)
      CanIfNumberOfCanHwUnits = (unset)
      CanIfReadRxPduDataApi = (unset)
      CanIfReadRxPduNotifyStatusApi = (unset)
      CanIfReadTxPduNotifyStatusApi = (unset)
      CanIfSetDynamicTxIdApi = (unset)
      CanIfVersionInfoApi = (unset)
      CanIfWakeUpValidationApi = (unset)
      CanIfWakeupEventApi = (unset)
    CanIfTransceiverDrvConfig: CanIfTrcvName=(unset), CanIfTrcvWakeupNotification=(unset), CanIfTrcvIdRef=(unset)
  module config CanIf_Impl_recommended: definition=CanIf, implementation-config-variant=VARIANT-PRE-COMPILE, module-description=CanIf_Impl
    CanIfControllerConfig: CanIfWakeupSupport=(unset), CanIfDriverNameRef=(unset), CanIfInitControllerRef=(unset), CanIfControllerIdRef=(unset)
    CanIfDispatchConfig: CanIfBusOffNotification=(unset), CanIfWakeupNotification=(unset), CanIfWakeupValidNotification=(unset)
    CanIfDriverConfig:
      CanIfDriverRefConfig = (unset)
      CanIfDriverName = (unset)
      CanIfBusoffNotification = true
      CanIfReceiveIndication = (unset)
      CanIfTransmitCancellation = (unset)
      CanIfTxConfirmation = (unset)
      CanIfWakeupNotification = true
      CanIfDriverNameRef = (unset)
      CanIfInitHohConfigRef = (unset)
    CanIfInitConfiguration: CanIfConfigSet=(unset), CanIfNumberOfCanRxPduIds=(unset), CanIfNumberOfCanTXPduIds=(unset), CanIfNumberOfDynamicCanTXPduIds=(unset)
      CanIfInitControllerConfig: CanIfControllerConfig=(unset), CanIfControllerRefConfigSet=(unset)
      CanIfInitHohConfig: CanIfRefConfigSet=(unset)
        CanIfHrhConfig: CanIfHrhType=(unset), CanIfSoftwareFilterHrh=true, CanIfCanControllerHrhIdRef=(unset), CanIfHrhIdSymRef=(unset)
          CanIfHrhRangeConfig: CanIfRxPduLowerCanId=(unset), CanIfRxPduUpperCanId=(unset)
        CanIfHthConfig: CanIfHthType=(unset), CanIfCanControllerIdRef=(unset), CanIfHthIdSymRef=(unset)
      CanIfRxPduConfig:
        CanIfCanRxPduCanId = (unset)
        CanIfCanRxPduDlc = (unset)
        CanIfCanRxPduId = (unset)
        CanIfReadRxPduData = false
        CanIfReadRxPduNotifyStatus = false
        CanIfRxPduIdCanIdType = (unset)
        CanIfRxUserType = (unset)
        CanIfUserRxIndication = (unset)
        CanIfCanRxPduHrhRef = (unset)
        PduIdRef = (unset)
        SrcPduRef = (unset)
        CanNmTxPduRef = (unset)
        CanTpRxPduRef = (unset)
        ComSignalRef = (unset)
      CanIfTxPduConfig:
        CanIfCanTxPduId = (unset)
        CanIfCanTxPduIdCanId = (unset)
        CanIfCanTxPduIdDlc = (unset)
        CanIfCanTxPduType = (unset)
        CanIfReadTxPduNotifyStatus = false
        CanIfTxPduIdCanIdType = (unset)
        CanIfTxUserType = (unset)
        CanIfUserTxConfirmation = (unset)
        CanIfCanTxPduHthRef = (unset)
        PduIdRef = (unset)
    CanIfPrivateConfiguration:
      CanIfDlcCheck = true
      CanIfNumberOfTxBuffers = (unset)
      CanIfSoftwareFilterType = (unset)
      CanIfPduRRef = (unset)
      CanIfEcuMRef = (unset)
      CanIfCanNmRef = (unset)
      CanIfCanSMRef = (unset)
    CanIfPublicConfiguration:
      CanIfDevErrorDetect = true
      CanIfMultipleDriverSupport = true
      CanIfNumberOfCanHwUnits = 1
      CanIfReadRxPduDataApi = false
      CanIfReadRxPduNotifyStatusApi = false
      CanIfReadTxPduNotifyStatusApi = false
      CanIfSetDynamicTxIdApi = false
      CanIfVersionInfoApi = true
      CanIfWakeUpValidationApi = (unset)
      CanIfWakeupEventApi = true
    CanIfTransceiverDrvConfig: CanIfTrcvName=(unset), CanIfTrcvWakeupNotification=false, CanIfTrcvIdRef=(unset)
