AUTOSAR XML (schema 4.0)
package /EPD
  module definition Vehicle
    container Engine [0..1]
      boolean Automatic: default-value=0
      enumeration EngineType: {Gasoline, Diesel}
      choice container Type
        container Gasoline
          string SparkPlugModel
          integer SparkPlugNumber
          float SparkPlugVoltage
        container Diesel
          string DieselFilterModel
          float MaxCouple
    container GeneralInfo
      integer Year
      integer SerialNumber
      string Manufacturer
      string VehicleName
      reference CurrentOwner: destination=Owner
      reference FirstHand [0..1]
      choice reference FinitionLevel: destination=[High, Medium, Low]
      container Owners
        container Owner [1..*]
          string FirstName [0..1]
          string LastName
      container Revisions [0..1]
        string RevisionDate [0..*]
    container Options
      choice container Color [1..5]
        container UnifiedColor
          choice reference ColorRef: destination=[CharCoal, CornflowerBlue, Gold, HotPink, NavyBlue, PapayaWhip, SalsaRed, Silver]
        container MixedColors
          choice reference ColorRef [1..*]: destination=[CharCoal, CornflowerBlue, Gold, HotPink, NavyBlue, PapayaWhip, SalsaRed, Silver]
      container FinitionLevels
        container High
        container Medium
        container Low
  module definition Attributes
    container AvailableColors
      container HotPink
      container CharCoal
      container NavyBlue
      container CornflowerBlue
      container Gold
      container Silver
      container PapayaWhip
      container SalsaRed
    container Constant [0..*]
      enumeration Type: {Integer, String, Boolean}
      string Value
      string Name
    container Configurator
      string Name
      string Id
package /BMD  # The BSW Module Description package which contains all BMD-related elements.
  bsw implementation Vehicle: sw-version=1.2.0, behavior=Vehicle, vendor-specific-module-def=Vehicle
  bsw implementation Attributes: sw-version=10.1.18a, behavior=Attributes, vendor-specific-module-def=Attributes
  bsw module description Vehicle
    bsw internal behavior Vehicle
  bsw module description Attributes
    bsw internal behavior Attributes
