AUTOSAR XML (schema 4.0)
package /EPD
  module definition Vehicle
    container Engine [0..1]
      boolean Automatic
      enumeration EngineType: {Gasoline, Diesel}
      choice container Type
        container Gasoline
          string SparkPlugModel
          integer SparkPlugNumber
          float SparkPlugVoltage
        container Diesel
          string DieselFilterModel
          float MaxCouple
    container GeneralInfo
      integer Year
      integer SerialNumber
      string Manufacturer
      string VehicleName
      reference CurrentOwner: destination=Owner
      reference FirstHand [0..1]
      choice reference FinitionLevel: destination=[High, Medium, Low]
      container Owners
        container Owner [1..*]
          string FirstName [0..1]
          string LastName
      container Revisons [0..1]
        string RevisionDate [0..*]
        reference OwnerAtThatTime [0..1]
    container Options
      container FinitionLevels
        container High
        container Medium
        container Low
  module definition Attributes
    container AvailableColors
      container HotPink
      container CharCoal
      container NavyBlue
      container CornflowerBlue
      container Gold
      container Silver
      container PapayaWhip
      container SalsaRed
package /BMD
  bsw implementation Vehicle: behavior=Vehicle, vendor-specific-module-def=Vehicle
  bsw module description Vehicle
    bsw internal behavior Vehicle
