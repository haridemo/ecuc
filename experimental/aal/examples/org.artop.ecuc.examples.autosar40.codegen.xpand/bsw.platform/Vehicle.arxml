AUTOSAR XML (schema 4.0)
package /EPD
  module definition Vehicle
    container Engine [0..1]
      boolean Automatic
      enumeration EngineType: {Gasoline, Diesel}
      choice container Type
        container Gasoline
          string SparkPlugModel
          integer SparkPlugNumber
          float SparkPlugVoltage
        container Diesel
          string DieselFilterModel
          float MaxCouple
    container GeneralInfo
      integer Year
      integer SerialNumber
      string Manufacturer
      string VehicleName
      choice reference EngineTypeChoice: destination=[Diesel, Gasoline]
      container Owners
        container Owner [1..*]
          string FirstName [0..1]
          string LastName
      container Revisons [0..1]
        string RevisionDate [0..*]
package /BMD
  bsw implementation Vehicle: behavior=Vehicle, vendor-specific-module-def=Vehicle
  bsw module description Vehicle
    bsw internal behavior Vehicle
