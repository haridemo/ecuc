AUTOSAR XML (schema 4.0)
package /BMD
  bsw implementation Vehicle: behavior=Vehicle, vendor-specific-module-def=Vehicle
  bsw module description Vehicle
    bsw internal behavior Vehicle
