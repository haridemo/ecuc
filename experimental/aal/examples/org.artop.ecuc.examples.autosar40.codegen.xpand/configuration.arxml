AUTOSAR XML (schema 4.0)
package /EPC
  module config Car: definition=Vehicle, module-description=Vehicle
    CategoryType: NbOfWheel=4
    Engine: EngineType=Gasoline
    GeneralInfo: VehicleName=Saxo, Manufacturer=(unset)
