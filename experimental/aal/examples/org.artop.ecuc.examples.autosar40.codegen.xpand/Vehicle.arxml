AUTOSAR XML (schema 4.0)
package /EPD
  module definition Vehicle
    container CategoryType
      integer NbOfWheel
    container Engine
      boolean Automatic
      enumeration EngineType: {Gasoline, Diesel}
    container GeneralInfo
      integer Year
      string Manufacturer
      string VehicleName
