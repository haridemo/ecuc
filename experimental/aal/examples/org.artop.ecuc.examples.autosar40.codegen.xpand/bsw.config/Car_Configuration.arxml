AUTOSAR XML (schema 4.0)
package /EPC
  module config Car: definition=Vehicle, module-description=Vehicle
    Engine: EngineType=Gasoline, Automatic=0
      Type
        Gasoline: SparkPlugNumber=12, SparkPlugVoltage=4.45, SparkPlugModel=Tartanpion Powa Boost
    GeneralInfo: VehicleName=Saxo, SerialNumber=879055672, Manufacturer=Citroën, Year=2000, FinitionLevel=High, CurrentOwner=FifthHand, FirstHand=(unset)
      Owners
        5 x Owner:
          FirstHand: LastName=Geensys
          SecondHand: LastName=See4sys
          ThirdHand: FirstName=John, LastName=Coltrane
          FourthHand: FirstName=Adderley, LastName=Cannonball
          FifthHand: FirstName=Herbie, LastName=Hancock
      Revisions (Revisons): RevisionDate=2007-12-15, RevisionDate=2008-01-06, RevisionDate=2008-06-05, RevisionDate=2009-07-07, RevisionDate=2010-09-18
    Options
      FinitionLevels
        High
        Low
