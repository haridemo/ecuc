AUTOSAR XML (schema 4.0)
package /EPC
  module config Car: definition=Vehicle, module-description=Vehicle
    Engine: EngineType=Gasoline, Automatic=0
      Type
        Gasoline: SparkPlugNumber=12, SparkPlugVoltage=4,45, SparkPlugModel=Tartanpion Powa Boost
    GeneralInfo: VehicleName=Saxo, SerialNumber=879055672, Manufacturer=Citroën, Year=2000, EngineTypeChoice=Gasoline
