AUTOSAR XML (schema 4-0-1)
package /EPC
  ecuc value collection ECU_Car: ecuc-values=[Car, CarAttributes]
  module config Car: definition=Vehicle, implementation-config-variant=VARIANT-PRE-COMPILE, module-description=Vehicle
    Engine: EngineType=Gasoline, Automatic=0
      Type
        Gasoline: SparkPlugNumber=12, SparkPlugVoltage=4.45, SparkPlugModel=Tartanpion Powa Boost
    GeneralInfo: VehicleName=Saxo, SerialNumber=879055672, Manufacturer=Citroën, Year=2000, FinitionLevel=High, CurrentOwner=FifthHand, FirstHand=(unset)
      Owners
        5 x Owner:
          FirstHand: LastName=Geensys
          SecondHand: LastName=See4sys
          ThirdHand: FirstName=John, LastName=Coltrane
          FourthHand: FirstName=Adderley, LastName=Cannonball
          FifthHand: FirstName=Herbie, LastName=Hancock
      Revisions:
        RevisionDate = 2007-12-15
        RevisionDate = 2008-01-06
        RevisionDate = 2008-06-05
        RevisionDate = 2009-07-07
        RevisionDate = 2010-09-18
        RevisionsReport = This report gathers all the things that have been preformed durgin each revision of that car.
    Options
      FinitionLevels
        High
        Low
      ColorStd (Color)
        UnifiedColor: ColorRef=Gold
      ColorExt (Color)
        MixedColors: ColorRef=Silver, ColorRef=SalsaRed
  module config CarAttributes: definition=Attributes, module-description=Attributes
    AvailableColors
      Gold
      Silver
      PapayaWhip
      SalsaRed
    Constant_NbWheels (Constant): Type=Integer, Value=4, Name=NumberOfWheels
    Configurator: Id=1234-5678, Name=See4sys
