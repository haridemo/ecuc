AUTOSAR XML (schema 4.0)
package /EPC
  module config Car: definition=Vehicle, module-description=Vehicle
    Engine: EngineType=Gasoline, Automatic=0
      Type
        Gasoline: SparkPlugNumber=12, SparkPlugVoltage=4.45, SparkPlugModel=Tartanpion Powa Boost
    GeneralInfo: VehicleName=Saxo, SerialNumber=879055672, Manufacturer=Citroën, Year=2000, EngineTypeChoice=Gasoline
      Owners
        4 x Owner:
          Owner_1: Owner LastName=Sesestre, Owner FirstName=Romain
          Owner_2: Owner LastName=Dieng, Owner FirstName=Idrissa
          Owner_3: Owner LastName=Eberle, Owner FirstName=Stephan
          Owner_4: Owner LastName=Didierjean, Owner FirstName=Yannick
      Revision Dates (Revisons Dates): Revision Date=06/01/2008, Revision Date=06/05/2008, Revision Date=07/07/2009, Revision Date=18/09/2010
